/*
COPYRIGHT
Copyright (c) 2006-2011 by Vctr Informatik GmbH. All rights reserved.
This software is copyright protected and proprietary to Vctr Informatik GmbH.
Vctr Informatik GmbH grants to you only those rights as set out in the license conditions.
License:  License CBD1010124 valid for CBD1010124 Nxtr  Package: BMW MSR SIP BAC3.0 Micro: TI TMS570 TMS570LS30306  Compiler: Code Composer Studio 4.9.0
*/
/begin MEASUREMENT Rte_FaultLog_FaultLog.CTCPassData[52].Byte6_Cnt_u08 "MICROSAR RTE" UBYTE NO_COMPU_METHOD 0 0 0 255 ECU_ADDRESS 0 READ_WRITE /end MEASUREMENT
/begin MEASUREMENT Rte_FaultLog_FaultLog.CTCPassData[52].Reserved1_Cnt_u08 "MICROSAR RTE" UBYTE NO_COMPU_METHOD 0 0 0 255 ECU_ADDRESS 0 READ_WRITE /end MEASUREMENT
/begin MEASUREMENT Rte_FaultLog_FaultLog.CTCPassData[52].Reserved2_Cnt_u08 "MICROSAR RTE" UBYTE NO_COMPU_METHOD 0 0 0 255 ECU_ADDRESS 0 READ_WRITE /end MEASUREMENT
/begin MEASUREMENT Rte_FaultLog_FaultLog.CTCPassData[53].Byte1_Cnt_u08 "MICROSAR RTE" UBYTE NO_COMPU_METHOD 0 0 0 255 ECU_ADDRESS 0 READ_WRITE /end MEASUREMENT
/begin MEASUREMENT Rte_FaultLog_FaultLog.CTCPassData[53].Byte2_Cnt_u08 "MICROSAR RTE" UBYTE NO_COMPU_METHOD 0 0 0 255 ECU_ADDRESS 0 READ_WRITE /end MEASUREMENT
/begin MEASUREMENT Rte_FaultLog_FaultLog.CTCPassData[53].Byte3_Cnt_u08 "MICROSAR RTE" UBYTE NO_COMPU_METHOD 0 0 0 255 ECU_ADDRESS 0 READ_WRITE /end MEASUREMENT
/begin MEASUREMENT Rte_FaultLog_FaultLog.CTCPassData[53].Byte4_Cnt_u08 "MICROSAR RTE" UBYTE NO_COMPU_METHOD 0 0 0 255 ECU_ADDRESS 0 READ_WRITE /end MEASUREMENT
/begin MEASUREMENT Rte_FaultLog_FaultLog.CTCPassData[53].Byte5_Cnt_u08 "MICROSAR RTE" UBYTE NO_COMPU_METHOD 0 0 0 255 ECU_ADDRESS 0 READ_WRITE /end MEASUREMENT
/begin MEASUREMENT Rte_FaultLog_FaultLog.CTCPassData[53].Byte6_Cnt_u08 "MICROSAR RTE" UBYTE NO_COMPU_METHOD 0 0 0 255 ECU_ADDRESS 0 READ_WRITE /end MEASUREMENT
/begin MEASUREMENT Rte_FaultLog_FaultLog.CTCPassData[53].Reserved1_Cnt_u08 "MICROSAR RTE" UBYTE NO_COMPU_METHOD 0 0 0 255 ECU_ADDRESS 0 READ_WRITE /end MEASUREMENT
/begin MEASUREMENT Rte_FaultLog_FaultLog.CTCPassData[53].Reserved2_Cnt_u08 "MICROSAR RTE" UBYTE NO_COMPU_METHOD 0 0 0 255 ECU_ADDRESS 0 READ_WRITE /end MEASUREMENT
/begin MEASUREMENT Rte_FaultLog_FaultLog.CTCPassData[54].Byte1_Cnt_u08 "MICROSAR RTE" UBYTE NO_COMPU_METHOD 0 0 0 255 ECU_ADDRESS 0 READ_WRITE /end MEASUREMENT
/begin MEASUREMENT Rte_FaultLog_FaultLog.CTCPassData[54].Byte2_Cnt_u08 "MICROSAR RTE" UBYTE NO_COMPU_METHOD 0 0 0 255 ECU_ADDRESS 0 READ_WRITE /end MEASUREMENT
/begin MEASUREMENT Rte_FaultLog_FaultLog.CTCPassData[54].Byte3_Cnt_u08 "MICROSAR RTE" UBYTE NO_COMPU_METHOD 0 0 0 255 ECU_ADDRESS 0 READ_WRITE /end MEASUREMENT
/begin MEASUREMENT Rte_FaultLog_FaultLog.CTCPassData[54].Byte4_Cnt_u08 "MICROSAR RTE" UBYTE NO_COMPU_METHOD 0 0 0 255 ECU_ADDRESS 0 READ_WRITE /end MEASUREMENT
/begin MEASUREMENT Rte_FaultLog_FaultLog.CTCPassData[54].Byte5_Cnt_u08 "MICROSAR RTE" UBYTE NO_COMPU_METHOD 0 0 0 255 ECU_ADDRESS 0 READ_WRITE /end MEASUREMENT
/begin MEASUREMENT Rte_FaultLog_FaultLog.CTCPassData[54].Byte6_Cnt_u08 "MICROSAR RTE" UBYTE NO_COMPU_METHOD 0 0 0 255 ECU_ADDRESS 0 READ_WRITE /end MEASUREMENT
/begin MEASUREMENT Rte_FaultLog_FaultLog.CTCPassData[54].Reserved1_Cnt_u08 "MICROSAR RTE" UBYTE NO_COMPU_METHOD 0 0 0 255 ECU_ADDRESS 0 READ_WRITE /end MEASUREMENT
/begin MEASUREMENT Rte_FaultLog_FaultLog.CTCPassData[54].Reserved2_Cnt_u08 "MICROSAR RTE" UBYTE NO_COMPU_METHOD 0 0 0 255 ECU_ADDRESS 0 READ_WRITE /end MEASUREMENT
/begin MEASUREMENT Rte_FaultLog_FaultLog.CTCPassData[55].Byte1_Cnt_u08 "MICROSAR RTE" UBYTE NO_COMPU_METHOD 0 0 0 255 ECU_ADDRESS 0 READ_WRITE /end MEASUREMENT
/begin MEASUREMENT Rte_FaultLog_FaultLog.CTCPassData[55].Byte2_Cnt_u08 "MICROSAR RTE" UBYTE NO_COMPU_METHOD 0 0 0 255 ECU_ADDRESS 0 READ_WRITE /end MEASUREMENT
/begin MEASUREMENT Rte_FaultLog_FaultLog.CTCPassData[55].Byte3_Cnt_u08 "MICROSAR RTE" UBYTE NO_COMPU_METHOD 0 0 0 255 ECU_ADDRESS 0 READ_WRITE /end MEASUREMENT
/begin MEASUREMENT Rte_FaultLog_FaultLog.CTCPassData[55].Byte4_Cnt_u08 "MICROSAR RTE" UBYTE NO_COMPU_METHOD 0 0 0 255 ECU_ADDRESS 0 READ_WRITE /end MEASUREMENT
/begin MEASUREMENT Rte_FaultLog_FaultLog.CTCPassData[55].Byte5_Cnt_u08 "MICROSAR RTE" UBYTE NO_COMPU_METHOD 0 0 0 255 ECU_ADDRESS 0 READ_WRITE /end MEASUREMENT
/begin MEASUREMENT Rte_FaultLog_FaultLog.CTCPassData[55].Byte6_Cnt_u08 "MICROSAR RTE" UBYTE NO_COMPU_METHOD 0 0 0 255 ECU_ADDRESS 0 READ_WRITE /end MEASUREMENT
/begin MEASUREMENT Rte_FaultLog_FaultLog.CTCPassData[55].Reserved1_Cnt_u08 "MICROSAR RTE" UBYTE NO_COMPU_METHOD 0 0 0 255 ECU_ADDRESS 0 READ_WRITE /end MEASUREMENT
/begin MEASUREMENT Rte_FaultLog_FaultLog.CTCPassData[55].Reserved2_Cnt_u08 "MICROSAR RTE" UBYTE NO_COMPU_METHOD 0 0 0 255 ECU_ADDRESS 0 READ_WRITE /end MEASUREMENT
/begin MEASUREMENT Rte_FaultLog_FaultLog.CTCPassData[56].Byte1_Cnt_u08 "MICROSAR RTE" UBYTE NO_COMPU_METHOD 0 0 0 255 ECU_ADDRESS 0 READ_WRITE /end MEASUREMENT
/begin MEASUREMENT Rte_FaultLog_FaultLog.CTCPassData[56].Byte2_Cnt_u08 "MICROSAR RTE" UBYTE NO_COMPU_METHOD 0 0 0 255 ECU_ADDRESS 0 READ_WRITE /end MEASUREMENT
/begin MEASUREMENT Rte_FaultLog_FaultLog.CTCPassData[56].Byte3_Cnt_u08 "MICROSAR RTE" UBYTE NO_COMPU_METHOD 0 0 0 255 ECU_ADDRESS 0 READ_WRITE /end MEASUREMENT
/begin MEASUREMENT Rte_FaultLog_FaultLog.CTCPassData[56].Byte4_Cnt_u08 "MICROSAR RTE" UBYTE NO_COMPU_METHOD 0 0 0 255 ECU_ADDRESS 0 READ_WRITE /end MEASUREMENT
/begin MEASUREMENT Rte_FaultLog_FaultLog.CTCPassData[56].Byte5_Cnt_u08 "MICROSAR RTE" UBYTE NO_COMPU_METHOD 0 0 0 255 ECU_ADDRESS 0 READ_WRITE /end MEASUREMENT
/begin MEASUREMENT Rte_FaultLog_FaultLog.CTCPassData[56].Byte6_Cnt_u08 "MICROSAR RTE" UBYTE NO_COMPU_METHOD 0 0 0 255 ECU_ADDRESS 0 READ_WRITE /end MEASUREMENT
/begin MEASUREMENT Rte_FaultLog_FaultLog.CTCPassData[56].Reserved1_Cnt_u08 "MICROSAR RTE" UBYTE NO_COMPU_METHOD 0 0 0 255 ECU_ADDRESS 0 READ_WRITE /end MEASUREMENT
/begin MEASUREMENT Rte_FaultLog_FaultLog.CTCPassData[56].Reserved2_Cnt_u08 "MICROSAR RTE" UBYTE NO_COMPU_METHOD 0 0 0 255 ECU_ADDRESS 0 READ_WRITE /end MEASUREMENT
/begin MEASUREMENT Rte_FaultLog_FaultLog.CTCPassData[57].Byte1_Cnt_u08 "MICROSAR RTE" UBYTE NO_COMPU_METHOD 0 0 0 255 ECU_ADDRESS 0 READ_WRITE /end MEASUREMENT
/begin MEASUREMENT Rte_FaultLog_FaultLog.CTCPassData[57].Byte2_Cnt_u08 "MICROSAR RTE" UBYTE NO_COMPU_METHOD 0 0 0 255 ECU_ADDRESS 0 READ_WRITE /end MEASUREMENT
/begin MEASUREMENT Rte_FaultLog_FaultLog.CTCPassData[57].Byte3_Cnt_u08 "MICROSAR RTE" UBYTE NO_COMPU_METHOD 0 0 0 255 ECU_ADDRESS 0 READ_WRITE /end MEASUREMENT
/begin MEASUREMENT Rte_FaultLog_FaultLog.CTCPassData[57].Byte4_Cnt_u08 "MICROSAR RTE" UBYTE NO_COMPU_METHOD 0 0 0 255 ECU_ADDRESS 0 READ_WRITE /end MEASUREMENT
/begin MEASUREMENT Rte_FaultLog_FaultLog.CTCPassData[57].Byte5_Cnt_u08 "MICROSAR RTE" UBYTE NO_COMPU_METHOD 0 0 0 255 ECU_ADDRESS 0 READ_WRITE /end MEASUREMENT
/begin MEASUREMENT Rte_FaultLog_FaultLog.CTCPassData[57].Byte6_Cnt_u08 "MICROSAR RTE" UBYTE NO_COMPU_METHOD 0 0 0 255 ECU_ADDRESS 0 READ_WRITE /end MEASUREMENT
/begin MEASUREMENT Rte_FaultLog_FaultLog.CTCPassData[57].Reserved1_Cnt_u08 "MICROSAR RTE" UBYTE NO_COMPU_METHOD 0 0 0 255 ECU_ADDRESS 0 READ_WRITE /end MEASUREMENT
/begin MEASUREMENT Rte_FaultLog_FaultLog.CTCPassData[57].Reserved2_Cnt_u08 "MICROSAR RTE" UBYTE NO_COMPU_METHOD 0 0 0 255 ECU_ADDRESS 0 READ_WRITE /end MEASUREMENT
/begin MEASUREMENT Rte_FaultLog_FaultLog.CTCPassData[58].Byte1_Cnt_u08 "MICROSAR RTE" UBYTE NO_COMPU_METHOD 0 0 0 255 ECU_ADDRESS 0 READ_WRITE /end MEASUREMENT
/begin MEASUREMENT Rte_FaultLog_FaultLog.CTCPassData[58].Byte2_Cnt_u08 "MICROSAR RTE" UBYTE NO_COMPU_METHOD 0 0 0 255 ECU_ADDRESS 0 READ_WRITE /end MEASUREMENT
/begin MEASUREMENT Rte_FaultLog_FaultLog.CTCPassData[58].Byte3_Cnt_u08 "MICROSAR RTE" UBYTE NO_COMPU_METHOD 0 0 0 255 ECU_ADDRESS 0 READ_WRITE /end MEASUREMENT
/begin MEASUREMENT Rte_FaultLog_FaultLog.CTCPassData[58].Byte4_Cnt_u08 "MICROSAR RTE" UBYTE NO_COMPU_METHOD 0 0 0 255 ECU_ADDRESS 0 READ_WRITE /end MEASUREMENT
/begin MEASUREMENT Rte_FaultLog_FaultLog.CTCPassData[58].Byte5_Cnt_u08 "MICROSAR RTE" UBYTE NO_COMPU_METHOD 0 0 0 255 ECU_ADDRESS 0 READ_WRITE /end MEASUREMENT
/begin MEASUREMENT Rte_FaultLog_FaultLog.CTCPassData[58].Byte6_Cnt_u08 "MICROSAR RTE" UBYTE NO_COMPU_METHOD 0 0 0 255 ECU_ADDRESS 0 READ_WRITE /end MEASUREMENT
/begin MEASUREMENT Rte_FaultLog_FaultLog.CTCPassData[58].Reserved1_Cnt_u08 "MICROSAR RTE" UBYTE NO_COMPU_METHOD 0 0 0 255 ECU_ADDRESS 0 READ_WRITE /end MEASUREMENT
/begin MEASUREMENT Rte_FaultLog_FaultLog.CTCPassData[58].Reserved2_Cnt_u08 "MICROSAR RTE" UBYTE NO_COMPU_METHOD 0 0 0 255 ECU_ADDRESS 0 READ_WRITE /end MEASUREMENT
/begin MEASUREMENT Rte_FaultLog_FaultLog.CTCPassData[59].Byte1_Cnt_u08 "MICROSAR RTE" UBYTE NO_COMPU_METHOD 0 0 0 255 ECU_ADDRESS 0 READ_WRITE /end MEASUREMENT
/begin MEASUREMENT Rte_FaultLog_FaultLog.CTCPassData[59].Byte2_Cnt_u08 "MICROSAR RTE" UBYTE NO_COMPU_METHOD 0 0 0 255 ECU_ADDRESS 0 READ_WRITE /end MEASUREMENT
/begin MEASUREMENT Rte_FaultLog_FaultLog.CTCPassData[59].Byte3_Cnt_u08 "MICROSAR RTE" UBYTE NO_COMPU_METHOD 0 0 0 255 ECU_ADDRESS 0 READ_WRITE /end MEASUREMENT
/begin MEASUREMENT Rte_FaultLog_FaultLog.CTCPassData[59].Byte4_Cnt_u08 "MICROSAR RTE" UBYTE NO_COMPU_METHOD 0 0 0 255 ECU_ADDRESS 0 READ_WRITE /end MEASUREMENT
/begin MEASUREMENT Rte_FaultLog_FaultLog.CTCPassData[59].Byte5_Cnt_u08 "MICROSAR RTE" UBYTE NO_COMPU_METHOD 0 0 0 255 ECU_ADDRESS 0 READ_WRITE /end MEASUREMENT
/begin MEASUREMENT Rte_FaultLog_FaultLog.CTCPassData[59].Byte6_Cnt_u08 "MICROSAR RTE" UBYTE NO_COMPU_METHOD 0 0 0 255 ECU_ADDRESS 0 READ_WRITE /end MEASUREMENT
/begin MEASUREMENT Rte_FaultLog_FaultLog.CTCPassData[59].Reserved1_Cnt_u08 "MICROSAR RTE" UBYTE NO_COMPU_METHOD 0 0 0 255 ECU_ADDRESS 0 READ_WRITE /end MEASUREMENT
/begin MEASUREMENT Rte_FaultLog_FaultLog.CTCPassData[59].Reserved2_Cnt_u08 "MICROSAR RTE" UBYTE NO_COMPU_METHOD 0 0 0 255 ECU_ADDRESS 0 READ_WRITE /end MEASUREMENT
/begin MEASUREMENT Rte_FaultLog_FaultLog.CTCPassData[5].Byte1_Cnt_u08 "MICROSAR RTE" UBYTE NO_COMPU_METHOD 0 0 0 255 ECU_ADDRESS 0 READ_WRITE /end MEASUREMENT
/begin MEASUREMENT Rte_FaultLog_FaultLog.CTCPassData[5].Byte2_Cnt_u08 "MICROSAR RTE" UBYTE NO_COMPU_METHOD 0 0 0 255 ECU_ADDRESS 0 READ_WRITE /end MEASUREMENT
/begin MEASUREMENT Rte_FaultLog_FaultLog.CTCPassData[5].Byte3_Cnt_u08 "MICROSAR RTE" UBYTE NO_COMPU_METHOD 0 0 0 255 ECU_ADDRESS 0 READ_WRITE /end MEASUREMENT
/begin MEASUREMENT Rte_FaultLog_FaultLog.CTCPassData[5].Byte4_Cnt_u08 "MICROSAR RTE" UBYTE NO_COMPU_METHOD 0 0 0 255 ECU_ADDRESS 0 READ_WRITE /end MEASUREMENT
/begin MEASUREMENT Rte_FaultLog_FaultLog.CTCPassData[5].Byte5_Cnt_u08 "MICROSAR RTE" UBYTE NO_COMPU_METHOD 0 0 0 255 ECU_ADDRESS 0 READ_WRITE /end MEASUREMENT
/begin MEASUREMENT Rte_FaultLog_FaultLog.CTCPassData[5].Byte6_Cnt_u08 "MICROSAR RTE" UBYTE NO_COMPU_METHOD 0 0 0 255 ECU_ADDRESS 0 READ_WRITE /end MEASUREMENT
/begin MEASUREMENT Rte_FaultLog_FaultLog.CTCPassData[5].Reserved1_Cnt_u08 "MICROSAR RTE" UBYTE NO_COMPU_METHOD 0 0 0 255 ECU_ADDRESS 0 READ_WRITE /end MEASUREMENT
/begin MEASUREMENT Rte_FaultLog_FaultLog.CTCPassData[5].Reserved2_Cnt_u08 "MICROSAR RTE" UBYTE NO_COMPU_METHOD 0 0 0 255 ECU_ADDRESS 0 READ_WRITE /end MEASUREMENT
/begin MEASUREMENT Rte_FaultLog_FaultLog.CTCPassData[6].Byte1_Cnt_u08 "MICROSAR RTE" UBYTE NO_COMPU_METHOD 0 0 0 255 ECU_ADDRESS 0 READ_WRITE /end MEASUREMENT
/begin MEASUREMENT Rte_FaultLog_FaultLog.CTCPassData[6].Byte2_Cnt_u08 "MICROSAR RTE" UBYTE NO_COMPU_METHOD 0 0 0 255 ECU_ADDRESS 0 READ_WRITE /end MEASUREMENT
/begin MEASUREMENT Rte_FaultLog_FaultLog.CTCPassData[6].Byte3_Cnt_u08 "MICROSAR RTE" UBYTE NO_COMPU_METHOD 0 0 0 255 ECU_ADDRESS 0 READ_WRITE /end MEASUREMENT
/begin MEASUREMENT Rte_FaultLog_FaultLog.CTCPassData[6].Byte4_Cnt_u08 "MICROSAR RTE" UBYTE NO_COMPU_METHOD 0 0 0 255 ECU_ADDRESS 0 READ_WRITE /end MEASUREMENT
/begin MEASUREMENT Rte_FaultLog_FaultLog.CTCPassData[6].Byte5_Cnt_u08 "MICROSAR RTE" UBYTE NO_COMPU_METHOD 0 0 0 255 ECU_ADDRESS 0 READ_WRITE /end MEASUREMENT
/begin MEASUREMENT Rte_FaultLog_FaultLog.CTCPassData[6].Byte6_Cnt_u08 "MICROSAR RTE" UBYTE NO_COMPU_METHOD 0 0 0 255 ECU_ADDRESS 0 READ_WRITE /end MEASUREMENT
/begin MEASUREMENT Rte_FaultLog_FaultLog.CTCPassData[6].Reserved1_Cnt_u08 "MICROSAR RTE" UBYTE NO_COMPU_METHOD 0 0 0 255 ECU_ADDRESS 0 READ_WRITE /end MEASUREMENT
/begin MEASUREMENT Rte_FaultLog_FaultLog.CTCPassData[6].Reserved2_Cnt_u08 "MICROSAR RTE" UBYTE NO_COMPU_METHOD 0 0 0 255 ECU_ADDRESS 0 READ_WRITE /end MEASUREMENT
/begin MEASUREMENT Rte_FaultLog_FaultLog.CTCPassData[7].Byte1_Cnt_u08 "MICROSAR RTE" UBYTE NO_COMPU_METHOD 0 0 0 255 ECU_ADDRESS 0 READ_WRITE /end MEASUREMENT
/begin MEASUREMENT Rte_FaultLog_FaultLog.CTCPassData[7].Byte2_Cnt_u08 "MICROSAR RTE" UBYTE NO_COMPU_METHOD 0 0 0 255 ECU_ADDRESS 0 READ_WRITE /end MEASUREMENT
/begin MEASUREMENT Rte_FaultLog_FaultLog.CTCPassData[7].Byte3_Cnt_u08 "MICROSAR RTE" UBYTE NO_COMPU_METHOD 0 0 0 255 ECU_ADDRESS 0 READ_WRITE /end MEASUREMENT
/begin MEASUREMENT Rte_FaultLog_FaultLog.CTCPassData[7].Byte4_Cnt_u08 "MICROSAR RTE" UBYTE NO_COMPU_METHOD 0 0 0 255 ECU_ADDRESS 0 READ_WRITE /end MEASUREMENT
/begin MEASUREMENT Rte_FaultLog_FaultLog.CTCPassData[7].Byte5_Cnt_u08 "MICROSAR RTE" UBYTE NO_COMPU_METHOD 0 0 0 255 ECU_ADDRESS 0 READ_WRITE /end MEASUREMENT
/begin MEASUREMENT Rte_FaultLog_FaultLog.CTCPassData[7].Byte6_Cnt_u08 "MICROSAR RTE" UBYTE NO_COMPU_METHOD 0 0 0 255 ECU_ADDRESS 0 READ_WRITE /end MEASUREMENT
/begin MEASUREMENT Rte_FaultLog_FaultLog.CTCPassData[7].Reserved1_Cnt_u08 "MICROSAR RTE" UBYTE NO_COMPU_METHOD 0 0 0 255 ECU_ADDRESS 0 READ_WRITE /end MEASUREMENT
/begin MEASUREMENT Rte_FaultLog_FaultLog.CTCPassData[7].Reserved2_Cnt_u08 "MICROSAR RTE" UBYTE NO_COMPU_METHOD 0 0 0 255 ECU_ADDRESS 0 READ_WRITE /end MEASUREMENT
/begin MEASUREMENT Rte_FaultLog_FaultLog.CTCPassData[8].Byte1_Cnt_u08 "MICROSAR RTE" UBYTE NO_COMPU_METHOD 0 0 0 255 ECU_ADDRESS 0 READ_WRITE /end MEASUREMENT
/begin MEASUREMENT Rte_FaultLog_FaultLog.CTCPassData[8].Byte2_Cnt_u08 "MICROSAR RTE" UBYTE NO_COMPU_METHOD 0 0 0 255 ECU_ADDRESS 0 READ_WRITE /end MEASUREMENT
/begin MEASUREMENT Rte_FaultLog_FaultLog.CTCPassData[8].Byte3_Cnt_u08 "MICROSAR RTE" UBYTE NO_COMPU_METHOD 0 0 0 255 ECU_ADDRESS 0 READ_WRITE /end MEASUREMENT
/begin MEASUREMENT Rte_FaultLog_FaultLog.CTCPassData[8].Byte4_Cnt_u08 "MICROSAR RTE" UBYTE NO_COMPU_METHOD 0 0 0 255 ECU_ADDRESS 0 READ_WRITE /end MEASUREMENT
/begin MEASUREMENT Rte_FaultLog_FaultLog.CTCPassData[8].Byte5_Cnt_u08 "MICROSAR RTE" UBYTE NO_COMPU_METHOD 0 0 0 255 ECU_ADDRESS 0 READ_WRITE /end MEASUREMENT
/begin MEASUREMENT Rte_FaultLog_FaultLog.CTCPassData[8].Byte6_Cnt_u08 "MICROSAR RTE" UBYTE NO_COMPU_METHOD 0 0 0 255 ECU_ADDRESS 0 READ_WRITE /end MEASUREMENT
/begin MEASUREMENT Rte_FaultLog_FaultLog.CTCPassData[8].Reserved1_Cnt_u08 "MICROSAR RTE" UBYTE NO_COMPU_METHOD 0 0 0 255 ECU_ADDRESS 0 READ_WRITE /end MEASUREMENT
/begin MEASUREMENT Rte_FaultLog_FaultLog.CTCPassData[8].Reserved2_Cnt_u08 "MICROSAR RTE" UBYTE NO_COMPU_METHOD 0 0 0 255 ECU_ADDRESS 0 READ_WRITE /end MEASUREMENT
/begin MEASUREMENT Rte_FaultLog_FaultLog.CTCPassData[9].Byte1_Cnt_u08 "MICROSAR RTE" UBYTE NO_COMPU_METHOD 0 0 0 255 ECU_ADDRESS 0 READ_WRITE /end MEASUREMENT
/begin MEASUREMENT Rte_FaultLog_FaultLog.CTCPassData[9].Byte2_Cnt_u08 "MICROSAR RTE" UBYTE NO_COMPU_METHOD 0 0 0 255 ECU_ADDRESS 0 READ_WRITE /end MEASUREMENT
/begin MEASUREMENT Rte_FaultLog_FaultLog.CTCPassData[9].Byte3_Cnt_u08 "MICROSAR RTE" UBYTE NO_COMPU_METHOD 0 0 0 255 ECU_ADDRESS 0 READ_WRITE /end MEASUREMENT
/begin MEASUREMENT Rte_FaultLog_FaultLog.CTCPassData[9].Byte4_Cnt_u08 "MICROSAR RTE" UBYTE NO_COMPU_METHOD 0 0 0 255 ECU_ADDRESS 0 READ_WRITE /end MEASUREMENT
/begin MEASUREMENT Rte_FaultLog_FaultLog.CTCPassData[9].Byte5_Cnt_u08 "MICROSAR RTE" UBYTE NO_COMPU_METHOD 0 0 0 255 ECU_ADDRESS 0 READ_WRITE /end MEASUREMENT
/begin MEASUREMENT Rte_FaultLog_FaultLog.CTCPassData[9].Byte6_Cnt_u08 "MICROSAR RTE" UBYTE NO_COMPU_METHOD 0 0 0 255 ECU_ADDRESS 0 READ_WRITE /end MEASUREMENT
/begin MEASUREMENT Rte_FaultLog_FaultLog.CTCPassData[9].Reserved1_Cnt_u08 "MICROSAR RTE" UBYTE NO_COMPU_METHOD 0 0 0 255 ECU_ADDRESS 0 READ_WRITE /end MEASUREMENT
/begin MEASUREMENT Rte_FaultLog_FaultLog.CTCPassData[9].Reserved2_Cnt_u08 "MICROSAR RTE" UBYTE NO_COMPU_METHOD 0 0 0 255 ECU_ADDRESS 0 READ_WRITE /end MEASUREMENT
/begin MEASUREMENT Rte_FaultLog_FaultLog.QueueData[0].QueueEventIdx_Cnt_u08 "MICROSAR RTE" UBYTE NO_COMPU_METHOD 0 0 0 255 ECU_ADDRESS 0 READ_WRITE /end MEASUREMENT
/begin MEASUREMENT Rte_FaultLog_FaultLog.QueueData[0].Status_Cnt_u08 "MICROSAR RTE" UBYTE NO_COMPU_METHOD 0 0 0 255 ECU_ADDRESS 0 READ_WRITE /end MEASUREMENT
/begin MEASUREMENT Rte_FaultLog_FaultLog.QueueData[100].QueueEventIdx_Cnt_u08 "MICROSAR RTE" UBYTE NO_COMPU_METHOD 0 0 0 255 ECU_ADDRESS 0 READ_WRITE /end MEASUREMENT
/begin MEASUREMENT Rte_FaultLog_FaultLog.QueueData[100].Status_Cnt_u08 "MICROSAR RTE" UBYTE NO_COMPU_METHOD 0 0 0 255 ECU_ADDRESS 0 READ_WRITE /end MEASUREMENT
/begin MEASUREMENT Rte_FaultLog_FaultLog.QueueData[101].QueueEventIdx_Cnt_u08 "MICROSAR RTE" UBYTE NO_COMPU_METHOD 0 0 0 255 ECU_ADDRESS 0 READ_WRITE /end MEASUREMENT
/begin MEASUREMENT Rte_FaultLog_FaultLog.QueueData[101].Status_Cnt_u08 "MICROSAR RTE" UBYTE NO_COMPU_METHOD 0 0 0 255 ECU_ADDRESS 0 READ_WRITE /end MEASUREMENT
/begin MEASUREMENT Rte_FaultLog_FaultLog.QueueData[102].QueueEventIdx_Cnt_u08 "MICROSAR RTE" UBYTE NO_COMPU_METHOD 0 0 0 255 ECU_ADDRESS 0 READ_WRITE /end MEASUREMENT
/begin MEASUREMENT Rte_FaultLog_FaultLog.QueueData[102].Status_Cnt_u08 "MICROSAR RTE" UBYTE NO_COMPU_METHOD 0 0 0 255 ECU_ADDRESS 0 READ_WRITE /end MEASUREMENT
/begin MEASUREMENT Rte_FaultLog_FaultLog.QueueData[103].QueueEventIdx_Cnt_u08 "MICROSAR RTE" UBYTE NO_COMPU_METHOD 0 0 0 255 ECU_ADDRESS 0 READ_WRITE /end MEASUREMENT
/begin MEASUREMENT Rte_FaultLog_FaultLog.QueueData[103].Status_Cnt_u08 "MICROSAR RTE" UBYTE NO_COMPU_METHOD 0 0 0 255 ECU_ADDRESS 0 READ_WRITE /end MEASUREMENT
/begin MEASUREMENT Rte_FaultLog_FaultLog.QueueData[104].QueueEventIdx_Cnt_u08 "MICROSAR RTE" UBYTE NO_COMPU_METHOD 0 0 0 255 ECU_ADDRESS 0 READ_WRITE /end MEASUREMENT
/begin MEASUREMENT Rte_FaultLog_FaultLog.QueueData[104].Status_Cnt_u08 "MICROSAR RTE" UBYTE NO_COMPU_METHOD 0 0 0 255 ECU_ADDRESS 0 READ_WRITE /end MEASUREMENT
/begin MEASUREMENT Rte_FaultLog_FaultLog.QueueData[105].QueueEventIdx_Cnt_u08 "MICROSAR RTE" UBYTE NO_COMPU_METHOD 0 0 0 255 ECU_ADDRESS 0 READ_WRITE /end MEASUREMENT
/begin MEASUREMENT Rte_FaultLog_FaultLog.QueueData[105].Status_Cnt_u08 "MICROSAR RTE" UBYTE NO_COMPU_METHOD 0 0 0 255 ECU_ADDRESS 0 READ_WRITE /end MEASUREMENT
/begin MEASUREMENT Rte_FaultLog_FaultLog.QueueData[106].QueueEventIdx_Cnt_u08 "MICROSAR RTE" UBYTE NO_COMPU_METHOD 0 0 0 255 ECU_ADDRESS 0 READ_WRITE /end MEASUREMENT
/begin MEASUREMENT Rte_FaultLog_FaultLog.QueueData[106].Status_Cnt_u08 "MICROSAR RTE" UBYTE NO_COMPU_METHOD 0 0 0 255 ECU_ADDRESS 0 READ_WRITE /end MEASUREMENT
/begin MEASUREMENT Rte_FaultLog_FaultLog.QueueData[107].QueueEventIdx_Cnt_u08 "MICROSAR RTE" UBYTE NO_COMPU_METHOD 0 0 0 255 ECU_ADDRESS 0 READ_WRITE /end MEASUREMENT
/begin MEASUREMENT Rte_FaultLog_FaultLog.QueueData[107].Status_Cnt_u08 "MICROSAR RTE" UBYTE NO_COMPU_METHOD 0 0 0 255 ECU_ADDRESS 0 READ_WRITE /end MEASUREMENT
/begin MEASUREMENT Rte_FaultLog_FaultLog.QueueData[108].QueueEventIdx_Cnt_u08 "MICROSAR RTE" UBYTE NO_COMPU_METHOD 0 0 0 255 ECU_ADDRESS 0 READ_WRITE /end MEASUREMENT
/begin MEASUREMENT Rte_FaultLog_FaultLog.QueueData[108].Status_Cnt_u08 "MICROSAR RTE" UBYTE NO_COMPU_METHOD 0 0 0 255 ECU_ADDRESS 0 READ_WRITE /end MEASUREMENT
/begin MEASUREMENT Rte_FaultLog_FaultLog.QueueData[109].QueueEventIdx_Cnt_u08 "MICROSAR RTE" UBYTE NO_COMPU_METHOD 0 0 0 255 ECU_ADDRESS 0 READ_WRITE /end MEASUREMENT
/begin MEASUREMENT Rte_FaultLog_FaultLog.QueueData[109].Status_Cnt_u08 "MICROSAR RTE" UBYTE NO_COMPU_METHOD 0 0 0 255 ECU_ADDRESS 0 READ_WRITE /end MEASUREMENT
/begin MEASUREMENT Rte_FaultLog_FaultLog.QueueData[10].QueueEventIdx_Cnt_u08 "MICROSAR RTE" UBYTE NO_COMPU_METHOD 0 0 0 255 ECU_ADDRESS 0 READ_WRITE /end MEASUREMENT
/begin MEASUREMENT Rte_FaultLog_FaultLog.QueueData[10].Status_Cnt_u08 "MICROSAR RTE" UBYTE NO_COMPU_METHOD 0 0 0 255 ECU_ADDRESS 0 READ_WRITE /end MEASUREMENT
/begin MEASUREMENT Rte_FaultLog_FaultLog.QueueData[110].QueueEventIdx_Cnt_u08 "MICROSAR RTE" UBYTE NO_COMPU_METHOD 0 0 0 255 ECU_ADDRESS 0 READ_WRITE /end MEASUREMENT
/begin MEASUREMENT Rte_FaultLog_FaultLog.QueueData[110].Status_Cnt_u08 "MICROSAR RTE" UBYTE NO_COMPU_METHOD 0 0 0 255 ECU_ADDRESS 0 READ_WRITE /end MEASUREMENT
/begin MEASUREMENT Rte_FaultLog_FaultLog.QueueData[111].QueueEventIdx_Cnt_u08 "MICROSAR RTE" UBYTE NO_COMPU_METHOD 0 0 0 255 ECU_ADDRESS 0 READ_WRITE /end MEASUREMENT
/begin MEASUREMENT Rte_FaultLog_FaultLog.QueueData[111].Status_Cnt_u08 "MICROSAR RTE" UBYTE NO_COMPU_METHOD 0 0 0 255 ECU_ADDRESS 0 READ_WRITE /end MEASUREMENT
/begin MEASUREMENT Rte_FaultLog_FaultLog.QueueData[112].QueueEventIdx_Cnt_u08 "MICROSAR RTE" UBYTE NO_COMPU_METHOD 0 0 0 255 ECU_ADDRESS 0 READ_WRITE /end MEASUREMENT
/begin MEASUREMENT Rte_FaultLog_FaultLog.QueueData[112].Status_Cnt_u08 "MICROSAR RTE" UBYTE NO_COMPU_METHOD 0 0 0 255 ECU_ADDRESS 0 READ_WRITE /end MEASUREMENT
/begin MEASUREMENT Rte_FaultLog_FaultLog.QueueData[113].QueueEventIdx_Cnt_u08 "MICROSAR RTE" UBYTE NO_COMPU_METHOD 0 0 0 255 ECU_ADDRESS 0 READ_WRITE /end MEASUREMENT
/begin MEASUREMENT Rte_FaultLog_FaultLog.QueueData[113].Status_Cnt_u08 "MICROSAR RTE" UBYTE NO_COMPU_METHOD 0 0 0 255 ECU_ADDRESS 0 READ_WRITE /end MEASUREMENT
/begin MEASUREMENT Rte_FaultLog_FaultLog.QueueData[114].QueueEventIdx_Cnt_u08 "MICROSAR RTE" UBYTE NO_COMPU_METHOD 0 0 0 255 ECU_ADDRESS 0 READ_WRITE /end MEASUREMENT
/begin MEASUREMENT Rte_FaultLog_FaultLog.QueueData[114].Status_Cnt_u08 "MICROSAR RTE" UBYTE NO_COMPU_METHOD 0 0 0 255 ECU_ADDRESS 0 READ_WRITE /end MEASUREMENT
/begin MEASUREMENT Rte_FaultLog_FaultLog.QueueData[115].QueueEventIdx_Cnt_u08 "MICROSAR RTE" UBYTE NO_COMPU_METHOD 0 0 0 255 ECU_ADDRESS 0 READ_WRITE /end MEASUREMENT
/begin MEASUREMENT Rte_FaultLog_FaultLog.QueueData[115].Status_Cnt_u08 "MICROSAR RTE" UBYTE NO_COMPU_METHOD 0 0 0 255 ECU_ADDRESS 0 READ_WRITE /end MEASUREMENT
/begin MEASUREMENT Rte_FaultLog_FaultLog.QueueData[116].QueueEventIdx_Cnt_u08 "MICROSAR RTE" UBYTE NO_COMPU_METHOD 0 0 0 255 ECU_ADDRESS 0 READ_WRITE /end MEASUREMENT
/begin MEASUREMENT Rte_FaultLog_FaultLog.QueueData[116].Status_Cnt_u08 "MICROSAR RTE" UBYTE NO_COMPU_METHOD 0 0 0 255 ECU_ADDRESS 0 READ_WRITE /end MEASUREMENT
/begin MEASUREMENT Rte_FaultLog_FaultLog.QueueData[117].QueueEventIdx_Cnt_u08 "MICROSAR RTE" UBYTE NO_COMPU_METHOD 0 0 0 255 ECU_ADDRESS 0 READ_WRITE /end MEASUREMENT
/begin MEASUREMENT Rte_FaultLog_FaultLog.QueueData[117].Status_Cnt_u08 "MICROSAR RTE" UBYTE NO_COMPU_METHOD 0 0 0 255 ECU_ADDRESS 0 READ_WRITE /end MEASUREMENT
/begin MEASUREMENT Rte_FaultLog_FaultLog.QueueData[118].QueueEventIdx_Cnt_u08 "MICROSAR RTE" UBYTE NO_COMPU_METHOD 0 0 0 255 ECU_ADDRESS 0 READ_WRITE /end MEASUREMENT
/begin MEASUREMENT Rte_FaultLog_FaultLog.QueueData[118].Status_Cnt_u08 "MICROSAR RTE" UBYTE NO_COMPU_METHOD 0 0 0 255 ECU_ADDRESS 0 READ_WRITE /end MEASUREMENT
/begin MEASUREMENT Rte_FaultLog_FaultLog.QueueData[119].QueueEventIdx_Cnt_u08 "MICROSAR RTE" UBYTE NO_COMPU_METHOD 0 0 0 255 ECU_ADDRESS 0 READ_WRITE /end MEASUREMENT
/begin MEASUREMENT Rte_FaultLog_FaultLog.QueueData[119].Status_Cnt_u08 "MICROSAR RTE" UBYTE NO_COMPU_METHOD 0 0 0 255 ECU_ADDRESS 0 READ_WRITE /end MEASUREMENT
/begin MEASUREMENT Rte_FaultLog_FaultLog.QueueData[11].QueueEventIdx_Cnt_u08 "MICROSAR RTE" UBYTE NO_COMPU_METHOD 0 0 0 255 ECU_ADDRESS 0 READ_WRITE /end MEASUREMENT
/begin MEASUREMENT Rte_FaultLog_FaultLog.QueueData[11].Status_Cnt_u08 "MICROSAR RTE" UBYTE NO_COMPU_METHOD 0 0 0 255 ECU_ADDRESS 0 READ_WRITE /end MEASUREMENT
/begin MEASUREMENT Rte_FaultLog_FaultLog.QueueData[12].QueueEventIdx_Cnt_u08 "MICROSAR RTE" UBYTE NO_COMPU_METHOD 0 0 0 255 ECU_ADDRESS 0 READ_WRITE /end MEASUREMENT
/begin MEASUREMENT Rte_FaultLog_FaultLog.QueueData[12].Status_Cnt_u08 "MICROSAR RTE" UBYTE NO_COMPU_METHOD 0 0 0 255 ECU_ADDRESS 0 READ_WRITE /end MEASUREMENT
/begin MEASUREMENT Rte_FaultLog_FaultLog.QueueData[13].QueueEventIdx_Cnt_u08 "MICROSAR RTE" UBYTE NO_COMPU_METHOD 0 0 0 255 ECU_ADDRESS 0 READ_WRITE /end MEASUREMENT
/begin MEASUREMENT Rte_FaultLog_FaultLog.QueueData[13].Status_Cnt_u08 "MICROSAR RTE" UBYTE NO_COMPU_METHOD 0 0 0 255 ECU_ADDRESS 0 READ_WRITE /end MEASUREMENT
/begin MEASUREMENT Rte_FaultLog_FaultLog.QueueData[14].QueueEventIdx_Cnt_u08 "MICROSAR RTE" UBYTE NO_COMPU_METHOD 0 0 0 255 ECU_ADDRESS 0 READ_WRITE /end MEASUREMENT
/begin MEASUREMENT Rte_FaultLog_FaultLog.QueueData[14].Status_Cnt_u08 "MICROSAR RTE" UBYTE NO_COMPU_METHOD 0 0 0 255 ECU_ADDRESS 0 READ_WRITE /end MEASUREMENT
/begin MEASUREMENT Rte_FaultLog_FaultLog.QueueData[15].QueueEventIdx_Cnt_u08 "MICROSAR RTE" UBYTE NO_COMPU_METHOD 0 0 0 255 ECU_ADDRESS 0 READ_WRITE /end MEASUREMENT
/begin MEASUREMENT Rte_FaultLog_FaultLog.QueueData[15].Status_Cnt_u08 "MICROSAR RTE" UBYTE NO_COMPU_METHOD 0 0 0 255 ECU_ADDRESS 0 READ_WRITE /end MEASUREMENT
/begin MEASUREMENT Rte_FaultLog_FaultLog.QueueData[16].QueueEventIdx_Cnt_u08 "MICROSAR RTE" UBYTE NO_COMPU_METHOD 0 0 0 255 ECU_ADDRESS 0 READ_WRITE /end MEASUREMENT
/begin MEASUREMENT Rte_FaultLog_FaultLog.QueueData[16].Status_Cnt_u08 "MICROSAR RTE" UBYTE NO_COMPU_METHOD 0 0 0 255 ECU_ADDRESS 0 READ_WRITE /end MEASUREMENT
/begin MEASUREMENT Rte_FaultLog_FaultLog.QueueData[17].QueueEventIdx_Cnt_u08 "MICROSAR RTE" UBYTE NO_COMPU_METHOD 0 0 0 255 ECU_ADDRESS 0 READ_WRITE /end MEASUREMENT
/begin MEASUREMENT Rte_FaultLog_FaultLog.QueueData[17].Status_Cnt_u08 "MICROSAR RTE" UBYTE NO_COMPU_METHOD 0 0 0 255 ECU_ADDRESS 0 READ_WRITE /end MEASUREMENT
/begin MEASUREMENT Rte_FaultLog_FaultLog.QueueData[18].QueueEventIdx_Cnt_u08 "MICROSAR RTE" UBYTE NO_COMPU_METHOD 0 0 0 255 ECU_ADDRESS 0 READ_WRITE /end MEASUREMENT
/begin MEASUREMENT Rte_FaultLog_FaultLog.QueueData[18].Status_Cnt_u08 "MICROSAR RTE" UBYTE NO_COMPU_METHOD 0 0 0 255 ECU_ADDRESS 0 READ_WRITE /end MEASUREMENT
/begin MEASUREMENT Rte_FaultLog_FaultLog.QueueData[19].QueueEventIdx_Cnt_u08 "MICROSAR RTE" UBYTE NO_COMPU_METHOD 0 0 0 255 ECU_ADDRESS 0 READ_WRITE /end MEASUREMENT
/begin MEASUREMENT Rte_FaultLog_FaultLog.QueueData[19].Status_Cnt_u08 "MICROSAR RTE" UBYTE NO_COMPU_METHOD 0 0 0 255 ECU_ADDRESS 0 READ_WRITE /end MEASUREMENT
/begin MEASUREMENT Rte_FaultLog_FaultLog.QueueData[1].QueueEventIdx_Cnt_u08 "MICROSAR RTE" UBYTE NO_COMPU_METHOD 0 0 0 255 ECU_ADDRESS 0 READ_WRITE /end MEASUREMENT
/begin MEASUREMENT Rte_FaultLog_FaultLog.QueueData[1].Status_Cnt_u08 "MICROSAR RTE" UBYTE NO_COMPU_METHOD 0 0 0 255 ECU_ADDRESS 0 READ_WRITE /end MEASUREMENT
/begin MEASUREMENT Rte_FaultLog_FaultLog.QueueData[20].QueueEventIdx_Cnt_u08 "MICROSAR RTE" UBYTE NO_COMPU_METHOD 0 0 0 255 ECU_ADDRESS 0 READ_WRITE /end MEASUREMENT
/begin MEASUREMENT Rte_FaultLog_FaultLog.QueueData[20].Status_Cnt_u08 "MICROSAR RTE" UBYTE NO_COMPU_METHOD 0 0 0 255 ECU_ADDRESS 0 READ_WRITE /end MEASUREMENT
/begin MEASUREMENT Rte_FaultLog_FaultLog.QueueData[21].QueueEventIdx_Cnt_u08 "MICROSAR RTE" UBYTE NO_COMPU_METHOD 0 0 0 255 ECU_ADDRESS 0 READ_WRITE /end MEASUREMENT
/begin MEASUREMENT Rte_FaultLog_FaultLog.QueueData[21].Status_Cnt_u08 "MICROSAR RTE" UBYTE NO_COMPU_METHOD 0 0 0 255 ECU_ADDRESS 0 READ_WRITE /end MEASUREMENT
/begin MEASUREMENT Rte_FaultLog_FaultLog.QueueData[22].QueueEventIdx_Cnt_u08 "MICROSAR RTE" UBYTE NO_COMPU_METHOD 0 0 0 255 ECU_ADDRESS 0 READ_WRITE /end MEASUREMENT
/begin MEASUREMENT Rte_FaultLog_FaultLog.QueueData[22].Status_Cnt_u08 "MICROSAR RTE" UBYTE NO_COMPU_METHOD 0 0 0 255 ECU_ADDRESS 0 READ_WRITE /end MEASUREMENT
/begin MEASUREMENT Rte_FaultLog_FaultLog.QueueData[23].QueueEventIdx_Cnt_u08 "MICROSAR RTE" UBYTE NO_COMPU_METHOD 0 0 0 255 ECU_ADDRESS 0 READ_WRITE /end MEASUREMENT
/begin MEASUREMENT Rte_FaultLog_FaultLog.QueueData[23].Status_Cnt_u08 "MICROSAR RTE" UBYTE NO_COMPU_METHOD 0 0 0 255 ECU_ADDRESS 0 READ_WRITE /end MEASUREMENT
/begin MEASUREMENT Rte_FaultLog_FaultLog.QueueData[24].QueueEventIdx_Cnt_u08 "MICROSAR RTE" UBYTE NO_COMPU_METHOD 0 0 0 255 ECU_ADDRESS 0 READ_WRITE /end MEASUREMENT
/begin MEASUREMENT Rte_FaultLog_FaultLog.QueueData[24].Status_Cnt_u08 "MICROSAR RTE" UBYTE NO_COMPU_METHOD 0 0 0 255 ECU_ADDRESS 0 READ_WRITE /end MEASUREMENT
/begin MEASUREMENT Rte_FaultLog_FaultLog.QueueData[25].QueueEventIdx_Cnt_u08 "MICROSAR RTE" UBYTE NO_COMPU_METHOD 0 0 0 255 ECU_ADDRESS 0 READ_WRITE /end MEASUREMENT
/begin MEASUREMENT Rte_FaultLog_FaultLog.QueueData[25].Status_Cnt_u08 "MICROSAR RTE" UBYTE NO_COMPU_METHOD 0 0 0 255 ECU_ADDRESS 0 READ_WRITE /end MEASUREMENT
/begin MEASUREMENT Rte_FaultLog_FaultLog.QueueData[26].QueueEventIdx_Cnt_u08 "MICROSAR RTE" UBYTE NO_COMPU_METHOD 0 0 0 255 ECU_ADDRESS 0 READ_WRITE /end MEASUREMENT
/begin MEASUREMENT Rte_FaultLog_FaultLog.QueueData[26].Status_Cnt_u08 "MICROSAR RTE" UBYTE NO_COMPU_METHOD 0 0 0 255 ECU_ADDRESS 0 READ_WRITE /end MEASUREMENT
/begin MEASUREMENT Rte_FaultLog_FaultLog.QueueData[27].QueueEventIdx_Cnt_u08 "MICROSAR RTE" UBYTE NO_COMPU_METHOD 0 0 0 255 ECU_ADDRESS 0 READ_WRITE /end MEASUREMENT
/begin MEASUREMENT Rte_FaultLog_FaultLog.QueueData[27].Status_Cnt_u08 "MICROSAR RTE" UBYTE NO_COMPU_METHOD 0 0 0 255 ECU_ADDRESS 0 READ_WRITE /end MEASUREMENT
/begin MEASUREMENT Rte_FaultLog_FaultLog.QueueData[28].QueueEventIdx_Cnt_u08 "MICROSAR RTE" UBYTE NO_COMPU_METHOD 0 0 0 255 ECU_ADDRESS 0 READ_WRITE /end MEASUREMENT
/begin MEASUREMENT Rte_FaultLog_FaultLog.QueueData[28].Status_Cnt_u08 "MICROSAR RTE" UBYTE NO_COMPU_METHOD 0 0 0 255 ECU_ADDRESS 0 READ_WRITE /end MEASUREMENT
/begin MEASUREMENT Rte_FaultLog_FaultLog.QueueData[29].QueueEventIdx_Cnt_u08 "MICROSAR RTE" UBYTE NO_COMPU_METHOD 0 0 0 255 ECU_ADDRESS 0 READ_WRITE /end MEASUREMENT
/begin MEASUREMENT Rte_FaultLog_FaultLog.QueueData[29].Status_Cnt_u08 "MICROSAR RTE" UBYTE NO_COMPU_METHOD 0 0 0 255 ECU_ADDRESS 0 READ_WRITE /end MEASUREMENT
/begin MEASUREMENT Rte_FaultLog_FaultLog.QueueData[2].QueueEventIdx_Cnt_u08 "MICROSAR RTE" UBYTE NO_COMPU_METHOD 0 0 0 255 ECU_ADDRESS 0 READ_WRITE /end MEASUREMENT
/begin MEASUREMENT Rte_FaultLog_FaultLog.QueueData[2].Status_Cnt_u08 "MICROSAR RTE" UBYTE NO_COMPU_METHOD 0 0 0 255 ECU_ADDRESS 0 READ_WRITE /end MEASUREMENT
/begin MEASUREMENT Rte_FaultLog_FaultLog.QueueData[30].QueueEventIdx_Cnt_u08 "MICROSAR RTE" UBYTE NO_COMPU_METHOD 0 0 0 255 ECU_ADDRESS 0 READ_WRITE /end MEASUREMENT
/begin MEASUREMENT Rte_FaultLog_FaultLog.QueueData[30].Status_Cnt_u08 "MICROSAR RTE" UBYTE NO_COMPU_METHOD 0 0 0 255 ECU_ADDRESS 0 READ_WRITE /end MEASUREMENT
/begin MEASUREMENT Rte_FaultLog_FaultLog.QueueData[31].QueueEventIdx_Cnt_u08 "MICROSAR RTE" UBYTE NO_COMPU_METHOD 0 0 0 255 ECU_ADDRESS 0 READ_WRITE /end MEASUREMENT
/begin MEASUREMENT Rte_FaultLog_FaultLog.QueueData[31].Status_Cnt_u08 "MICROSAR RTE" UBYTE NO_COMPU_METHOD 0 0 0 255 ECU_ADDRESS 0 READ_WRITE /end MEASUREMENT
/begin MEASUREMENT Rte_FaultLog_FaultLog.QueueData[32].QueueEventIdx_Cnt_u08 "MICROSAR RTE" UBYTE NO_COMPU_METHOD 0 0 0 255 ECU_ADDRESS 0 READ_WRITE /end MEASUREMENT
/begin MEASUREMENT Rte_FaultLog_FaultLog.QueueData[32].Status_Cnt_u08 "MICROSAR RTE" UBYTE NO_COMPU_METHOD 0 0 0 255 ECU_ADDRESS 0 READ_WRITE /end MEASUREMENT
/begin MEASUREMENT Rte_FaultLog_FaultLog.QueueData[33].QueueEventIdx_Cnt_u08 "MICROSAR RTE" UBYTE NO_COMPU_METHOD 0 0 0 255 ECU_ADDRESS 0 READ_WRITE /end MEASUREMENT
/begin MEASUREMENT Rte_FaultLog_FaultLog.QueueData[33].Status_Cnt_u08 "MICROSAR RTE" UBYTE NO_COMPU_METHOD 0 0 0 255 ECU_ADDRESS 0 READ_WRITE /end MEASUREMENT
/begin MEASUREMENT Rte_FaultLog_FaultLog.QueueData[34].QueueEventIdx_Cnt_u08 "MICROSAR RTE" UBYTE NO_COMPU_METHOD 0 0 0 255 ECU_ADDRESS 0 READ_WRITE /end MEASUREMENT
/begin MEASUREMENT Rte_FaultLog_FaultLog.QueueData[34].Status_Cnt_u08 "MICROSAR RTE" UBYTE NO_COMPU_METHOD 0 0 0 255 ECU_ADDRESS 0 READ_WRITE /end MEASUREMENT
/begin MEASUREMENT Rte_FaultLog_FaultLog.QueueData[35].QueueEventIdx_Cnt_u08 "MICROSAR RTE" UBYTE NO_COMPU_METHOD 0 0 0 255 ECU_ADDRESS 0 READ_WRITE /end MEASUREMENT
/begin MEASUREMENT Rte_FaultLog_FaultLog.QueueData[35].Status_Cnt_u08 "MICROSAR RTE" UBYTE NO_COMPU_METHOD 0 0 0 255 ECU_ADDRESS 0 READ_WRITE /end MEASUREMENT
/begin MEASUREMENT Rte_FaultLog_FaultLog.QueueData[36].QueueEventIdx_Cnt_u08 "MICROSAR RTE" UBYTE NO_COMPU_METHOD 0 0 0 255 ECU_ADDRESS 0 READ_WRITE /end MEASUREMENT
/begin MEASUREMENT Rte_FaultLog_FaultLog.QueueData[36].Status_Cnt_u08 "MICROSAR RTE" UBYTE NO_COMPU_METHOD 0 0 0 255 ECU_ADDRESS 0 READ_WRITE /end MEASUREMENT
/begin MEASUREMENT Rte_FaultLog_FaultLog.QueueData[37].QueueEventIdx_Cnt_u08 "MICROSAR RTE" UBYTE NO_COMPU_METHOD 0 0 0 255 ECU_ADDRESS 0 READ_WRITE /end MEASUREMENT
/begin MEASUREMENT Rte_FaultLog_FaultLog.QueueData[37].Status_Cnt_u08 "MICROSAR RTE" UBYTE NO_COMPU_METHOD 0 0 0 255 ECU_ADDRESS 0 READ_WRITE /end MEASUREMENT
/begin MEASUREMENT Rte_FaultLog_FaultLog.QueueData[38].QueueEventIdx_Cnt_u08 "MICROSAR RTE" UBYTE NO_COMPU_METHOD 0 0 0 255 ECU_ADDRESS 0 READ_WRITE /end MEASUREMENT
/begin MEASUREMENT Rte_FaultLog_FaultLog.QueueData[38].Status_Cnt_u08 "MICROSAR RTE" UBYTE NO_COMPU_METHOD 0 0 0 255 ECU_ADDRESS 0 READ_WRITE /end MEASUREMENT
/begin MEASUREMENT Rte_FaultLog_FaultLog.QueueData[39].QueueEventIdx_Cnt_u08 "MICROSAR RTE" UBYTE NO_COMPU_METHOD 0 0 0 255 ECU_ADDRESS 0 READ_WRITE /end MEASUREMENT
/begin MEASUREMENT Rte_FaultLog_FaultLog.QueueData[39].Status_Cnt_u08 "MICROSAR RTE" UBYTE NO_COMPU_METHOD 0 0 0 255 ECU_ADDRESS 0 READ_WRITE /end MEASUREMENT
/begin MEASUREMENT Rte_FaultLog_FaultLog.QueueData[3].QueueEventIdx_Cnt_u08 "MICROSAR RTE" UBYTE NO_COMPU_METHOD 0 0 0 255 ECU_ADDRESS 0 READ_WRITE /end MEASUREMENT
/begin MEASUREMENT Rte_FaultLog_FaultLog.QueueData[3].Status_Cnt_u08 "MICROSAR RTE" UBYTE NO_COMPU_METHOD 0 0 0 255 ECU_ADDRESS 0 READ_WRITE /end MEASUREMENT
/begin MEASUREMENT Rte_FaultLog_FaultLog.QueueData[40].QueueEventIdx_Cnt_u08 "MICROSAR RTE" UBYTE NO_COMPU_METHOD 0 0 0 255 ECU_ADDRESS 0 READ_WRITE /end MEASUREMENT
/begin MEASUREMENT Rte_FaultLog_FaultLog.QueueData[40].Status_Cnt_u08 "MICROSAR RTE" UBYTE NO_COMPU_METHOD 0 0 0 255 ECU_ADDRESS 0 READ_WRITE /end MEASUREMENT
/begin MEASUREMENT Rte_FaultLog_FaultLog.QueueData[41].QueueEventIdx_Cnt_u08 "MICROSAR RTE" UBYTE NO_COMPU_METHOD 0 0 0 255 ECU_ADDRESS 0 READ_WRITE /end MEASUREMENT
/begin MEASUREMENT Rte_FaultLog_FaultLog.QueueData[41].Status_Cnt_u08 "MICROSAR RTE" UBYTE NO_COMPU_METHOD 0 0 0 255 ECU_ADDRESS 0 READ_WRITE /end MEASUREMENT
/begin MEASUREMENT Rte_FaultLog_FaultLog.QueueData[42].QueueEventIdx_Cnt_u08 "MICROSAR RTE" UBYTE NO_COMPU_METHOD 0 0 0 255 ECU_ADDRESS 0 READ_WRITE /end MEASUREMENT
/begin MEASUREMENT Rte_FaultLog_FaultLog.QueueData[42].Status_Cnt_u08 "MICROSAR RTE" UBYTE NO_COMPU_METHOD 0 0 0 255 ECU_ADDRESS 0 READ_WRITE /end MEASUREMENT
/begin MEASUREMENT Rte_FaultLog_FaultLog.QueueData[43].QueueEventIdx_Cnt_u08 "MICROSAR RTE" UBYTE NO_COMPU_METHOD 0 0 0 255 ECU_ADDRESS 0 READ_WRITE /end MEASUREMENT
/begin MEASUREMENT Rte_FaultLog_FaultLog.QueueData[43].Status_Cnt_u08 "MICROSAR RTE" UBYTE NO_COMPU_METHOD 0 0 0 255 ECU_ADDRESS 0 READ_WRITE /end MEASUREMENT
/begin MEASUREMENT Rte_FaultLog_FaultLog.QueueData[44].QueueEventIdx_Cnt_u08 "MICROSAR RTE" UBYTE NO_COMPU_METHOD 0 0 0 255 ECU_ADDRESS 0 READ_WRITE /end MEASUREMENT
/begin MEASUREMENT Rte_FaultLog_FaultLog.QueueData[44].Status_Cnt_u08 "MICROSAR RTE" UBYTE NO_COMPU_METHOD 0 0 0 255 ECU_ADDRESS 0 READ_WRITE /end MEASUREMENT
/begin MEASUREMENT Rte_FaultLog_FaultLog.QueueData[45].QueueEventIdx_Cnt_u08 "MICROSAR RTE" UBYTE NO_COMPU_METHOD 0 0 0 255 ECU_ADDRESS 0 READ_WRITE /end MEASUREMENT
/begin MEASUREMENT Rte_FaultLog_FaultLog.QueueData[45].Status_Cnt_u08 "MICROSAR RTE" UBYTE NO_COMPU_METHOD 0 0 0 255 ECU_ADDRESS 0 READ_WRITE /end MEASUREMENT
/begin MEASUREMENT Rte_FaultLog_FaultLog.QueueData[46].QueueEventIdx_Cnt_u08 "MICROSAR RTE" UBYTE NO_COMPU_METHOD 0 0 0 255 ECU_ADDRESS 0 READ_WRITE /end MEASUREMENT
/begin MEASUREMENT Rte_FaultLog_FaultLog.QueueData[46].Status_Cnt_u08 "MICROSAR RTE" UBYTE NO_COMPU_METHOD 0 0 0 255 ECU_ADDRESS 0 READ_WRITE /end MEASUREMENT
/begin MEASUREMENT Rte_FaultLog_FaultLog.QueueData[47].QueueEventIdx_Cnt_u08 "MICROSAR RTE" UBYTE NO_COMPU_METHOD 0 0 0 255 ECU_ADDRESS 0 READ_WRITE /end MEASUREMENT
/begin MEASUREMENT Rte_FaultLog_FaultLog.QueueData[47].Status_Cnt_u08 "MICROSAR RTE" UBYTE NO_COMPU_METHOD 0 0 0 255 ECU_ADDRESS 0 READ_WRITE /end MEASUREMENT
/begin MEASUREMENT Rte_FaultLog_FaultLog.QueueData[48].QueueEventIdx_Cnt_u08 "MICROSAR RTE" UBYTE NO_COMPU_METHOD 0 0 0 255 ECU_ADDRESS 0 READ_WRITE /end MEASUREMENT
/begin MEASUREMENT Rte_FaultLog_FaultLog.QueueData[48].Status_Cnt_u08 "MICROSAR RTE" UBYTE NO_COMPU_METHOD 0 0 0 255 ECU_ADDRESS 0 READ_WRITE /end MEASUREMENT
/begin MEASUREMENT Rte_FaultLog_FaultLog.QueueData[49].QueueEventIdx_Cnt_u08 "MICROSAR RTE" UBYTE NO_COMPU_METHOD 0 0 0 255 ECU_ADDRESS 0 READ_WRITE /end MEASUREMENT
/begin MEASUREMENT Rte_FaultLog_FaultLog.QueueData[49].Status_Cnt_u08 "MICROSAR RTE" UBYTE NO_COMPU_METHOD 0 0 0 255 ECU_ADDRESS 0 READ_WRITE /end MEASUREMENT
/begin MEASUREMENT Rte_FaultLog_FaultLog.QueueData[4].QueueEventIdx_Cnt_u08 "MICROSAR RTE" UBYTE NO_COMPU_METHOD 0 0 0 255 ECU_ADDRESS 0 READ_WRITE /end MEASUREMENT
/begin MEASUREMENT Rte_FaultLog_FaultLog.QueueData[4].Status_Cnt_u08 "MICROSAR RTE" UBYTE NO_COMPU_METHOD 0 0 0 255 ECU_ADDRESS 0 READ_WRITE /end MEASUREMENT
/begin MEASUREMENT Rte_FaultLog_FaultLog.QueueData[50].QueueEventIdx_Cnt_u08 "MICROSAR RTE" UBYTE NO_COMPU_METHOD 0 0 0 255 ECU_ADDRESS 0 READ_WRITE /end MEASUREMENT
/begin MEASUREMENT Rte_FaultLog_FaultLog.QueueData[50].Status_Cnt_u08 "MICROSAR RTE" UBYTE NO_COMPU_METHOD 0 0 0 255 ECU_ADDRESS 0 READ_WRITE /end MEASUREMENT
/begin MEASUREMENT Rte_FaultLog_FaultLog.QueueData[51].QueueEventIdx_Cnt_u08 "MICROSAR RTE" UBYTE NO_COMPU_METHOD 0 0 0 255 ECU_ADDRESS 0 READ_WRITE /end MEASUREMENT
/begin MEASUREMENT Rte_FaultLog_FaultLog.QueueData[51].Status_Cnt_u08 "MICROSAR RTE" UBYTE NO_COMPU_METHOD 0 0 0 255 ECU_ADDRESS 0 READ_WRITE /end MEASUREMENT
/begin MEASUREMENT Rte_FaultLog_FaultLog.QueueData[52].QueueEventIdx_Cnt_u08 "MICROSAR RTE" UBYTE NO_COMPU_METHOD 0 0 0 255 ECU_ADDRESS 0 READ_WRITE /end MEASUREMENT
/begin MEASUREMENT Rte_FaultLog_FaultLog.QueueData[52].Status_Cnt_u08 "MICROSAR RTE" UBYTE NO_COMPU_METHOD 0 0 0 255 ECU_ADDRESS 0 READ_WRITE /end MEASUREMENT
/begin MEASUREMENT Rte_FaultLog_FaultLog.QueueData[53].QueueEventIdx_Cnt_u08 "MICROSAR RTE" UBYTE NO_COMPU_METHOD 0 0 0 255 ECU_ADDRESS 0 READ_WRITE /end MEASUREMENT
/begin MEASUREMENT Rte_FaultLog_FaultLog.QueueData[53].Status_Cnt_u08 "MICROSAR RTE" UBYTE NO_COMPU_METHOD 0 0 0 255 ECU_ADDRESS 0 READ_WRITE /end MEASUREMENT
/begin MEASUREMENT Rte_FaultLog_FaultLog.QueueData[54].QueueEventIdx_Cnt_u08 "MICROSAR RTE" UBYTE NO_COMPU_METHOD 0 0 0 255 ECU_ADDRESS 0 READ_WRITE /end MEASUREMENT
/begin MEASUREMENT Rte_FaultLog_FaultLog.QueueData[54].Status_Cnt_u08 "MICROSAR RTE" UBYTE NO_COMPU_METHOD 0 0 0 255 ECU_ADDRESS 0 READ_WRITE /end MEASUREMENT
/begin MEASUREMENT Rte_FaultLog_FaultLog.QueueData[55].QueueEventIdx_Cnt_u08 "MICROSAR RTE" UBYTE NO_COMPU_METHOD 0 0 0 255 ECU_ADDRESS 0 READ_WRITE /end MEASUREMENT
/begin MEASUREMENT Rte_FaultLog_FaultLog.QueueData[55].Status_Cnt_u08 "MICROSAR RTE" UBYTE NO_COMPU_METHOD 0 0 0 255 ECU_ADDRESS 0 READ_WRITE /end MEASUREMENT
/begin MEASUREMENT Rte_FaultLog_FaultLog.QueueData[56].QueueEventIdx_Cnt_u08 "MICROSAR RTE" UBYTE NO_COMPU_METHOD 0 0 0 255 ECU_ADDRESS 0 READ_WRITE /end MEASUREMENT
/begin MEASUREMENT Rte_FaultLog_FaultLog.QueueData[56].Status_Cnt_u08 "MICROSAR RTE" UBYTE NO_COMPU_METHOD 0 0 0 255 ECU_ADDRESS 0 READ_WRITE /end MEASUREMENT
/begin MEASUREMENT Rte_FaultLog_FaultLog.QueueData[57].QueueEventIdx_Cnt_u08 "MICROSAR RTE" UBYTE NO_COMPU_METHOD 0 0 0 255 ECU_ADDRESS 0 READ_WRITE /end MEASUREMENT
/begin MEASUREMENT Rte_FaultLog_FaultLog.QueueData[57].Status_Cnt_u08 "MICROSAR RTE" UBYTE NO_COMPU_METHOD 0 0 0 255 ECU_ADDRESS 0 READ_WRITE /end MEASUREMENT
/begin MEASUREMENT Rte_FaultLog_FaultLog.QueueData[58].QueueEventIdx_Cnt_u08 "MICROSAR RTE" UBYTE NO_COMPU_METHOD 0 0 0 255 ECU_ADDRESS 0 READ_WRITE /end MEASUREMENT
/begin MEASUREMENT Rte_FaultLog_FaultLog.QueueData[58].Status_Cnt_u08 "MICROSAR RTE" UBYTE NO_COMPU_METHOD 0 0 0 255 ECU_ADDRESS 0 READ_WRITE /end MEASUREMENT
/begin MEASUREMENT Rte_FaultLog_FaultLog.QueueData[59].QueueEventIdx_Cnt_u08 "MICROSAR RTE" UBYTE NO_COMPU_METHOD 0 0 0 255 ECU_ADDRESS 0 READ_WRITE /end MEASUREMENT
/begin MEASUREMENT Rte_FaultLog_FaultLog.QueueData[59].Status_Cnt_u08 "MICROSAR RTE" UBYTE NO_COMPU_METHOD 0 0 0 255 ECU_ADDRESS 0 READ_WRITE /end MEASUREMENT
/begin MEASUREMENT Rte_FaultLog_FaultLog.QueueData[5].QueueEventIdx_Cnt_u08 "MICROSAR RTE" UBYTE NO_COMPU_METHOD 0 0 0 255 ECU_ADDRESS 0 READ_WRITE /end MEASUREMENT
/begin MEASUREMENT Rte_FaultLog_FaultLog.QueueData[5].Status_Cnt_u08 "MICROSAR RTE" UBYTE NO_COMPU_METHOD 0 0 0 255 ECU_ADDRESS 0 READ_WRITE /end MEASUREMENT
/begin MEASUREMENT Rte_FaultLog_FaultLog.QueueData[60].QueueEventIdx_Cnt_u08 "MICROSAR RTE" UBYTE NO_COMPU_METHOD 0 0 0 255 ECU_ADDRESS 0 READ_WRITE /end MEASUREMENT
/begin MEASUREMENT Rte_FaultLog_FaultLog.QueueData[60].Status_Cnt_u08 "MICROSAR RTE" UBYTE NO_COMPU_METHOD 0 0 0 255 ECU_ADDRESS 0 READ_WRITE /end MEASUREMENT
/begin MEASUREMENT Rte_FaultLog_FaultLog.QueueData[61].QueueEventIdx_Cnt_u08 "MICROSAR RTE" UBYTE NO_COMPU_METHOD 0 0 0 255 ECU_ADDRESS 0 READ_WRITE /end MEASUREMENT
/begin MEASUREMENT Rte_FaultLog_FaultLog.QueueData[61].Status_Cnt_u08 "MICROSAR RTE" UBYTE NO_COMPU_METHOD 0 0 0 255 ECU_ADDRESS 0 READ_WRITE /end MEASUREMENT
/begin MEASUREMENT Rte_FaultLog_FaultLog.QueueData[62].QueueEventIdx_Cnt_u08 "MICROSAR RTE" UBYTE NO_COMPU_METHOD 0 0 0 255 ECU_ADDRESS 0 READ_WRITE /end MEASUREMENT
/begin MEASUREMENT Rte_FaultLog_FaultLog.QueueData[62].Status_Cnt_u08 "MICROSAR RTE" UBYTE NO_COMPU_METHOD 0 0 0 255 ECU_ADDRESS 0 READ_WRITE /end MEASUREMENT
/begin MEASUREMENT Rte_FaultLog_FaultLog.QueueData[63].QueueEventIdx_Cnt_u08 "MICROSAR RTE" UBYTE NO_COMPU_METHOD 0 0 0 255 ECU_ADDRESS 0 READ_WRITE /end MEASUREMENT
/begin MEASUREMENT Rte_FaultLog_FaultLog.QueueData[63].Status_Cnt_u08 "MICROSAR RTE" UBYTE NO_COMPU_METHOD 0 0 0 255 ECU_ADDRESS 0 READ_WRITE /end MEASUREMENT
/begin MEASUREMENT Rte_FaultLog_FaultLog.QueueData[64].QueueEventIdx_Cnt_u08 "MICROSAR RTE" UBYTE NO_COMPU_METHOD 0 0 0 255 ECU_ADDRESS 0 READ_WRITE /end MEASUREMENT
/begin MEASUREMENT Rte_FaultLog_FaultLog.QueueData[64].Status_Cnt_u08 "MICROSAR RTE" UBYTE NO_COMPU_METHOD 0 0 0 255 ECU_ADDRESS 0 READ_WRITE /end MEASUREMENT
/begin MEASUREMENT Rte_FaultLog_FaultLog.QueueData[65].QueueEventIdx_Cnt_u08 "MICROSAR RTE" UBYTE NO_COMPU_METHOD 0 0 0 255 ECU_ADDRESS 0 READ_WRITE /end MEASUREMENT
/begin MEASUREMENT Rte_FaultLog_FaultLog.QueueData[65].Status_Cnt_u08 "MICROSAR RTE" UBYTE NO_COMPU_METHOD 0 0 0 255 ECU_ADDRESS 0 READ_WRITE /end MEASUREMENT
/begin MEASUREMENT Rte_FaultLog_FaultLog.QueueData[66].QueueEventIdx_Cnt_u08 "MICROSAR RTE" UBYTE NO_COMPU_METHOD 0 0 0 255 ECU_ADDRESS 0 READ_WRITE /end MEASUREMENT
/begin MEASUREMENT Rte_FaultLog_FaultLog.QueueData[66].Status_Cnt_u08 "MICROSAR RTE" UBYTE NO_COMPU_METHOD 0 0 0 255 ECU_ADDRESS 0 READ_WRITE /end MEASUREMENT
/begin MEASUREMENT Rte_FaultLog_FaultLog.QueueData[67].QueueEventIdx_Cnt_u08 "MICROSAR RTE" UBYTE NO_COMPU_METHOD 0 0 0 255 ECU_ADDRESS 0 READ_WRITE /end MEASUREMENT
/begin MEASUREMENT Rte_FaultLog_FaultLog.QueueData[67].Status_Cnt_u08 "MICROSAR RTE" UBYTE NO_COMPU_METHOD 0 0 0 255 ECU_ADDRESS 0 READ_WRITE /end MEASUREMENT
/begin MEASUREMENT Rte_FaultLog_FaultLog.QueueData[68].QueueEventIdx_Cnt_u08 "MICROSAR RTE" UBYTE NO_COMPU_METHOD 0 0 0 255 ECU_ADDRESS 0 READ_WRITE /end MEASUREMENT
/begin MEASUREMENT Rte_FaultLog_FaultLog.QueueData[68].Status_Cnt_u08 "MICROSAR RTE" UBYTE NO_COMPU_METHOD 0 0 0 255 ECU_ADDRESS 0 READ_WRITE /end MEASUREMENT
/begin MEASUREMENT Rte_FaultLog_FaultLog.QueueData[69].QueueEventIdx_Cnt_u08 "MICROSAR RTE" UBYTE NO_COMPU_METHOD 0 0 0 255 ECU_ADDRESS 0 READ_WRITE /end MEASUREMENT
/begin MEASUREMENT Rte_FaultLog_FaultLog.QueueData[69].Status_Cnt_u08 "MICROSAR RTE" UBYTE NO_COMPU_METHOD 0 0 0 255 ECU_ADDRESS 0 READ_WRITE /end MEASUREMENT
/begin MEASUREMENT Rte_FaultLog_FaultLog.QueueData[6].QueueEventIdx_Cnt_u08 "MICROSAR RTE" UBYTE NO_COMPU_METHOD 0 0 0 255 ECU_ADDRESS 0 READ_WRITE /end MEASUREMENT
/begin MEASUREMENT Rte_FaultLog_FaultLog.QueueData[6].Status_Cnt_u08 "MICROSAR RTE" UBYTE NO_COMPU_METHOD 0 0 0 255 ECU_ADDRESS 0 READ_WRITE /end MEASUREMENT
/begin MEASUREMENT Rte_FaultLog_FaultLog.QueueData[70].QueueEventIdx_Cnt_u08 "MICROSAR RTE" UBYTE NO_COMPU_METHOD 0 0 0 255 ECU_ADDRESS 0 READ_WRITE /end MEASUREMENT
/begin MEASUREMENT Rte_FaultLog_FaultLog.QueueData[70].Status_Cnt_u08 "MICROSAR RTE" UBYTE NO_COMPU_METHOD 0 0 0 255 ECU_ADDRESS 0 READ_WRITE /end MEASUREMENT
/begin MEASUREMENT Rte_FaultLog_FaultLog.QueueData[71].QueueEventIdx_Cnt_u08 "MICROSAR RTE" UBYTE NO_COMPU_METHOD 0 0 0 255 ECU_ADDRESS 0 READ_WRITE /end MEASUREMENT
/begin MEASUREMENT Rte_FaultLog_FaultLog.QueueData[71].Status_Cnt_u08 "MICROSAR RTE" UBYTE NO_COMPU_METHOD 0 0 0 255 ECU_ADDRESS 0 READ_WRITE /end MEASUREMENT
/begin MEASUREMENT Rte_FaultLog_FaultLog.QueueData[72].QueueEventIdx_Cnt_u08 "MICROSAR RTE" UBYTE NO_COMPU_METHOD 0 0 0 255 ECU_ADDRESS 0 READ_WRITE /end MEASUREMENT
/begin MEASUREMENT Rte_FaultLog_FaultLog.QueueData[72].Status_Cnt_u08 "MICROSAR RTE" UBYTE NO_COMPU_METHOD 0 0 0 255 ECU_ADDRESS 0 READ_WRITE /end MEASUREMENT
/begin MEASUREMENT Rte_FaultLog_FaultLog.QueueData[73].QueueEventIdx_Cnt_u08 "MICROSAR RTE" UBYTE NO_COMPU_METHOD 0 0 0 255 ECU_ADDRESS 0 READ_WRITE /end MEASUREMENT
/begin MEASUREMENT Rte_FaultLog_FaultLog.QueueData[73].Status_Cnt_u08 "MICROSAR RTE" UBYTE NO_COMPU_METHOD 0 0 0 255 ECU_ADDRESS 0 READ_WRITE /end MEASUREMENT
/begin MEASUREMENT Rte_FaultLog_FaultLog.QueueData[74].QueueEventIdx_Cnt_u08 "MICROSAR RTE" UBYTE NO_COMPU_METHOD 0 0 0 255 ECU_ADDRESS 0 READ_WRITE /end MEASUREMENT
/begin MEASUREMENT Rte_FaultLog_FaultLog.QueueData[74].Status_Cnt_u08 "MICROSAR RTE" UBYTE NO_COMPU_METHOD 0 0 0 255 ECU_ADDRESS 0 READ_WRITE /end MEASUREMENT
/begin MEASUREMENT Rte_FaultLog_FaultLog.QueueData[75].QueueEventIdx_Cnt_u08 "MICROSAR RTE" UBYTE NO_COMPU_METHOD 0 0 0 255 ECU_ADDRESS 0 READ_WRITE /end MEASUREMENT
/begin MEASUREMENT Rte_FaultLog_FaultLog.QueueData[75].Status_Cnt_u08 "MICROSAR RTE" UBYTE NO_COMPU_METHOD 0 0 0 255 ECU_ADDRESS 0 READ_WRITE /end MEASUREMENT
/begin MEASUREMENT Rte_FaultLog_FaultLog.QueueData[76].QueueEventIdx_Cnt_u08 "MICROSAR RTE" UBYTE NO_COMPU_METHOD 0 0 0 255 ECU_ADDRESS 0 READ_WRITE /end MEASUREMENT
/begin MEASUREMENT Rte_FaultLog_FaultLog.QueueData[76].Status_Cnt_u08 "MICROSAR RTE" UBYTE NO_COMPU_METHOD 0 0 0 255 ECU_ADDRESS 0 READ_WRITE /end MEASUREMENT
/begin MEASUREMENT Rte_FaultLog_FaultLog.QueueData[77].QueueEventIdx_Cnt_u08 "MICROSAR RTE" UBYTE NO_COMPU_METHOD 0 0 0 255 ECU_ADDRESS 0 READ_WRITE /end MEASUREMENT
/begin MEASUREMENT Rte_FaultLog_FaultLog.QueueData[77].Status_Cnt_u08 "MICROSAR RTE" UBYTE NO_COMPU_METHOD 0 0 0 255 ECU_ADDRESS 0 READ_WRITE /end MEASUREMENT
/begin MEASUREMENT Rte_FaultLog_FaultLog.QueueData[78].QueueEventIdx_Cnt_u08 "MICROSAR RTE" UBYTE NO_COMPU_METHOD 0 0 0 255 ECU_ADDRESS 0 READ_WRITE /end MEASUREMENT
/begin MEASUREMENT Rte_FaultLog_FaultLog.QueueData[78].Status_Cnt_u08 "MICROSAR RTE" UBYTE NO_COMPU_METHOD 0 0 0 255 ECU_ADDRESS 0 READ_WRITE /end MEASUREMENT
/begin MEASUREMENT Rte_FaultLog_FaultLog.QueueData[79].QueueEventIdx_Cnt_u08 "MICROSAR RTE" UBYTE NO_COMPU_METHOD 0 0 0 255 ECU_ADDRESS 0 READ_WRITE /end MEASUREMENT
/begin MEASUREMENT Rte_FaultLog_FaultLog.QueueData[79].Status_Cnt_u08 "MICROSAR RTE" UBYTE NO_COMPU_METHOD 0 0 0 255 ECU_ADDRESS 0 READ_WRITE /end MEASUREMENT
/begin MEASUREMENT Rte_FaultLog_FaultLog.QueueData[7].QueueEventIdx_Cnt_u08 "MICROSAR RTE" UBYTE NO_COMPU_METHOD 0 0 0 255 ECU_ADDRESS 0 READ_WRITE /end MEASUREMENT
/begin MEASUREMENT Rte_FaultLog_FaultLog.QueueData[7].Status_Cnt_u08 "MICROSAR RTE" UBYTE NO_COMPU_METHOD 0 0 0 255 ECU_ADDRESS 0 READ_WRITE /end MEASUREMENT
/begin MEASUREMENT Rte_FaultLog_FaultLog.QueueData[80].QueueEventIdx_Cnt_u08 "MICROSAR RTE" UBYTE NO_COMPU_METHOD 0 0 0 255 ECU_ADDRESS 0 READ_WRITE /end MEASUREMENT
/begin MEASUREMENT Rte_FaultLog_FaultLog.QueueData[80].Status_Cnt_u08 "MICROSAR RTE" UBYTE NO_COMPU_METHOD 0 0 0 255 ECU_ADDRESS 0 READ_WRITE /end MEASUREMENT
/begin MEASUREMENT Rte_FaultLog_FaultLog.QueueData[81].QueueEventIdx_Cnt_u08 "MICROSAR RTE" UBYTE NO_COMPU_METHOD 0 0 0 255 ECU_ADDRESS 0 READ_WRITE /end MEASUREMENT
/begin MEASUREMENT Rte_FaultLog_FaultLog.QueueData[81].Status_Cnt_u08 "MICROSAR RTE" UBYTE NO_COMPU_METHOD 0 0 0 255 ECU_ADDRESS 0 READ_WRITE /end MEASUREMENT
/begin MEASUREMENT Rte_FaultLog_FaultLog.QueueData[82].QueueEventIdx_Cnt_u08 "MICROSAR RTE" UBYTE NO_COMPU_METHOD 0 0 0 255 ECU_ADDRESS 0 READ_WRITE /end MEASUREMENT
/begin MEASUREMENT Rte_FaultLog_FaultLog.QueueData[82].Status_Cnt_u08 "MICROSAR RTE" UBYTE NO_COMPU_METHOD 0 0 0 255 ECU_ADDRESS 0 READ_WRITE /end MEASUREMENT
/begin MEASUREMENT Rte_FaultLog_FaultLog.QueueData[83].QueueEventIdx_Cnt_u08 "MICROSAR RTE" UBYTE NO_COMPU_METHOD 0 0 0 255 ECU_ADDRESS 0 READ_WRITE /end MEASUREMENT
/begin MEASUREMENT Rte_FaultLog_FaultLog.QueueData[83].Status_Cnt_u08 "MICROSAR RTE" UBYTE NO_COMPU_METHOD 0 0 0 255 ECU_ADDRESS 0 READ_WRITE /end MEASUREMENT
/begin MEASUREMENT Rte_FaultLog_FaultLog.QueueData[84].QueueEventIdx_Cnt_u08 "MICROSAR RTE" UBYTE NO_COMPU_METHOD 0 0 0 255 ECU_ADDRESS 0 READ_WRITE /end MEASUREMENT
/begin MEASUREMENT Rte_FaultLog_FaultLog.QueueData[84].Status_Cnt_u08 "MICROSAR RTE" UBYTE NO_COMPU_METHOD 0 0 0 255 ECU_ADDRESS 0 READ_WRITE /end MEASUREMENT
/begin MEASUREMENT Rte_FaultLog_FaultLog.QueueData[85].QueueEventIdx_Cnt_u08 "MICROSAR RTE" UBYTE NO_COMPU_METHOD 0 0 0 255 ECU_ADDRESS 0 READ_WRITE /end MEASUREMENT
/begin MEASUREMENT Rte_FaultLog_FaultLog.QueueData[85].Status_Cnt_u08 "MICROSAR RTE" UBYTE NO_COMPU_METHOD 0 0 0 255 ECU_ADDRESS 0 READ_WRITE /end MEASUREMENT
/begin MEASUREMENT Rte_FaultLog_FaultLog.QueueData[86].QueueEventIdx_Cnt_u08 "MICROSAR RTE" UBYTE NO_COMPU_METHOD 0 0 0 255 ECU_ADDRESS 0 READ_WRITE /end MEASUREMENT
/begin MEASUREMENT Rte_FaultLog_FaultLog.QueueData[86].Status_Cnt_u08 "MICROSAR RTE" UBYTE NO_COMPU_METHOD 0 0 0 255 ECU_ADDRESS 0 READ_WRITE /end MEASUREMENT
/begin MEASUREMENT Rte_FaultLog_FaultLog.QueueData[87].QueueEventIdx_Cnt_u08 "MICROSAR RTE" UBYTE NO_COMPU_METHOD 0 0 0 255 ECU_ADDRESS 0 READ_WRITE /end MEASUREMENT
/begin MEASUREMENT Rte_FaultLog_FaultLog.QueueData[87].Status_Cnt_u08 "MICROSAR RTE" UBYTE NO_COMPU_METHOD 0 0 0 255 ECU_ADDRESS 0 READ_WRITE /end MEASUREMENT
/begin MEASUREMENT Rte_FaultLog_FaultLog.QueueData[88].QueueEventIdx_Cnt_u08 "MICROSAR RTE" UBYTE NO_COMPU_METHOD 0 0 0 255 ECU_ADDRESS 0 READ_WRITE /end MEASUREMENT
/begin MEASUREMENT Rte_FaultLog_FaultLog.QueueData[88].Status_Cnt_u08 "MICROSAR RTE" UBYTE NO_COMPU_METHOD 0 0 0 255 ECU_ADDRESS 0 READ_WRITE /end MEASUREMENT
/begin MEASUREMENT Rte_FaultLog_FaultLog.QueueData[89].QueueEventIdx_Cnt_u08 "MICROSAR RTE" UBYTE NO_COMPU_METHOD 0 0 0 255 ECU_ADDRESS 0 READ_WRITE /end MEASUREMENT
/begin MEASUREMENT Rte_FaultLog_FaultLog.QueueData[89].Status_Cnt_u08 "MICROSAR RTE" UBYTE NO_COMPU_METHOD 0 0 0 255 ECU_ADDRESS 0 READ_WRITE /end MEASUREMENT
/begin MEASUREMENT Rte_FaultLog_FaultLog.QueueData[8].QueueEventIdx_Cnt_u08 "MICROSAR RTE" UBYTE NO_COMPU_METHOD 0 0 0 255 ECU_ADDRESS 0 READ_WRITE /end MEASUREMENT
/begin MEASUREMENT Rte_FaultLog_FaultLog.QueueData[8].Status_Cnt_u08 "MICROSAR RTE" UBYTE NO_COMPU_METHOD 0 0 0 255 ECU_ADDRESS 0 READ_WRITE /end MEASUREMENT
/begin MEASUREMENT Rte_FaultLog_FaultLog.QueueData[90].QueueEventIdx_Cnt_u08 "MICROSAR RTE" UBYTE NO_COMPU_METHOD 0 0 0 255 ECU_ADDRESS 0 READ_WRITE /end MEASUREMENT
/begin MEASUREMENT Rte_FaultLog_FaultLog.QueueData[90].Status_Cnt_u08 "MICROSAR RTE" UBYTE NO_COMPU_METHOD 0 0 0 255 ECU_ADDRESS 0 READ_WRITE /end MEASUREMENT
/begin MEASUREMENT Rte_FaultLog_FaultLog.QueueData[91].QueueEventIdx_Cnt_u08 "MICROSAR RTE" UBYTE NO_COMPU_METHOD 0 0 0 255 ECU_ADDRESS 0 READ_WRITE /end MEASUREMENT
/begin MEASUREMENT Rte_FaultLog_FaultLog.QueueData[91].Status_Cnt_u08 "MICROSAR RTE" UBYTE NO_COMPU_METHOD 0 0 0 255 ECU_ADDRESS 0 READ_WRITE /end MEASUREMENT
/begin MEASUREMENT Rte_FaultLog_FaultLog.QueueData[92].QueueEventIdx_Cnt_u08 "MICROSAR RTE" UBYTE NO_COMPU_METHOD 0 0 0 255 ECU_ADDRESS 0 READ_WRITE /end MEASUREMENT
/begin MEASUREMENT Rte_FaultLog_FaultLog.QueueData[92].Status_Cnt_u08 "MICROSAR RTE" UBYTE NO_COMPU_METHOD 0 0 0 255 ECU_ADDRESS 0 READ_WRITE /end MEASUREMENT
/begin MEASUREMENT Rte_FaultLog_FaultLog.QueueData[93].QueueEventIdx_Cnt_u08 "MICROSAR RTE" UBYTE NO_COMPU_METHOD 0 0 0 255 ECU_ADDRESS 0 READ_WRITE /end MEASUREMENT
/begin MEASUREMENT Rte_FaultLog_FaultLog.QueueData[93].Status_Cnt_u08 "MICROSAR RTE" UBYTE NO_COMPU_METHOD 0 0 0 255 ECU_ADDRESS 0 READ_WRITE /end MEASUREMENT
/begin MEASUREMENT Rte_FaultLog_FaultLog.QueueData[94].QueueEventIdx_Cnt_u08 "MICROSAR RTE" UBYTE NO_COMPU_METHOD 0 0 0 255 ECU_ADDRESS 0 READ_WRITE /end MEASUREMENT
/begin MEASUREMENT Rte_FaultLog_FaultLog.QueueData[94].Status_Cnt_u08 "MICROSAR RTE" UBYTE NO_COMPU_METHOD 0 0 0 255 ECU_ADDRESS 0 READ_WRITE /end MEASUREMENT
/begin MEASUREMENT Rte_FaultLog_FaultLog.QueueData[95].QueueEventIdx_Cnt_u08 "MICROSAR RTE" UBYTE NO_COMPU_METHOD 0 0 0 255 ECU_ADDRESS 0 READ_WRITE /end MEASUREMENT
/begin MEASUREMENT Rte_FaultLog_FaultLog.QueueData[95].Status_Cnt_u08 "MICROSAR RTE" UBYTE NO_COMPU_METHOD 0 0 0 255 ECU_ADDRESS 0 READ_WRITE /end MEASUREMENT
/begin MEASUREMENT Rte_FaultLog_FaultLog.QueueData[96].QueueEventIdx_Cnt_u08 "MICROSAR RTE" UBYTE NO_COMPU_METHOD 0 0 0 255 ECU_ADDRESS 0 READ_WRITE /end MEASUREMENT
/begin MEASUREMENT Rte_FaultLog_FaultLog.QueueData[96].Status_Cnt_u08 "MICROSAR RTE" UBYTE NO_COMPU_METHOD 0 0 0 255 ECU_ADDRESS 0 READ_WRITE /end MEASUREMENT
/begin MEASUREMENT Rte_FaultLog_FaultLog.QueueData[97].QueueEventIdx_Cnt_u08 "MICROSAR RTE" UBYTE NO_COMPU_METHOD 0 0 0 255 ECU_ADDRESS 0 READ_WRITE /end MEASUREMENT
/begin MEASUREMENT Rte_FaultLog_FaultLog.QueueData[97].Status_Cnt_u08 "MICROSAR RTE" UBYTE NO_COMPU_METHOD 0 0 0 255 ECU_ADDRESS 0 READ_WRITE /end MEASUREMENT
/begin MEASUREMENT Rte_FaultLog_FaultLog.QueueData[98].QueueEventIdx_Cnt_u08 "MICROSAR RTE" UBYTE NO_COMPU_METHOD 0 0 0 255 ECU_ADDRESS 0 READ_WRITE /end MEASUREMENT
/begin MEASUREMENT Rte_FaultLog_FaultLog.QueueData[98].Status_Cnt_u08 "MICROSAR RTE" UBYTE NO_COMPU_METHOD 0 0 0 255 ECU_ADDRESS 0 READ_WRITE /end MEASUREMENT
/begin MEASUREMENT Rte_FaultLog_FaultLog.QueueData[99].QueueEventIdx_Cnt_u08 "MICROSAR RTE" UBYTE NO_COMPU_METHOD 0 0 0 255 ECU_ADDRESS 0 READ_WRITE /end MEASUREMENT
/begin MEASUREMENT Rte_FaultLog_FaultLog.QueueData[99].Status_Cnt_u08 "MICROSAR RTE" UBYTE NO_COMPU_METHOD 0 0 0 255 ECU_ADDRESS 0 READ_WRITE /end MEASUREMENT
/begin MEASUREMENT Rte_FaultLog_FaultLog.QueueData[9].QueueEventIdx_Cnt_u08 "MICROSAR RTE" UBYTE NO_COMPU_METHOD 0 0 0 255 ECU_ADDRESS 0 READ_WRITE /end MEASUREMENT
/begin MEASUREMENT Rte_FaultLog_FaultLog.QueueData[9].Status_Cnt_u08 "MICROSAR RTE" UBYTE NO_COMPU_METHOD 0 0 0 255 ECU_ADDRESS 0 READ_WRITE /end MEASUREMENT
/begin MEASUREMENT Rte_SrlComDriver_PowerSupplies_Cnt_u08 "MICROSAR RTE" UBYTE NO_COMPU_METHOD 0 0 0 255 ECU_ADDRESS 0 /end MEASUREMENT
/begin MEASUREMENT Rte_SrlComDriver_ShuntPosition_Cnt_u08 "MICROSAR RTE" UBYTE NO_COMPU_METHOD 0 0 0 255 ECU_ADDRESS 0 /end MEASUREMENT
/begin MEASUREMENT Rte_SrlComDriver_TxEnabled_Cnt_lgc "MICROSAR RTE" UBYTE RTE_CM_BOOLEAN 0 0 0 255 ECU_ADDRESS 0 /end MEASUREMENT
/begin MEASUREMENT Rte_FrqDepDmpnInrtCmp_VehicleLonAccel_KphpS_f32 "MICROSAR RTE" FLOAT32_IEEE NO_COMPU_METHOD 0 0 1.175494351e-38 3.402823466e+38 ECU_ADDRESS 0 /end MEASUREMENT
/begin MEASUREMENT Rte_FrqDepDmpnInrtCmp_WIRCmdAmpBlnd_MtrNm_f32 "MICROSAR RTE" FLOAT32_IEEE NO_COMPU_METHOD 0 0 1.175494351e-38 3.402823466e+38 ECU_ADDRESS 0 /end MEASUREMENT
/begin MEASUREMENT Rte_GCCDiag_DftGrossCCDiag_Cnt_lgc "MICROSAR RTE" UBYTE RTE_CM_BOOLEAN 0 0 0 255 ECU_ADDRESS 0 /end MEASUREMENT
/begin MEASUREMENT Rte_Gsod_Ana_Hw_Torque_HwNm_f32 "MICROSAR RTE" FLOAT32_IEEE NO_COMPU_METHOD 0 0 1.175494351e-38 3.402823466e+38 ECU_ADDRESS 0 /end MEASUREMENT
/begin MEASUREMENT Rte_Gsod_SysC_Ana_Hw_Torque_HwNm_f32 "MICROSAR RTE" FLOAT32_IEEE NO_COMPU_METHOD 0 0 1.175494351e-38 3.402823466e+38 ECU_ADDRESS 0 /end MEASUREMENT
/begin MEASUREMENT Rte_Polarity_SysC_MtrElecMechPolarity_Cnt_s32 "MICROSAR RTE" SLONG NO_COMPU_METHOD 0 0 -2147483648 2147483647 ECU_ADDRESS 0 /end MEASUREMENT
/begin MEASUREMENT Rte_HiLoadStall_AssistStallLimit_MtrNm_f32 "MICROSAR RTE" FLOAT32_IEEE NO_COMPU_METHOD 0 0 1.175494351e-38 3.402823466e+38 ECU_ADDRESS 0 /end MEASUREMENT
/begin MEASUREMENT Rte_HighFreqAssist_WIRCmdAmpBlnd_MtrNm_f32 "MICROSAR RTE" FLOAT32_IEEE NO_COMPU_METHOD 0 0 1.175494351e-38 3.402823466e+38 ECU_ADDRESS 0 /end MEASUREMENT
/begin MEASUREMENT Rte_MtrDrvDiag_MtrDrvrInitComplete_Cnt_lgc "MICROSAR RTE" UBYTE RTE_CM_BOOLEAN 0 0 0 255 ECU_ADDRESS 0 /end MEASUREMENT
/begin MEASUREMENT Rte_HwPwUp_MtrDrvrInitStart_Cnt_lgc "MICROSAR RTE" UBYTE RTE_CM_BOOLEAN 0 0 0 255 ECU_ADDRESS 0 /end MEASUREMENT
/begin MEASUREMENT Rte_TmprlMon_TMFTestComplete_Cnt_lgc "MICROSAR RTE" UBYTE RTE_CM_BOOLEAN 0 0 0 255 ECU_ADDRESS 0 /end MEASUREMENT
/begin MEASUREMENT Rte_HwPwUp_TMFTestStart_Cnt_lgc "MICROSAR RTE" UBYTE RTE_CM_BOOLEAN 0 0 0 255 ECU_ADDRESS 0 /end MEASUREMENT
/begin MEASUREMENT Rte_HystComp_WIRCmdAmpBlnd_MtrNm_f32 "MICROSAR RTE" FLOAT32_IEEE NO_COMPU_METHOD 0 0 1.175494351e-38 3.402823466e+38 ECU_ADDRESS 0 /end MEASUREMENT
/begin MEASUREMENT Rte_VehSpdLmt_AstVehSpdLimit_MtrNm_f32 "MICROSAR RTE" FLOAT32_IEEE NO_COMPU_METHOD 0 0 1.175494351e-38 3.402823466e+38 ECU_ADDRESS 0 /end MEASUREMENT
/begin MEASUREMENT Rte_LmtCod_CCLTrqRamp_Uls_f32 "MICROSAR RTE" FLOAT32_IEEE NO_COMPU_METHOD 0 0 1.175494351e-38 3.402823466e+38 ECU_ADDRESS 0 /end MEASUREMENT
/begin MEASUREMENT Rte_StOpCtrl_OutputRampMult_Uls_f32 "MICROSAR RTE" FLOAT32_IEEE NO_COMPU_METHOD 0 0 1.175494351e-38 3.402823466e+38 ECU_ADDRESS 0 /end MEASUREMENT
/begin MEASUREMENT Rte_ThrmlDutyCycle_ThermalLimit_MtrNm_f32 "MICROSAR RTE" FLOAT32_IEEE NO_COMPU_METHOD 0 0 1.175494351e-38 3.402823466e+38 ECU_ADDRESS 0 /end MEASUREMENT
/begin MEASUREMENT Rte_LrnEOT_LearnedEOT.CCWEOTFound_Cnt_lgc "MICROSAR RTE" UBYTE RTE_CM_BOOLEAN 0 0 0 255 ECU_ADDRESS 0 READ_WRITE /end MEASUREMENT
/begin MEASUREMENT Rte_LrnEOT_LearnedEOT.CCWEOTPosition_HwDeg_f32 "MICROSAR RTE" FLOAT32_IEEE NO_COMPU_METHOD 0 0 1.175494351e-38 3.402823466e+38 ECU_ADDRESS 0 READ_WRITE /end MEASUREMENT
/begin MEASUREMENT Rte_LrnEOT_LearnedEOT.CWEOTFound_Cnt_lgc "MICROSAR RTE" UBYTE RTE_CM_BOOLEAN 0 0 0 255 ECU_ADDRESS 0 READ_WRITE /end MEASUREMENT
/begin MEASUREMENT Rte_LrnEOT_LearnedEOT.CWEOTPosition_HwDeg_f32 "MICROSAR RTE" FLOAT32_IEEE NO_COMPU_METHOD 0 0 1.175494351e-38 3.402823466e+38 ECU_ADDRESS 0 READ_WRITE /end MEASUREMENT
/begin MEASUREMENT Rte_MtrDrvDiag_FETFaultPhase_Cnt_enum "MICROSAR RTE" UBYTE RTE_CM_ENUM_FETPHASETYPE_ENUM 0 0 0 255 ECU_ADDRESS 0 /end MEASUREMENT
/begin MEASUREMENT Rte_MtrDrvDiag_FETFaultType_Cnt_enum "MICROSAR RTE" UBYTE RTE_CM_ENUM_FETFAULTTYPE_ENUM 0 0 0 255 ECU_ADDRESS 0 /end MEASUREMENT
/begin MEASUREMENT Rte_MtrTempEst_AmbTemp_DegC_f32 "MICROSAR RTE" FLOAT32_IEEE NO_COMPU_METHOD 0 0 1.175494351e-38 3.402823466e+38 ECU_ADDRESS 0 /end MEASUREMENT
/begin MEASUREMENT Rte_MtrTempEst_EngTemp_DegC_f32 "MICROSAR RTE" FLOAT32_IEEE NO_COMPU_METHOD 0 0 1.175494351e-38 3.402823466e+38 ECU_ADDRESS 0 /end MEASUREMENT
/begin MEASUREMENT Rte_PeakCurrEst_EstPkCurr_AmpSq_f32 "MICROSAR RTE" FLOAT32_IEEE NO_COMPU_METHOD 0 0 1.175494351e-38 3.402823466e+38 ECU_ADDRESS 0 /end MEASUREMENT
/begin MEASUREMENT Rte_MtrTempEst_ScomAMDefeat_Cnt_lgc "MICROSAR RTE" UBYTE RTE_CM_BOOLEAN 0 0 0 255 ECU_ADDRESS 0 /end MEASUREMENT
/begin MEASUREMENT Rte_MtrTempEst_ScomTempDataRcvd_Cnt_lgc "MICROSAR RTE" UBYTE RTE_CM_BOOLEAN 0 0 0 255 ECU_ADDRESS 0 /end MEASUREMENT
/begin MEASUREMENT Rte_MtrVel_HwVelValid_Cnt_lgc "MICROSAR RTE" UBYTE RTE_CM_BOOLEAN 0 0 0 255 ECU_ADDRESS 0 /end MEASUREMENT
/begin MEASUREMENT Rte_MtrVel2_SysCDiagHwVel_HwRadpS_f32 "MICROSAR RTE" FLOAT32_IEEE NO_COMPU_METHOD 0 0 1.175494351e-38 3.402823466e+38 ECU_ADDRESS 0 /end MEASUREMENT
/begin MEASUREMENT Rte_MtrVel2_SysCDiagMtrVelMRF_MtrRadpS_f32 "MICROSAR RTE" FLOAT32_IEEE NO_COMPU_METHOD 0 0 1.175494351e-38 3.402823466e+38 ECU_ADDRESS 0 /end MEASUREMENT
/begin MEASUREMENT Rte_MtrVel_SysCHandwheelVel_HwRadpS_f32 "MICROSAR RTE" FLOAT32_IEEE NO_COMPU_METHOD 0 0 1.175494351e-38 3.402823466e+38 ECU_ADDRESS 0 /end MEASUREMENT
/begin MEASUREMENT Rte_MtrVel_SysCMotorVelMRF_MtrRadpS_f32 "MICROSAR RTE" FLOAT32_IEEE NO_COMPU_METHOD 0 0 1.175494351e-38 3.402823466e+38 ECU_ADDRESS 0 /end MEASUREMENT
/begin MEASUREMENT Rte_PICurrCntrl_DervLambdaAlphaDiag_Volt_f32 "This signal is intended to communicate any type voltage signal measured by the ecu.  This signal has a lower limit of 0 which reequires users of the signal to provide divide by 0 protection if it is used as a denominator in a calculation.  See Vecu port p" FLOAT32_IEEE NO_COMPU_METHOD 0 0 1.175494351e-38 3.402823466e+38 ECU_ADDRESS 0 /end MEASUREMENT
/begin MEASUREMENT Rte_PICurrCntrl_DervLambdaBetaDiag_Volt_f32 "This signal is intended to communicate any type voltage signal measured by the ecu.  This signal has a lower limit of 0 which reequires users of the signal to provide divide by 0 protection if it is used as a denominator in a calculation.  See Vecu port p" FLOAT32_IEEE NO_COMPU_METHOD 0 0 1.175494351e-38 3.402823466e+38 ECU_ADDRESS 0 /end MEASUREMENT
/begin MEASUREMENT Rte_PSASH_APAState_Cnt_u08 "MICROSAR RTE" UBYTE NO_COMPU_METHOD 0 0 0 255 ECU_ADDRESS 0 /end MEASUREMENT
/begin MEASUREMENT Rte_PSASH_APAStateTransitionCause_Cnt_u08 "MICROSAR RTE" UBYTE NO_COMPU_METHOD 0 0 0 255 ECU_ADDRESS 0 /end MEASUREMENT
/begin MEASUREMENT Rte_SrlComInput_APAAuthn_Cnt_lgc "MICROSAR RTE" UBYTE RTE_CM_BOOLEAN 0 0 0 255 ECU_ADDRESS 0 /end MEASUREMENT
/begin MEASUREMENT Rte_SrlComInput_APARequest_Cnt_lgc "MICROSAR RTE" UBYTE RTE_CM_BOOLEAN 0 0 0 255 ECU_ADDRESS 0 /end MEASUREMENT
/begin MEASUREMENT Rte_SrlComInput_ApaRelaxReq_Cnt_lgc "MICROSAR RTE" UBYTE RTE_CM_BOOLEAN 0 0 0 255 ECU_ADDRESS 0 /end MEASUREMENT
/begin MEASUREMENT Rte_SrlComInput_CPKOK_Cnt_lgc "MICROSAR RTE" UBYTE RTE_CM_BOOLEAN 0 0 0 255 ECU_ADDRESS 0 /end MEASUREMENT
/begin MEASUREMENT Rte_PSASH_PosSrvoEnable_Cnt_lgc "MICROSAR RTE" UBYTE RTE_CM_BOOLEAN 0 0 0 255 ECU_ADDRESS 0 /end MEASUREMENT
/begin MEASUREMENT Rte_SrlComInput_PosSrvoHwAngle_HwDeg_f32 "MICROSAR RTE" FLOAT32_IEEE NO_COMPU_METHOD 0 0 1.175494351e-38 3.402823466e+38 ECU_ADDRESS 0 /end MEASUREMENT
/begin MEASUREMENT Rte_PSATA_PosSrvoNTC_Cnt_lgc "MICROSAR RTE" UBYTE RTE_CM_BOOLEAN 0 0 0 255 ECU_ADDRESS 0 /end MEASUREMENT
/begin MEASUREMENT Rte_PosServo_PosSrvoCmd_MtrNm_f32 "MICROSAR RTE" FLOAT32_IEEE NO_COMPU_METHOD 0 0 1.175494351e-38 3.402823466e+38 ECU_ADDRESS 0 /end MEASUREMENT
/begin MEASUREMENT Rte_PeakCurrEst_FiltEstPkCurr_AmpSq_f32 "MICROSAR RTE" FLOAT32_IEEE NO_COMPU_METHOD 0 0 1.175494351e-38 3.402823466e+38 ECU_ADDRESS 0 /end MEASUREMENT
/begin GROUP FaultLog.FaultLog "MICROSAR RTE"
 /begin REF_MEASUREMENT Rte_FaultLog_FaultLog.CTCPassData[52].Byte6_Cnt_u08 Rte_FaultLog_FaultLog.CTCPassData[52].Reserved1_Cnt_u08 Rte_FaultLog_FaultLog.CTCPassData[52].Reserved2_Cnt_u08 Rte_FaultLog_FaultLog.CTCPassData[53].Byte1_Cnt_u08 Rte_FaultLog_FaultLog.CTCPassData[53].Byte2_Cnt_u08 Rte_FaultLog_FaultLog.CTCPassData[53].Byte3_Cnt_u08 Rte_FaultLog_FaultLog.CTCPassData[53].Byte4_Cnt_u08 Rte_FaultLog_FaultLog.CTCPassData[53].Byte5_Cnt_u08 Rte_FaultLog_FaultLog.CTCPassData[53].Byte6_Cnt_u08 Rte_FaultLog_FaultLog.CTCPassData[53].Reserved1_Cnt_u08 Rte_FaultLog_FaultLog.CTCPassData[53].Reserved2_Cnt_u08 Rte_FaultLog_FaultLog.CTCPassData[54].Byte1_Cnt_u08 Rte_FaultLog_FaultLog.CTCPassData[54].Byte2_Cnt_u08 Rte_FaultLog_FaultLog.CTCPassData[54].Byte3_Cnt_u08 Rte_FaultLog_FaultLog.CTCPassData[54].Byte4_Cnt_u08 Rte_FaultLog_FaultLog.CTCPassData[54].Byte5_Cnt_u08 Rte_FaultLog_FaultLog.CTCPassData[54].Byte6_Cnt_u08 Rte_FaultLog_FaultLog.CTCPassData[54].Reserved1_Cnt_u08 Rte_FaultLog_FaultLog.CTCPassData[54].Reserved2_Cnt_u08 Rte_FaultLog_FaultLog.CTCPassData[55].Byte1_Cnt_u08 Rte_FaultLog_FaultLog.CTCPassData[55].Byte2_Cnt_u08 Rte_FaultLog_FaultLog.CTCPassData[55].Byte3_Cnt_u08 Rte_FaultLog_FaultLog.CTCPassData[55].Byte4_Cnt_u08 Rte_FaultLog_FaultLog.CTCPassData[55].Byte5_Cnt_u08 Rte_FaultLog_FaultLog.CTCPassData[55].Byte6_Cnt_u08 Rte_FaultLog_FaultLog.CTCPassData[55].Reserved1_Cnt_u08 Rte_FaultLog_FaultLog.CTCPassData[55].Reserved2_Cnt_u08 Rte_FaultLog_FaultLog.CTCPassData[56].Byte1_Cnt_u08 Rte_FaultLog_FaultLog.CTCPassData[56].Byte2_Cnt_u08 Rte_FaultLog_FaultLog.CTCPassData[56].Byte3_Cnt_u08 Rte_FaultLog_FaultLog.CTCPassData[56].Byte4_Cnt_u08 Rte_FaultLog_FaultLog.CTCPassData[56].Byte5_Cnt_u08 Rte_FaultLog_FaultLog.CTCPassData[56].Byte6_Cnt_u08 Rte_FaultLog_FaultLog.CTCPassData[56].Reserved1_Cnt_u08 Rte_FaultLog_FaultLog.CTCPassData[56].Reserved2_Cnt_u08 Rte_FaultLog_FaultLog.CTCPassData[57].Byte1_Cnt_u08 Rte_FaultLog_FaultLog.CTCPassData[57].Byte2_Cnt_u08 Rte_FaultLog_FaultLog.CTCPassData[57].Byte3_Cnt_u08 Rte_FaultLog_FaultLog.CTCPassData[57].Byte4_Cnt_u08 Rte_FaultLog_FaultLog.CTCPassData[57].Byte5_Cnt_u08 Rte_FaultLog_FaultLog.CTCPassData[57].Byte6_Cnt_u08 Rte_FaultLog_FaultLog.CTCPassData[57].Reserved1_Cnt_u08 Rte_FaultLog_FaultLog.CTCPassData[57].Reserved2_Cnt_u08 Rte_FaultLog_FaultLog.CTCPassData[58].Byte1_Cnt_u08 Rte_FaultLog_FaultLog.CTCPassData[58].Byte2_Cnt_u08 Rte_FaultLog_FaultLog.CTCPassData[58].Byte3_Cnt_u08 Rte_FaultLog_FaultLog.CTCPassData[58].Byte4_Cnt_u08 Rte_FaultLog_FaultLog.CTCPassData[58].Byte5_Cnt_u08 Rte_FaultLog_FaultLog.CTCPassData[58].Byte6_Cnt_u08 Rte_FaultLog_FaultLog.CTCPassData[58].Reserved1_Cnt_u08 Rte_FaultLog_FaultLog.CTCPassData[58].Reserved2_Cnt_u08 Rte_FaultLog_FaultLog.CTCPassData[59].Byte1_Cnt_u08 Rte_FaultLog_FaultLog.CTCPassData[59].Byte2_Cnt_u08 Rte_FaultLog_FaultLog.CTCPassData[59].Byte3_Cnt_u08 Rte_FaultLog_FaultLog.CTCPassData[59].Byte4_Cnt_u08 Rte_FaultLog_FaultLog.CTCPassData[59].Byte5_Cnt_u08 Rte_FaultLog_FaultLog.CTCPassData[59].Byte6_Cnt_u08 Rte_FaultLog_FaultLog.CTCPassData[59].Reserved1_Cnt_u08 Rte_FaultLog_FaultLog.CTCPassData[59].Reserved2_Cnt_u08 Rte_FaultLog_FaultLog.CTCPassData[5].Byte1_Cnt_u08 Rte_FaultLog_FaultLog.CTCPassData[5].Byte2_Cnt_u08 Rte_FaultLog_FaultLog.CTCPassData[5].Byte3_Cnt_u08 Rte_FaultLog_FaultLog.CTCPassData[5].Byte4_Cnt_u08 Rte_FaultLog_FaultLog.CTCPassData[5].Byte5_Cnt_u08 Rte_FaultLog_FaultLog.CTCPassData[5].Byte6_Cnt_u08 Rte_FaultLog_FaultLog.CTCPassData[5].Reserved1_Cnt_u08 Rte_FaultLog_FaultLog.CTCPassData[5].Reserved2_Cnt_u08 Rte_FaultLog_FaultLog.CTCPassData[6].Byte1_Cnt_u08 Rte_FaultLog_FaultLog.CTCPassData[6].Byte2_Cnt_u08 Rte_FaultLog_FaultLog.CTCPassData[6].Byte3_Cnt_u08 Rte_FaultLog_FaultLog.CTCPassData[6].Byte4_Cnt_u08 Rte_FaultLog_FaultLog.CTCPassData[6].Byte5_Cnt_u08 Rte_FaultLog_FaultLog.CTCPassData[6].Byte6_Cnt_u08 Rte_FaultLog_FaultLog.CTCPassData[6].Reserved1_Cnt_u08 Rte_FaultLog_FaultLog.CTCPassData[6].Reserved2_Cnt_u08 Rte_FaultLog_FaultLog.CTCPassData[7].Byte1_Cnt_u08 Rte_FaultLog_FaultLog.CTCPassData[7].Byte2_Cnt_u08 Rte_FaultLog_FaultLog.CTCPassData[7].Byte3_Cnt_u08 Rte_FaultLog_FaultLog.CTCPassData[7].Byte4_Cnt_u08 Rte_FaultLog_FaultLog.CTCPassData[7].Byte5_Cnt_u08 Rte_FaultLog_FaultLog.CTCPassData[7].Byte6_Cnt_u08 Rte_FaultLog_FaultLog.CTCPassData[7].Reserved1_Cnt_u08 Rte_FaultLog_FaultLog.CTCPassData[7].Reserved2_Cnt_u08 Rte_FaultLog_FaultLog.CTCPassData[8].Byte1_Cnt_u08 Rte_FaultLog_FaultLog.CTCPassData[8].Byte2_Cnt_u08 Rte_FaultLog_FaultLog.CTCPassData[8].Byte3_Cnt_u08 Rte_FaultLog_FaultLog.CTCPassData[8].Byte4_Cnt_u08 Rte_FaultLog_FaultLog.CTCPassData[8].Byte5_Cnt_u08 Rte_FaultLog_FaultLog.CTCPassData[8].Byte6_Cnt_u08 Rte_FaultLog_FaultLog.CTCPassData[8].Reserved1_Cnt_u08 Rte_FaultLog_FaultLog.CTCPassData[8].Reserved2_Cnt_u08 Rte_FaultLog_FaultLog.CTCPassData[9].Byte1_Cnt_u08 Rte_FaultLog_FaultLog.CTCPassData[9].Byte2_Cnt_u08 Rte_FaultLog_FaultLog.CTCPassData[9].Byte3_Cnt_u08 Rte_FaultLog_FaultLog.CTCPassData[9].Byte4_Cnt_u08 Rte_FaultLog_FaultLog.CTCPassData[9].Byte5_Cnt_u08 Rte_FaultLog_FaultLog.CTCPassData[9].Byte6_Cnt_u08 Rte_FaultLog_FaultLog.CTCPassData[9].Reserved1_Cnt_u08 Rte_FaultLog_FaultLog.CTCPassData[9].Reserved2_Cnt_u08 Rte_FaultLog_FaultLog.QueueData[0].QueueEventIdx_Cnt_u08 Rte_FaultLog_FaultLog.QueueData[0].Status_Cnt_u08 Rte_FaultLog_FaultLog.QueueData[100].QueueEventIdx_Cnt_u08 Rte_FaultLog_FaultLog.QueueData[100].Status_Cnt_u08 Rte_FaultLog_FaultLog.QueueData[101].QueueEventIdx_Cnt_u08 Rte_FaultLog_FaultLog.QueueData[101].Status_Cnt_u08 Rte_FaultLog_FaultLog.QueueData[102].QueueEventIdx_Cnt_u08 Rte_FaultLog_FaultLog.QueueData[102].Status_Cnt_u08 Rte_FaultLog_FaultLog.QueueData[103].QueueEventIdx_Cnt_u08 Rte_FaultLog_FaultLog.QueueData[103].Status_Cnt_u08 Rte_FaultLog_FaultLog.QueueData[104].QueueEventIdx_Cnt_u08 Rte_FaultLog_FaultLog.QueueData[104].Status_Cnt_u08 Rte_FaultLog_FaultLog.QueueData[105].QueueEventIdx_Cnt_u08 Rte_FaultLog_FaultLog.QueueData[105].Status_Cnt_u08 Rte_FaultLog_FaultLog.QueueData[106].QueueEventIdx_Cnt_u08 Rte_FaultLog_FaultLog.QueueData[106].Status_Cnt_u08 Rte_FaultLog_FaultLog.QueueData[107].QueueEventIdx_Cnt_u08 Rte_FaultLog_FaultLog.QueueData[107].Status_Cnt_u08 Rte_FaultLog_FaultLog.QueueData[108].QueueEventIdx_Cnt_u08 Rte_FaultLog_FaultLog.QueueData[108].Status_Cnt_u08 Rte_FaultLog_FaultLog.QueueData[109].QueueEventIdx_Cnt_u08 Rte_FaultLog_FaultLog.QueueData[109].Status_Cnt_u08 Rte_FaultLog_FaultLog.QueueData[10].QueueEventIdx_Cnt_u08 Rte_FaultLog_FaultLog.QueueData[10].Status_Cnt_u08 Rte_FaultLog_FaultLog.QueueData[110].QueueEventIdx_Cnt_u08 Rte_FaultLog_FaultLog.QueueData[110].Status_Cnt_u08 Rte_FaultLog_FaultLog.QueueData[111].QueueEventIdx_Cnt_u08 Rte_FaultLog_FaultLog.QueueData[111].Status_Cnt_u08 Rte_FaultLog_FaultLog.QueueData[112].QueueEventIdx_Cnt_u08 Rte_FaultLog_FaultLog.QueueData[112].Status_Cnt_u08 Rte_FaultLog_FaultLog.QueueData[113].QueueEventIdx_Cnt_u08 Rte_FaultLog_FaultLog.QueueData[113].Status_Cnt_u08 Rte_FaultLog_FaultLog.QueueData[114].QueueEventIdx_Cnt_u08 Rte_FaultLog_FaultLog.QueueData[114].Status_Cnt_u08 Rte_FaultLog_FaultLog.QueueData[115].QueueEventIdx_Cnt_u08 Rte_FaultLog_FaultLog.QueueData[115].Status_Cnt_u08 Rte_FaultLog_FaultLog.QueueData[116].QueueEventIdx_Cnt_u08 Rte_FaultLog_FaultLog.QueueData[116].Status_Cnt_u08 Rte_FaultLog_FaultLog.QueueData[117].QueueEventIdx_Cnt_u08 Rte_FaultLog_FaultLog.QueueData[117].Status_Cnt_u08 Rte_FaultLog_FaultLog.QueueData[118].QueueEventIdx_Cnt_u08 Rte_FaultLog_FaultLog.QueueData[118].Status_Cnt_u08 Rte_FaultLog_FaultLog.QueueData[119].QueueEventIdx_Cnt_u08 Rte_FaultLog_FaultLog.QueueData[119].Status_Cnt_u08 Rte_FaultLog_FaultLog.QueueData[11].QueueEventIdx_Cnt_u08 Rte_FaultLog_FaultLog.QueueData[11].Status_Cnt_u08 Rte_FaultLog_FaultLog.QueueData[12].QueueEventIdx_Cnt_u08 Rte_FaultLog_FaultLog.QueueData[12].Status_Cnt_u08 Rte_FaultLog_FaultLog.QueueData[13].QueueEventIdx_Cnt_u08 Rte_FaultLog_FaultLog.QueueData[13].Status_Cnt_u08 Rte_FaultLog_FaultLog.QueueData[14].QueueEventIdx_Cnt_u08 Rte_FaultLog_FaultLog.QueueData[14].Status_Cnt_u08 Rte_FaultLog_FaultLog.QueueData[15].QueueEventIdx_Cnt_u08 Rte_FaultLog_FaultLog.QueueData[15].Status_Cnt_u08 Rte_FaultLog_FaultLog.QueueData[16].QueueEventIdx_Cnt_u08 Rte_FaultLog_FaultLog.QueueData[16].Status_Cnt_u08 Rte_FaultLog_FaultLog.QueueData[17].QueueEventIdx_Cnt_u08 Rte_FaultLog_FaultLog.QueueData[17].Status_Cnt_u08 Rte_FaultLog_FaultLog.QueueData[18].QueueEventIdx_Cnt_u08 Rte_FaultLog_FaultLog.QueueData[18].Status_Cnt_u08 Rte_FaultLog_FaultLog.QueueData[19].QueueEventIdx_Cnt_u08 Rte_FaultLog_FaultLog.QueueData[19].Status_Cnt_u08 Rte_FaultLog_FaultLog.QueueData[1].QueueEventIdx_Cnt_u08 Rte_FaultLog_FaultLog.QueueData[1].Status_Cnt_u08 Rte_FaultLog_FaultLog.QueueData[20].QueueEventIdx_Cnt_u08 Rte_FaultLog_FaultLog.QueueData[20].Status_Cnt_u08 Rte_FaultLog_FaultLog.QueueData[21].QueueEventIdx_Cnt_u08 Rte_FaultLog_FaultLog.QueueData[21].Status_Cnt_u08 Rte_FaultLog_FaultLog.QueueData[22].QueueEventIdx_Cnt_u08 Rte_FaultLog_FaultLog.QueueData[22].Status_Cnt_u08 Rte_FaultLog_FaultLog.QueueData[23].QueueEventIdx_Cnt_u08 Rte_FaultLog_FaultLog.QueueData[23].Status_Cnt_u08 Rte_FaultLog_FaultLog.QueueData[24].QueueEventIdx_Cnt_u08 Rte_FaultLog_FaultLog.QueueData[24].Status_Cnt_u08 Rte_FaultLog_FaultLog.QueueData[25].QueueEventIdx_Cnt_u08 Rte_FaultLog_FaultLog.QueueData[25].Status_Cnt_u08 Rte_FaultLog_FaultLog.QueueData[26].QueueEventIdx_Cnt_u08 Rte_FaultLog_FaultLog.QueueData[26].Status_Cnt_u08 Rte_FaultLog_FaultLog.QueueData[27].QueueEventIdx_Cnt_u08 Rte_FaultLog_FaultLog.QueueData[27].Status_Cnt_u08 Rte_FaultLog_FaultLog.QueueData[28].QueueEventIdx_Cnt_u08 Rte_FaultLog_FaultLog.QueueData[28].Status_Cnt_u08 Rte_FaultLog_FaultLog.QueueData[29].QueueEventIdx_Cnt_u08 Rte_FaultLog_FaultLog.QueueData[29].Status_Cnt_u08 Rte_FaultLog_FaultLog.QueueData[2].QueueEventIdx_Cnt_u08 Rte_FaultLog_FaultLog.QueueData[2].Status_Cnt_u08 Rte_FaultLog_FaultLog.QueueData[30].QueueEventIdx_Cnt_u08 Rte_FaultLog_FaultLog.QueueData[30].Status_Cnt_u08 Rte_FaultLog_FaultLog.QueueData[31].QueueEventIdx_Cnt_u08 Rte_FaultLog_FaultLog.QueueData[31].Status_Cnt_u08 Rte_FaultLog_FaultLog.QueueData[32].QueueEventIdx_Cnt_u08 Rte_FaultLog_FaultLog.QueueData[32].Status_Cnt_u08 Rte_FaultLog_FaultLog.QueueData[33].QueueEventIdx_Cnt_u08 Rte_FaultLog_FaultLog.QueueData[33].Status_Cnt_u08 Rte_FaultLog_FaultLog.QueueData[34].QueueEventIdx_Cnt_u08 Rte_FaultLog_FaultLog.QueueData[34].Status_Cnt_u08 Rte_FaultLog_FaultLog.QueueData[35].QueueEventIdx_Cnt_u08 Rte_FaultLog_FaultLog.QueueData[35].Status_Cnt_u08 Rte_FaultLog_FaultLog.QueueData[36].QueueEventIdx_Cnt_u08 Rte_FaultLog_FaultLog.QueueData[36].Status_Cnt_u08 Rte_FaultLog_FaultLog.QueueData[37].QueueEventIdx_Cnt_u08 Rte_FaultLog_FaultLog.QueueData[37].Status_Cnt_u08 Rte_FaultLog_FaultLog.QueueData[38].QueueEventIdx_Cnt_u08 Rte_FaultLog_FaultLog.QueueData[38].Status_Cnt_u08 Rte_FaultLog_FaultLog.QueueData[39].QueueEventIdx_Cnt_u08 Rte_FaultLog_FaultLog.QueueData[39].Status_Cnt_u08 Rte_FaultLog_FaultLog.QueueData[3].QueueEventIdx_Cnt_u08 Rte_FaultLog_FaultLog.QueueData[3].Status_Cnt_u08 Rte_FaultLog_FaultLog.QueueData[40].QueueEventIdx_Cnt_u08 Rte_FaultLog_FaultLog.QueueData[40].Status_Cnt_u08 Rte_FaultLog_FaultLog.QueueData[41].QueueEventIdx_Cnt_u08 Rte_FaultLog_FaultLog.QueueData[41].Status_Cnt_u08 Rte_FaultLog_FaultLog.QueueData[42].QueueEventIdx_Cnt_u08 Rte_FaultLog_FaultLog.QueueData[42].Status_Cnt_u08 Rte_FaultLog_FaultLog.QueueData[43].QueueEventIdx_Cnt_u08 Rte_FaultLog_FaultLog.QueueData[43].Status_Cnt_u08 Rte_FaultLog_FaultLog.QueueData[44].QueueEventIdx_Cnt_u08 Rte_FaultLog_FaultLog.QueueData[44].Status_Cnt_u08 Rte_FaultLog_FaultLog.QueueData[45].QueueEventIdx_Cnt_u08 Rte_FaultLog_FaultLog.QueueData[45].Status_Cnt_u08 Rte_FaultLog_FaultLog.QueueData[46].QueueEventIdx_Cnt_u08 Rte_FaultLog_FaultLog.QueueData[46].Status_Cnt_u08 Rte_FaultLog_FaultLog.QueueData[47].QueueEventIdx_Cnt_u08 Rte_FaultLog_FaultLog.QueueData[47].Status_Cnt_u08 Rte_FaultLog_FaultLog.QueueData[48].QueueEventIdx_Cnt_u08 Rte_FaultLog_FaultLog.QueueData[48].Status_Cnt_u08 Rte_FaultLog_FaultLog.QueueData[49].QueueEventIdx_Cnt_u08 Rte_FaultLog_FaultLog.QueueData[49].Status_Cnt_u08 Rte_FaultLog_FaultLog.QueueData[4].QueueEventIdx_Cnt_u08 Rte_FaultLog_FaultLog.QueueData[4].Status_Cnt_u08 Rte_FaultLog_FaultLog.QueueData[50].QueueEventIdx_Cnt_u08 Rte_FaultLog_FaultLog.QueueData[50].Status_Cnt_u08 Rte_FaultLog_FaultLog.QueueData[51].QueueEventIdx_Cnt_u08 Rte_FaultLog_FaultLog.QueueData[51].Status_Cnt_u08 Rte_FaultLog_FaultLog.QueueData[52].QueueEventIdx_Cnt_u08 Rte_FaultLog_FaultLog.QueueData[52].Status_Cnt_u08 Rte_FaultLog_FaultLog.QueueData[53].QueueEventIdx_Cnt_u08 Rte_FaultLog_FaultLog.QueueData[53].Status_Cnt_u08 Rte_FaultLog_FaultLog.QueueData[54].QueueEventIdx_Cnt_u08 Rte_FaultLog_FaultLog.QueueData[54].Status_Cnt_u08 Rte_FaultLog_FaultLog.QueueData[55].QueueEventIdx_Cnt_u08 Rte_FaultLog_FaultLog.QueueData[55].Status_Cnt_u08 Rte_FaultLog_FaultLog.QueueData[56].QueueEventIdx_Cnt_u08 Rte_FaultLog_FaultLog.QueueData[56].Status_Cnt_u08 Rte_FaultLog_FaultLog.QueueData[57].QueueEventIdx_Cnt_u08 Rte_FaultLog_FaultLog.QueueData[57].Status_Cnt_u08 Rte_FaultLog_FaultLog.QueueData[58].QueueEventIdx_Cnt_u08 Rte_FaultLog_FaultLog.QueueData[58].Status_Cnt_u08 Rte_FaultLog_FaultLog.QueueData[59].QueueEventIdx_Cnt_u08 Rte_FaultLog_FaultLog.QueueData[59].Status_Cnt_u08 Rte_FaultLog_FaultLog.QueueData[5].QueueEventIdx_Cnt_u08 Rte_FaultLog_FaultLog.QueueData[5].Status_Cnt_u08 Rte_FaultLog_FaultLog.QueueData[60].QueueEventIdx_Cnt_u08 Rte_FaultLog_FaultLog.QueueData[60].Status_Cnt_u08 Rte_FaultLog_FaultLog.QueueData[61].QueueEventIdx_Cnt_u08 Rte_FaultLog_FaultLog.QueueData[61].Status_Cnt_u08 Rte_FaultLog_FaultLog.QueueData[62].QueueEventIdx_Cnt_u08 Rte_FaultLog_FaultLog.QueueData[62].Status_Cnt_u08 Rte_FaultLog_FaultLog.QueueData[63].QueueEventIdx_Cnt_u08 Rte_FaultLog_FaultLog.QueueData[63].Status_Cnt_u08 Rte_FaultLog_FaultLog.QueueData[64].QueueEventIdx_Cnt_u08 Rte_FaultLog_FaultLog.QueueData[64].Status_Cnt_u08 Rte_FaultLog_FaultLog.QueueData[65].QueueEventIdx_Cnt_u08 Rte_FaultLog_FaultLog.QueueData[65].Status_Cnt_u08 Rte_FaultLog_FaultLog.QueueData[66].QueueEventIdx_Cnt_u08 Rte_FaultLog_FaultLog.QueueData[66].Status_Cnt_u08 Rte_FaultLog_FaultLog.QueueData[67].QueueEventIdx_Cnt_u08 Rte_FaultLog_FaultLog.QueueData[67].Status_Cnt_u08 Rte_FaultLog_FaultLog.QueueData[68].QueueEventIdx_Cnt_u08 Rte_FaultLog_FaultLog.QueueData[68].Status_Cnt_u08 Rte_FaultLog_FaultLog.QueueData[69].QueueEventIdx_Cnt_u08 Rte_FaultLog_FaultLog.QueueData[69].Status_Cnt_u08 Rte_FaultLog_FaultLog.QueueData[6].QueueEventIdx_Cnt_u08 Rte_FaultLog_FaultLog.QueueData[6].Status_Cnt_u08 Rte_FaultLog_FaultLog.QueueData[70].QueueEventIdx_Cnt_u08 Rte_FaultLog_FaultLog.QueueData[70].Status_Cnt_u08 Rte_FaultLog_FaultLog.QueueData[71].QueueEventIdx_Cnt_u08 Rte_FaultLog_FaultLog.QueueData[71].Status_Cnt_u08 Rte_FaultLog_FaultLog.QueueData[72].QueueEventIdx_Cnt_u08 Rte_FaultLog_FaultLog.QueueData[72].Status_Cnt_u08 Rte_FaultLog_FaultLog.QueueData[73].QueueEventIdx_Cnt_u08 Rte_FaultLog_FaultLog.QueueData[73].Status_Cnt_u08 Rte_FaultLog_FaultLog.QueueData[74].QueueEventIdx_Cnt_u08 Rte_FaultLog_FaultLog.QueueData[74].Status_Cnt_u08 Rte_FaultLog_FaultLog.QueueData[75].QueueEventIdx_Cnt_u08 Rte_FaultLog_FaultLog.QueueData[75].Status_Cnt_u08 Rte_FaultLog_FaultLog.QueueData[76].QueueEventIdx_Cnt_u08 Rte_FaultLog_FaultLog.QueueData[76].Status_Cnt_u08 Rte_FaultLog_FaultLog.QueueData[77].QueueEventIdx_Cnt_u08 Rte_FaultLog_FaultLog.QueueData[77].Status_Cnt_u08 Rte_FaultLog_FaultLog.QueueData[78].QueueEventIdx_Cnt_u08 Rte_FaultLog_FaultLog.QueueData[78].Status_Cnt_u08 Rte_FaultLog_FaultLog.QueueData[79].QueueEventIdx_Cnt_u08 Rte_FaultLog_FaultLog.QueueData[79].Status_Cnt_u08 Rte_FaultLog_FaultLog.QueueData[7].QueueEventIdx_Cnt_u08 Rte_FaultLog_FaultLog.QueueData[7].Status_Cnt_u08 Rte_FaultLog_FaultLog.QueueData[80].QueueEventIdx_Cnt_u08 Rte_FaultLog_FaultLog.QueueData[80].Status_Cnt_u08 Rte_FaultLog_FaultLog.QueueData[81].QueueEventIdx_Cnt_u08 Rte_FaultLog_FaultLog.QueueData[81].Status_Cnt_u08 Rte_FaultLog_FaultLog.QueueData[82].QueueEventIdx_Cnt_u08 Rte_FaultLog_FaultLog.QueueData[82].Status_Cnt_u08 Rte_FaultLog_FaultLog.QueueData[83].QueueEventIdx_Cnt_u08 Rte_FaultLog_FaultLog.QueueData[83].Status_Cnt_u08 Rte_FaultLog_FaultLog.QueueData[84].QueueEventIdx_Cnt_u08 Rte_FaultLog_FaultLog.QueueData[84].Status_Cnt_u08 Rte_FaultLog_FaultLog.QueueData[85].QueueEventIdx_Cnt_u08 Rte_FaultLog_FaultLog.QueueData[85].Status_Cnt_u08 Rte_FaultLog_FaultLog.QueueData[86].QueueEventIdx_Cnt_u08 Rte_FaultLog_FaultLog.QueueData[86].Status_Cnt_u08 Rte_FaultLog_FaultLog.QueueData[87].QueueEventIdx_Cnt_u08 Rte_FaultLog_FaultLog.QueueData[87].Status_Cnt_u08 Rte_FaultLog_FaultLog.QueueData[88].QueueEventIdx_Cnt_u08 Rte_FaultLog_FaultLog.QueueData[88].Status_Cnt_u08 Rte_FaultLog_FaultLog.QueueData[89].QueueEventIdx_Cnt_u08 Rte_FaultLog_FaultLog.QueueData[89].Status_Cnt_u08 Rte_FaultLog_FaultLog.QueueData[8].QueueEventIdx_Cnt_u08 Rte_FaultLog_FaultLog.QueueData[8].Status_Cnt_u08 Rte_FaultLog_FaultLog.QueueData[90].QueueEventIdx_Cnt_u08 Rte_FaultLog_FaultLog.QueueData[90].Status_Cnt_u08 Rte_FaultLog_FaultLog.QueueData[91].QueueEventIdx_Cnt_u08 Rte_FaultLog_FaultLog.QueueData[91].Status_Cnt_u08 Rte_FaultLog_FaultLog.QueueData[92].QueueEventIdx_Cnt_u08 Rte_FaultLog_FaultLog.QueueData[92].Status_Cnt_u08 Rte_FaultLog_FaultLog.QueueData[93].QueueEventIdx_Cnt_u08 Rte_FaultLog_FaultLog.QueueData[93].Status_Cnt_u08 Rte_FaultLog_FaultLog.QueueData[94].QueueEventIdx_Cnt_u08 Rte_FaultLog_FaultLog.QueueData[94].Status_Cnt_u08 Rte_FaultLog_FaultLog.QueueData[95].QueueEventIdx_Cnt_u08 Rte_FaultLog_FaultLog.QueueData[95].Status_Cnt_u08 Rte_FaultLog_FaultLog.QueueData[96].QueueEventIdx_Cnt_u08 Rte_FaultLog_FaultLog.QueueData[96].Status_Cnt_u08 Rte_FaultLog_FaultLog.QueueData[97].QueueEventIdx_Cnt_u08 Rte_FaultLog_FaultLog.QueueData[97].Status_Cnt_u08 Rte_FaultLog_FaultLog.QueueData[98].QueueEventIdx_Cnt_u08 Rte_FaultLog_FaultLog.QueueData[98].Status_Cnt_u08 Rte_FaultLog_FaultLog.QueueData[99].QueueEventIdx_Cnt_u08 Rte_FaultLog_FaultLog.QueueData[99].Status_Cnt_u08 Rte_FaultLog_FaultLog.QueueData[9].QueueEventIdx_Cnt_u08 Rte_FaultLog_FaultLog.QueueData[9].Status_Cnt_u08 /end REF_MEASUREMENT
/end GROUP
/begin GROUP FaultLog.HandwheelPosition.HwDeg_f32 "MICROSAR RTE" /begin SUB_GROUP /end SUB_GROUP /begin FUNCTION_LIST /end FUNCTION_LIST /begin REF_CHARACTERISTIC /end REF_CHARACTERISTIC /end GROUP
/begin GROUP FaultLog.HandwheelTorque.HwNm_f32 "MICROSAR RTE" /begin SUB_GROUP /end SUB_GROUP /begin FUNCTION_LIST /end FUNCTION_LIST /begin REF_CHARACTERISTIC /end REF_CHARACTERISTIC /end GROUP
/begin GROUP FaultLog.Kilometrage.Cnt_u32 "MICROSAR RTE" /begin SUB_GROUP /end SUB_GROUP /begin FUNCTION_LIST /end FUNCTION_LIST /begin REF_CHARACTERISTIC /end REF_CHARACTERISTIC /end GROUP
/begin GROUP FaultLog.ModeRequirePorts "MICROSAR RTE" /begin SUB_GROUP FaultLog.SystemState.Mode /end SUB_GROUP /begin FUNCTION_LIST /end FUNCTION_LIST /begin REF_CHARACTERISTIC /end REF_CHARACTERISTIC /begin REF_MEASUREMENT /end REF_MEASUREMENT /end GROUP
/begin GROUP FaultLog.MotorTorque.MtrNm_f32 "MICROSAR RTE" /begin SUB_GROUP /end SUB_GROUP /begin FUNCTION_LIST /end FUNCTION_LIST /begin REF_CHARACTERISTIC /end REF_CHARACTERISTIC /end GROUP
/begin GROUP FaultLog.PerInstanceMemories "MICROSAR RTE" /begin SUB_GROUP FaultLog.FaultLog /end SUB_GROUP /begin FUNCTION_LIST /end FUNCTION_LIST /begin REF_CHARACTERISTIC /end REF_CHARACTERISTIC /begin REF_MEASUREMENT /end REF_MEASUREMENT /end GROUP
/begin GROUP FaultLog.PowerSupplies.Cnt_u08 "MICROSAR RTE" /begin SUB_GROUP /end SUB_GROUP /begin FUNCTION_LIST /end FUNCTION_LIST /begin REF_CHARACTERISTIC /end REF_CHARACTERISTIC /begin REF_MEASUREMENT Rte_SrlComDriver_PowerSupplies_Cnt_u08 /end REF_MEASUREMENT /end GROUP
/begin GROUP FaultLog.ReceiverPorts "MICROSAR RTE"
 /begin SUB_GROUP FaultLog.BSIDataMissing.Cnt_lgc FaultLog.BatteryVoltage.Volt_f32 FaultLog.CMMDataMissing.Cnt_lgc FaultLog.CompteurTemporelVehicule.Cnt_u32 FaultLog.ComputerRazGCT.Cnt_u08 FaultLog.CtrlTemp.DegC_f32 FaultLog.EngineState.Cnt_u08 FaultLog.EtatPrincipSev.Cnt_u08 FaultLog.EtatReseauElec.Cnt_u08 FaultLog.HandwheelPosition.HwDeg_f32 FaultLog.HandwheelTorque.HwNm_f32 FaultLog.Kilometrage.Cnt_u32 FaultLog.MotorTorque.MtrNm_f32 FaultLog.PowerSupplies.Cnt_u08 FaultLog.ShuntPosition.Cnt_u08 FaultLog.TxEnabled.Cnt_lgc FaultLog.VehicleSpeed.Kph_f32 /end SUB_GROUP
 /begin FUNCTION_LIST /end FUNCTION_LIST
 /begin REF_CHARACTERISTIC /end REF_CHARACTERISTIC
 /begin REF_MEASUREMENT /end REF_MEASUREMENT
/end GROUP
/begin GROUP FaultLog.ShuntPosition.Cnt_u08 "MICROSAR RTE" /begin SUB_GROUP /end SUB_GROUP /begin FUNCTION_LIST /end FUNCTION_LIST /begin REF_CHARACTERISTIC /end REF_CHARACTERISTIC /begin REF_MEASUREMENT Rte_SrlComDriver_ShuntPosition_Cnt_u08 /end REF_MEASUREMENT /end GROUP
/begin GROUP FaultLog.SystemState.Mode "MICROSAR RTE" /begin SUB_GROUP /end SUB_GROUP /begin FUNCTION_LIST /end FUNCTION_LIST /begin REF_CHARACTERISTIC /end REF_CHARACTERISTIC /end GROUP
/begin GROUP FaultLog.TxEnabled.Cnt_lgc "MICROSAR RTE" /begin SUB_GROUP /end SUB_GROUP /begin FUNCTION_LIST /end FUNCTION_LIST /begin REF_CHARACTERISTIC /end REF_CHARACTERISTIC /begin REF_MEASUREMENT Rte_SrlComDriver_TxEnabled_Cnt_lgc /end REF_MEASUREMENT /end GROUP
/begin GROUP FaultLog.VehicleSpeed.Kph_f32 "MICROSAR RTE" /begin SUB_GROUP /end SUB_GROUP /begin FUNCTION_LIST /end FUNCTION_LIST /begin REF_CHARACTERISTIC /end REF_CHARACTERISTIC /end GROUP
/begin GROUP FltInjection "MICROSAR RTE" /begin SUB_GROUP FltInjection.ReceiverPorts /end SUB_GROUP /begin FUNCTION_LIST /end FUNCTION_LIST /begin REF_CHARACTERISTIC /end REF_CHARACTERISTIC /begin REF_MEASUREMENT /end REF_MEASUREMENT /end GROUP
/begin GROUP FltInjection.MotorVelCRF.MtrRadpS_f32 "MICROSAR RTE" /begin SUB_GROUP /end SUB_GROUP /begin FUNCTION_LIST /end FUNCTION_LIST /begin REF_CHARACTERISTIC /end REF_CHARACTERISTIC /end GROUP
/begin GROUP FltInjection.ReceiverPorts "MICROSAR RTE" /begin SUB_GROUP FltInjection.MotorVelCRF.MtrRadpS_f32 /end SUB_GROUP /begin FUNCTION_LIST /end FUNCTION_LIST /begin REF_CHARACTERISTIC /end REF_CHARACTERISTIC /begin REF_MEASUREMENT /end REF_MEASUREMENT /end GROUP
/begin GROUP FrqDepDmpnInrtCmp "MICROSAR RTE"
 /begin SUB_GROUP FrqDepDmpnInrtCmp.ModeRequirePorts FrqDepDmpnInrtCmp.ReceiverPorts FrqDepDmpnInrtCmp.SenderPorts /end SUB_GROUP
 /begin FUNCTION_LIST /end FUNCTION_LIST
 /begin REF_CHARACTERISTIC /end REF_CHARACTERISTIC
 /begin REF_MEASUREMENT /end REF_MEASUREMENT
/end GROUP
/begin GROUP FrqDepDmpnInrtCmp.BaseAssistCmd.MtrNm_f32 "MICROSAR RTE" /begin SUB_GROUP /end SUB_GROUP /begin FUNCTION_LIST /end FUNCTION_LIST /begin REF_CHARACTERISTIC /end REF_CHARACTERISTIC /end GROUP
/begin GROUP FrqDepDmpnInrtCmp.CRFMotorVel.MtrRadpS_f32 "MICROSAR RTE" /begin SUB_GROUP /end SUB_GROUP /begin FUNCTION_LIST /end FUNCTION_LIST /begin REF_CHARACTERISTIC /end REF_CHARACTERISTIC /end GROUP
/begin GROUP FrqDepDmpnInrtCmp.FreqDepDmpSrlComSvcDft.Cnt_lgc "MICROSAR RTE" /begin SUB_GROUP /end SUB_GROUP /begin FUNCTION_LIST /end FUNCTION_LIST /begin REF_CHARACTERISTIC /end REF_CHARACTERISTIC /end GROUP
/begin GROUP FrqDepDmpnInrtCmp.FrqDepDmpnInrtCmp.MtrNm_f32 "MICROSAR RTE" /begin SUB_GROUP /end SUB_GROUP /begin FUNCTION_LIST /end FUNCTION_LIST /begin REF_CHARACTERISTIC /end REF_CHARACTERISTIC /end GROUP
/begin GROUP FrqDepDmpnInrtCmp.HwTorque.HwNm_f32 "MICROSAR RTE" /begin SUB_GROUP /end SUB_GROUP /begin FUNCTION_LIST /end FUNCTION_LIST /begin REF_CHARACTERISTIC /end REF_CHARACTERISTIC /end GROUP
/begin GROUP FrqDepDmpnInrtCmp.ModeRequirePorts "MICROSAR RTE" /begin SUB_GROUP FrqDepDmpnInrtCmp.SystemState.Mode /end SUB_GROUP /begin FUNCTION_LIST /end FUNCTION_LIST /begin REF_CHARACTERISTIC /end REF_CHARACTERISTIC /begin REF_MEASUREMENT /end REF_MEASUREMENT /end GROUP
/begin GROUP FrqDepDmpnInrtCmp.ReceiverPorts "MICROSAR RTE"
 /begin SUB_GROUP FrqDepDmpnInrtCmp.BaseAssistCmd.MtrNm_f32 FrqDepDmpnInrtCmp.CRFMotorVel.MtrRadpS_f32 FrqDepDmpnInrtCmp.FreqDepDmpSrlComSvcDft.Cnt_lgc FrqDepDmpnInrtCmp.HwTorque.HwNm_f32 FrqDepDmpnInrtCmp.VehicleLonAccel.KphpS_f32 FrqDepDmpnInrtCmp.VehicleSpeed.Kph_f32 FrqDepDmpnInrtCmp.WIRCmdAmpBlnd.MtrNm_f32 /end SUB_GROUP
 /begin FUNCTION_LIST /end FUNCTION_LIST
 /begin REF_CHARACTERISTIC /end REF_CHARACTERISTIC
 /begin REF_MEASUREMENT /end REF_MEASUREMENT
/end GROUP
/begin GROUP FrqDepDmpnInrtCmp.SenderPorts "MICROSAR RTE" /begin SUB_GROUP FrqDepDmpnInrtCmp.FrqDepDmpnInrtCmp.MtrNm_f32 /end SUB_GROUP /begin FUNCTION_LIST /end FUNCTION_LIST /begin REF_CHARACTERISTIC /end REF_CHARACTERISTIC /begin REF_MEASUREMENT /end REF_MEASUREMENT /end GROUP
/begin GROUP FrqDepDmpnInrtCmp.SystemState.Mode "MICROSAR RTE" /begin SUB_GROUP /end SUB_GROUP /begin FUNCTION_LIST /end FUNCTION_LIST /begin REF_CHARACTERISTIC /end REF_CHARACTERISTIC /end GROUP
/begin GROUP FrqDepDmpnInrtCmp.VehicleLonAccel.KphpS_f32 "MICROSAR RTE" /begin SUB_GROUP /end SUB_GROUP /begin FUNCTION_LIST /end FUNCTION_LIST /begin REF_CHARACTERISTIC /end REF_CHARACTERISTIC /begin REF_MEASUREMENT Rte_FrqDepDmpnInrtCmp_VehicleLonAccel_KphpS_f32 /end REF_MEASUREMENT /end GROUP
/begin GROUP FrqDepDmpnInrtCmp.VehicleSpeed.Kph_f32 "MICROSAR RTE" /begin SUB_GROUP /end SUB_GROUP /begin FUNCTION_LIST /end FUNCTION_LIST /begin REF_CHARACTERISTIC /end REF_CHARACTERISTIC /end GROUP
/begin GROUP FrqDepDmpnInrtCmp.WIRCmdAmpBlnd.MtrNm_f32 "MICROSAR RTE" /begin SUB_GROUP /end SUB_GROUP /begin FUNCTION_LIST /end FUNCTION_LIST /begin REF_CHARACTERISTIC /end REF_CHARACTERISTIC /begin REF_MEASUREMENT Rte_FrqDepDmpnInrtCmp_WIRCmdAmpBlnd_MtrNm_f32 /end REF_MEASUREMENT /end GROUP
/begin GROUP GCCDiag "MICROSAR RTE" /begin SUB_GROUP GCCDiag.ReceiverPorts /end SUB_GROUP /begin FUNCTION_LIST /end FUNCTION_LIST /begin REF_CHARACTERISTIC /end REF_CHARACTERISTIC /begin REF_MEASUREMENT /end REF_MEASUREMENT /end GROUP
/begin GROUP GCCDiag.DftGrossCCDiag.Cnt_lgc "MICROSAR RTE" /begin SUB_GROUP /end SUB_GROUP /begin FUNCTION_LIST /end FUNCTION_LIST /begin REF_CHARACTERISTIC /end REF_CHARACTERISTIC /begin REF_MEASUREMENT Rte_GCCDiag_DftGrossCCDiag_Cnt_lgc /end REF_MEASUREMENT /end GROUP
/begin GROUP GCCDiag.HwTorque.HwNm_f32 "MICROSAR RTE" /begin SUB_GROUP /end SUB_GROUP /begin FUNCTION_LIST /end FUNCTION_LIST /begin REF_CHARACTERISTIC /end REF_CHARACTERISTIC /end GROUP
/begin GROUP GCCDiag.MRFMtrTrqCmdScl.MtrNm_f32 "MICROSAR RTE" /begin SUB_GROUP /end SUB_GROUP /begin FUNCTION_LIST /end FUNCTION_LIST /begin REF_CHARACTERISTIC /end REF_CHARACTERISTIC /end GROUP
/begin GROUP GCCDiag.ReceiverPorts "MICROSAR RTE"
 /begin SUB_GROUP GCCDiag.DftGrossCCDiag.Cnt_lgc GCCDiag.HwTorque.HwNm_f32 GCCDiag.MRFMtrTrqCmdScl.MtrNm_f32 GCCDiag.VehicleSpeed.Kph_f32 /end SUB_GROUP
 /begin FUNCTION_LIST /end FUNCTION_LIST
 /begin REF_CHARACTERISTIC /end REF_CHARACTERISTIC
 /begin REF_MEASUREMENT /end REF_MEASUREMENT
/end GROUP
/begin GROUP GCCDiag.VehicleSpeed.Kph_f32 "MICROSAR RTE" /begin SUB_GROUP /end SUB_GROUP /begin FUNCTION_LIST /end FUNCTION_LIST /begin REF_CHARACTERISTIC /end REF_CHARACTERISTIC /end GROUP
/begin GROUP Gsod "MICROSAR RTE" /begin SUB_GROUP Gsod.ModeRequirePorts Gsod.ReceiverPorts /end SUB_GROUP /begin FUNCTION_LIST /end FUNCTION_LIST /begin REF_CHARACTERISTIC /end REF_CHARACTERISTIC /begin REF_MEASUREMENT /end REF_MEASUREMENT /end GROUP
/begin GROUP Gsod.Ana_Hw_Torque.HwNm_f32 "MICROSAR RTE" /begin SUB_GROUP /end SUB_GROUP /begin FUNCTION_LIST /end FUNCTION_LIST /begin REF_CHARACTERISTIC /end REF_CHARACTERISTIC /begin REF_MEASUREMENT Rte_Gsod_Ana_Hw_Torque_HwNm_f32 /end REF_MEASUREMENT /end GROUP
/begin GROUP Gsod.Corrected_MtrPos.Rev_f32 "MICROSAR RTE" /begin SUB_GROUP /end SUB_GROUP /begin FUNCTION_LIST /end FUNCTION_LIST /begin REF_CHARACTERISTIC /end REF_CHARACTERISTIC /end GROUP
/begin GROUP Gsod.Cum_Mtr_Pos_CRF.Deg_f32 "MICROSAR RTE" /begin SUB_GROUP /end SUB_GROUP /begin FUNCTION_LIST /end FUNCTION_LIST /begin REF_CHARACTERISTIC /end REF_CHARACTERISTIC /end GROUP
/begin GROUP Gsod.ModeRequirePorts "MICROSAR RTE" /begin SUB_GROUP Gsod.SystemState.Mode /end SUB_GROUP /begin FUNCTION_LIST /end FUNCTION_LIST /begin REF_CHARACTERISTIC /end REF_CHARACTERISTIC /begin REF_MEASUREMENT /end REF_MEASUREMENT /end GROUP
/begin GROUP Gsod.MtrElecMech_Polarity.Cnt_s08 "MICROSAR RTE" /begin SUB_GROUP /end SUB_GROUP /begin FUNCTION_LIST /end FUNCTION_LIST /begin REF_CHARACTERISTIC /end REF_CHARACTERISTIC /end GROUP
/begin GROUP Gsod.ReceiverPorts "MICROSAR RTE"
 /begin SUB_GROUP Gsod.Ana_Hw_Torque.HwNm_f32 Gsod.Corrected_MtrPos.Rev_f32 Gsod.Cum_Mtr_Pos_CRF.Deg_f32 Gsod.MtrElecMech_Polarity.Cnt_s08 Gsod.SysC_Ana_Hw_Torque.HwNm_f32 Gsod.SysC_Corrected_MtrPos.Rev_f32 Gsod.SysC_Cum_Mtr_Pos_CRF.Deg_f32 Gsod.SysC_MtrElecMech_Polarity.Cnt_s32 Gsod.SysC_Torque_Cmd_CRF.MtrNm_f32 Gsod.SysC_Torque_Cmd_MRF.MtrNm_f32 Gsod.SysC_Vecu.Volt_f32 Gsod.Torque_Cmd_CRF.MtrNm_f32 Gsod.Torque_Cmd_MRF.MtrNm_f32 Gsod.Vecu.Volt_f32 /end SUB_GROUP
 /begin FUNCTION_LIST /end FUNCTION_LIST
 /begin REF_CHARACTERISTIC /end REF_CHARACTERISTIC
 /begin REF_MEASUREMENT /end REF_MEASUREMENT
/end GROUP
/begin GROUP Gsod.SysC_Ana_Hw_Torque.HwNm_f32 "MICROSAR RTE" /begin SUB_GROUP /end SUB_GROUP /begin FUNCTION_LIST /end FUNCTION_LIST /begin REF_CHARACTERISTIC /end REF_CHARACTERISTIC /begin REF_MEASUREMENT Rte_Gsod_SysC_Ana_Hw_Torque_HwNm_f32 /end REF_MEASUREMENT /end GROUP
/begin GROUP Gsod.SysC_Corrected_MtrPos.Rev_f32 "MICROSAR RTE" /begin SUB_GROUP /end SUB_GROUP /begin FUNCTION_LIST /end FUNCTION_LIST /begin REF_CHARACTERISTIC /end REF_CHARACTERISTIC /end GROUP
/begin GROUP Gsod.SysC_Cum_Mtr_Pos_CRF.Deg_f32 "MICROSAR RTE" /begin SUB_GROUP /end SUB_GROUP /begin FUNCTION_LIST /end FUNCTION_LIST /begin REF_CHARACTERISTIC /end REF_CHARACTERISTIC /end GROUP
/begin GROUP Gsod.SysC_MtrElecMech_Polarity.Cnt_s32 "MICROSAR RTE" /begin SUB_GROUP /end SUB_GROUP /begin FUNCTION_LIST /end FUNCTION_LIST /begin REF_CHARACTERISTIC /end REF_CHARACTERISTIC /begin REF_MEASUREMENT Rte_Polarity_SysC_MtrElecMechPolarity_Cnt_s32 /end REF_MEASUREMENT /end GROUP
/begin GROUP Gsod.SysC_Torque_Cmd_CRF.MtrNm_f32 "MICROSAR RTE" /begin SUB_GROUP /end SUB_GROUP /begin FUNCTION_LIST /end FUNCTION_LIST /begin REF_CHARACTERISTIC /end REF_CHARACTERISTIC /end GROUP
/begin GROUP Gsod.SysC_Torque_Cmd_MRF.MtrNm_f32 "MICROSAR RTE" /begin SUB_GROUP /end SUB_GROUP /begin FUNCTION_LIST /end FUNCTION_LIST /begin REF_CHARACTERISTIC /end REF_CHARACTERISTIC /end GROUP
/begin GROUP Gsod.SysC_Vecu.Volt_f32 "MICROSAR RTE" /begin SUB_GROUP /end SUB_GROUP /begin FUNCTION_LIST /end FUNCTION_LIST /begin REF_CHARACTERISTIC /end REF_CHARACTERISTIC /end GROUP
/begin GROUP Gsod.SystemState.Mode "MICROSAR RTE" /begin SUB_GROUP /end SUB_GROUP /begin FUNCTION_LIST /end FUNCTION_LIST /begin REF_CHARACTERISTIC /end REF_CHARACTERISTIC /end GROUP
/begin GROUP Gsod.Torque_Cmd_CRF.MtrNm_f32 "MICROSAR RTE" /begin SUB_GROUP /end SUB_GROUP /begin FUNCTION_LIST /end FUNCTION_LIST /begin REF_CHARACTERISTIC /end REF_CHARACTERISTIC /end GROUP
/begin GROUP Gsod.Torque_Cmd_MRF.MtrNm_f32 "MICROSAR RTE" /begin SUB_GROUP /end SUB_GROUP /begin FUNCTION_LIST /end FUNCTION_LIST /begin REF_CHARACTERISTIC /end REF_CHARACTERISTIC /end GROUP
/begin GROUP Gsod.Vecu.Volt_f32 "MICROSAR RTE" /begin SUB_GROUP /end SUB_GROUP /begin FUNCTION_LIST /end FUNCTION_LIST /begin REF_CHARACTERISTIC /end REF_CHARACTERISTIC /end GROUP
/begin GROUP HiLoadStall "MICROSAR RTE" /begin SUB_GROUP HiLoadStall.ReceiverPorts HiLoadStall.SenderPorts /end SUB_GROUP /begin FUNCTION_LIST /end FUNCTION_LIST /begin REF_CHARACTERISTIC /end REF_CHARACTERISTIC /begin REF_MEASUREMENT /end REF_MEASUREMENT /end GROUP
/begin GROUP HiLoadStall.AssistStallLimit.MtrNm_f32 "MICROSAR RTE" /begin SUB_GROUP /end SUB_GROUP /begin FUNCTION_LIST /end FUNCTION_LIST /begin REF_CHARACTERISTIC /end REF_CHARACTERISTIC /begin REF_MEASUREMENT Rte_HiLoadStall_AssistStallLimit_MtrNm_f32 /end REF_MEASUREMENT /end GROUP
/begin GROUP HiLoadStall.DftStallLimit.Cnt_lgc "MICROSAR RTE" /begin SUB_GROUP /end SUB_GROUP /begin FUNCTION_LIST /end FUNCTION_LIST /begin REF_CHARACTERISTIC /end REF_CHARACTERISTIC /end GROUP
/begin GROUP HiLoadStall.MtrVelCRF.MtrRadpS_f32 "MICROSAR RTE" /begin SUB_GROUP /end SUB_GROUP /begin FUNCTION_LIST /end FUNCTION_LIST /begin REF_CHARACTERISTIC /end REF_CHARACTERISTIC /end GROUP
/begin GROUP HiLoadStall.PreLimitForStall.MtrNm_f32 "MICROSAR RTE" /begin SUB_GROUP /end SUB_GROUP /begin FUNCTION_LIST /end FUNCTION_LIST /begin REF_CHARACTERISTIC /end REF_CHARACTERISTIC /end GROUP
/begin GROUP HiLoadStall.ReceiverPorts "MICROSAR RTE"
 /begin SUB_GROUP HiLoadStall.DftStallLimit.Cnt_lgc HiLoadStall.MtrVelCRF.MtrRadpS_f32 HiLoadStall.PreLimitForStall.MtrNm_f32 /end SUB_GROUP
 /begin FUNCTION_LIST /end FUNCTION_LIST
 /begin REF_CHARACTERISTIC /end REF_CHARACTERISTIC
 /begin REF_MEASUREMENT /end REF_MEASUREMENT
/end GROUP
/begin GROUP HiLoadStall.SenderPorts "MICROSAR RTE" /begin SUB_GROUP HiLoadStall.AssistStallLimit.MtrNm_f32 /end SUB_GROUP /begin FUNCTION_LIST /end FUNCTION_LIST /begin REF_CHARACTERISTIC /end REF_CHARACTERISTIC /begin REF_MEASUREMENT /end REF_MEASUREMENT /end GROUP
/begin GROUP HighFreqAssist "MICROSAR RTE" /begin SUB_GROUP HighFreqAssist.ReceiverPorts HighFreqAssist.SenderPorts /end SUB_GROUP /begin FUNCTION_LIST /end FUNCTION_LIST /begin REF_CHARACTERISTIC /end REF_CHARACTERISTIC /begin REF_MEASUREMENT /end REF_MEASUREMENT /end GROUP
/begin GROUP HighFreqAssist.HighFreqAssist.MtrNm_f32 "MICROSAR RTE" /begin SUB_GROUP /end SUB_GROUP /begin FUNCTION_LIST /end FUNCTION_LIST /begin REF_CHARACTERISTIC /end REF_CHARACTERISTIC /end GROUP
/begin GROUP HighFreqAssist.HwTorque.HwNm_f32 "MICROSAR RTE" /begin SUB_GROUP /end SUB_GROUP /begin FUNCTION_LIST /end FUNCTION_LIST /begin REF_CHARACTERISTIC /end REF_CHARACTERISTIC /end GROUP
/begin GROUP HighFreqAssist.ReceiverPorts "MICROSAR RTE"
 /begin SUB_GROUP HighFreqAssist.HwTorque.HwNm_f32 HighFreqAssist.VehicleSpeed.Kph_f32 HighFreqAssist.WIRCmdAmpBlnd.MtrNm_f32 /end SUB_GROUP
 /begin FUNCTION_LIST /end FUNCTION_LIST
 /begin REF_CHARACTERISTIC /end REF_CHARACTERISTIC
 /begin REF_MEASUREMENT /end REF_MEASUREMENT
/end GROUP
/begin GROUP HighFreqAssist.SenderPorts "MICROSAR RTE" /begin SUB_GROUP HighFreqAssist.HighFreqAssist.MtrNm_f32 /end SUB_GROUP /begin FUNCTION_LIST /end FUNCTION_LIST /begin REF_CHARACTERISTIC /end REF_CHARACTERISTIC /begin REF_MEASUREMENT /end REF_MEASUREMENT /end GROUP
/begin GROUP HighFreqAssist.VehicleSpeed.Kph_f32 "MICROSAR RTE" /begin SUB_GROUP /end SUB_GROUP /begin FUNCTION_LIST /end FUNCTION_LIST /begin REF_CHARACTERISTIC /end REF_CHARACTERISTIC /end GROUP
/begin GROUP HighFreqAssist.WIRCmdAmpBlnd.MtrNm_f32 "MICROSAR RTE" /begin SUB_GROUP /end SUB_GROUP /begin FUNCTION_LIST /end FUNCTION_LIST /begin REF_CHARACTERISTIC /end REF_CHARACTERISTIC /begin REF_MEASUREMENT Rte_HighFreqAssist_WIRCmdAmpBlnd_MtrNm_f32 /end REF_MEASUREMENT /end GROUP
/begin GROUP HwPwUp "MICROSAR RTE"
 /begin SUB_GROUP HwPwUp.ModeRequirePorts HwPwUp.ReceiverPorts HwPwUp.SenderPorts /end SUB_GROUP
 /begin FUNCTION_LIST /end FUNCTION_LIST
 /begin REF_CHARACTERISTIC /end REF_CHARACTERISTIC
 /begin REF_MEASUREMENT /end REF_MEASUREMENT
/end GROUP
/begin GROUP HwPwUp.ModeRequirePorts "MICROSAR RTE" /begin SUB_GROUP HwPwUp.SystemState.Mode /end SUB_GROUP /begin FUNCTION_LIST /end FUNCTION_LIST /begin REF_CHARACTERISTIC /end REF_CHARACTERISTIC /begin REF_MEASUREMENT /end REF_MEASUREMENT /end GROUP
/begin GROUP HwPwUp.MtrDrvrInitComplete.Cnt_lgc "MICROSAR RTE" /begin SUB_GROUP /end SUB_GROUP /begin FUNCTION_LIST /end FUNCTION_LIST /begin REF_CHARACTERISTIC /end REF_CHARACTERISTIC /begin REF_MEASUREMENT Rte_MtrDrvDiag_MtrDrvrInitComplete_Cnt_lgc /end REF_MEASUREMENT /end GROUP
/begin GROUP HwPwUp.MtrDrvrInitStart.Cnt_lgc "MICROSAR RTE" /begin SUB_GROUP /end SUB_GROUP /begin FUNCTION_LIST /end FUNCTION_LIST /begin REF_CHARACTERISTIC /end REF_CHARACTERISTIC /begin REF_MEASUREMENT Rte_HwPwUp_MtrDrvrInitStart_Cnt_lgc /end REF_MEASUREMENT /end GROUP
/begin GROUP HwPwUp.PwrDiscATestComplete.Cnt_lgc "MICROSAR RTE" /begin SUB_GROUP /end SUB_GROUP /begin FUNCTION_LIST /end FUNCTION_LIST /begin REF_CHARACTERISTIC /end REF_CHARACTERISTIC /end GROUP
/begin GROUP HwPwUp.PwrDiscATestStart.Cnt_lgc "MICROSAR RTE" /begin SUB_GROUP /end SUB_GROUP /begin FUNCTION_LIST /end FUNCTION_LIST /begin REF_CHARACTERISTIC /end REF_CHARACTERISTIC /end GROUP
/begin GROUP HwPwUp.PwrDiscBTestComplete.Cnt_lgc "MICROSAR RTE" /begin SUB_GROUP /end SUB_GROUP /begin FUNCTION_LIST /end FUNCTION_LIST /begin REF_CHARACTERISTIC /end REF_CHARACTERISTIC /end GROUP
/begin GROUP HwPwUp.PwrDiscBTestStart.Cnt_lgc "MICROSAR RTE" /begin SUB_GROUP /end SUB_GROUP /begin FUNCTION_LIST /end FUNCTION_LIST /begin REF_CHARACTERISTIC /end REF_CHARACTERISTIC /end GROUP
/begin GROUP HwPwUp.ReceiverPorts "MICROSAR RTE"
 /begin SUB_GROUP HwPwUp.MtrDrvrInitComplete.Cnt_lgc HwPwUp.PwrDiscATestComplete.Cnt_lgc HwPwUp.PwrDiscBTestComplete.Cnt_lgc HwPwUp.TMFTestComplete.Cnt_lgc /end SUB_GROUP
 /begin FUNCTION_LIST /end FUNCTION_LIST
 /begin REF_CHARACTERISTIC /end REF_CHARACTERISTIC
 /begin REF_MEASUREMENT /end REF_MEASUREMENT
/end GROUP
/begin GROUP HwPwUp.SenderPorts "MICROSAR RTE"
 /begin SUB_GROUP HwPwUp.MtrDrvrInitStart.Cnt_lgc HwPwUp.PwrDiscATestStart.Cnt_lgc HwPwUp.PwrDiscBTestStart.Cnt_lgc HwPwUp.TMFTestStart.Cnt_lgc /end SUB_GROUP
 /begin FUNCTION_LIST /end FUNCTION_LIST
 /begin REF_CHARACTERISTIC /end REF_CHARACTERISTIC
 /begin REF_MEASUREMENT /end REF_MEASUREMENT
/end GROUP
/begin GROUP HwPwUp.SystemState.Mode "MICROSAR RTE" /begin SUB_GROUP /end SUB_GROUP /begin FUNCTION_LIST /end FUNCTION_LIST /begin REF_CHARACTERISTIC /end REF_CHARACTERISTIC /end GROUP
/begin GROUP HwPwUp.TMFTestComplete.Cnt_lgc "MICROSAR RTE" /begin SUB_GROUP /end SUB_GROUP /begin FUNCTION_LIST /end FUNCTION_LIST /begin REF_CHARACTERISTIC /end REF_CHARACTERISTIC /begin REF_MEASUREMENT Rte_TmprlMon_TMFTestComplete_Cnt_lgc /end REF_MEASUREMENT /end GROUP
/begin GROUP HwPwUp.TMFTestStart.Cnt_lgc "MICROSAR RTE" /begin SUB_GROUP /end SUB_GROUP /begin FUNCTION_LIST /end FUNCTION_LIST /begin REF_CHARACTERISTIC /end REF_CHARACTERISTIC /begin REF_MEASUREMENT Rte_HwPwUp_TMFTestStart_Cnt_lgc /end REF_MEASUREMENT /end GROUP
/begin GROUP HystComp "MICROSAR RTE" /begin SUB_GROUP HystComp.ReceiverPorts HystComp.SenderPorts /end SUB_GROUP /begin FUNCTION_LIST /end FUNCTION_LIST /begin REF_CHARACTERISTIC /end REF_CHARACTERISTIC /begin REF_MEASUREMENT /end REF_MEASUREMENT /end GROUP
/begin GROUP HystComp.AssistMechTempEst.DegC_f32 "MICROSAR RTE" /begin SUB_GROUP /end SUB_GROUP /begin FUNCTION_LIST /end FUNCTION_LIST /begin REF_CHARACTERISTIC /end REF_CHARACTERISTIC /end GROUP
/begin GROUP HystComp.BaseAssistCmd.MtrNm_f32 "MICROSAR RTE" /begin SUB_GROUP /end SUB_GROUP /begin FUNCTION_LIST /end FUNCTION_LIST /begin REF_CHARACTERISTIC /end REF_CHARACTERISTIC /end GROUP
/begin GROUP HystComp.DefeatHystService.Cnt_lgc "MICROSAR RTE" /begin SUB_GROUP /end SUB_GROUP /begin FUNCTION_LIST /end FUNCTION_LIST /begin REF_CHARACTERISTIC /end REF_CHARACTERISTIC /end GROUP
/begin GROUP HystComp.FricOffset.HwNm_f32 "MICROSAR RTE" /begin SUB_GROUP /end SUB_GROUP /begin FUNCTION_LIST /end FUNCTION_LIST /begin REF_CHARACTERISTIC /end REF_CHARACTERISTIC /end GROUP
/begin GROUP HystComp.HwTorque.HwNm_f32 "MICROSAR RTE" /begin SUB_GROUP /end SUB_GROUP /begin FUNCTION_LIST /end FUNCTION_LIST /begin REF_CHARACTERISTIC /end REF_CHARACTERISTIC /end GROUP
/begin GROUP HystComp.HysteresisComp.MtrNm_f32 "MICROSAR RTE" /begin SUB_GROUP /end SUB_GROUP /begin FUNCTION_LIST /end FUNCTION_LIST /begin REF_CHARACTERISTIC /end REF_CHARACTERISTIC /end GROUP
/begin GROUP HystComp.ReceiverPorts "MICROSAR RTE"
 /begin SUB_GROUP HystComp.AssistMechTempEst.DegC_f32 HystComp.BaseAssistCmd.MtrNm_f32 HystComp.DefeatHystService.Cnt_lgc HystComp.FricOffset.HwNm_f32 HystComp.HwTorque.HwNm_f32 HystComp.VehicleSpeed.Kph_f32 HystComp.WIRCmdAmpBlnd.MtrNm_f32 /end SUB_GROUP
 /begin FUNCTION_LIST /end FUNCTION_LIST
 /begin REF_CHARACTERISTIC /end REF_CHARACTERISTIC
 /begin REF_MEASUREMENT /end REF_MEASUREMENT
/end GROUP
/begin GROUP HystComp.SenderPorts "MICROSAR RTE" /begin SUB_GROUP HystComp.HysteresisComp.MtrNm_f32 /end SUB_GROUP /begin FUNCTION_LIST /end FUNCTION_LIST /begin REF_CHARACTERISTIC /end REF_CHARACTERISTIC /begin REF_MEASUREMENT /end REF_MEASUREMENT /end GROUP
/begin GROUP HystComp.VehicleSpeed.Kph_f32 "MICROSAR RTE" /begin SUB_GROUP /end SUB_GROUP /begin FUNCTION_LIST /end FUNCTION_LIST /begin REF_CHARACTERISTIC /end REF_CHARACTERISTIC /end GROUP
/begin GROUP HystComp.WIRCmdAmpBlnd.MtrNm_f32 "MICROSAR RTE" /begin SUB_GROUP /end SUB_GROUP /begin FUNCTION_LIST /end FUNCTION_LIST /begin REF_CHARACTERISTIC /end REF_CHARACTERISTIC /begin REF_MEASUREMENT Rte_HystComp_WIRCmdAmpBlnd_MtrNm_f32 /end REF_MEASUREMENT /end GROUP
/begin GROUP IoHwAb10 "MICROSAR RTE" /begin SUB_GROUP IoHwAb10.ReceiverPorts IoHwAb10.SenderPorts /end SUB_GROUP /begin FUNCTION_LIST /end FUNCTION_LIST /begin REF_CHARACTERISTIC /end REF_CHARACTERISTIC /begin REF_MEASUREMENT /end REF_MEASUREMENT /end GROUP
/begin GROUP IoHwAb10.Batt.Volt_f32 "MICROSAR RTE" /begin SUB_GROUP /end SUB_GROUP /begin FUNCTION_LIST /end FUNCTION_LIST /begin REF_CHARACTERISTIC /end REF_CHARACTERISTIC /end GROUP
/begin GROUP IoHwAb10.BattSwitched.Volt_f32 "MICROSAR RTE" /begin SUB_GROUP /end SUB_GROUP /begin FUNCTION_LIST /end FUNCTION_LIST /begin REF_CHARACTERISTIC /end REF_CHARACTERISTIC /end GROUP
/begin GROUP IoHwAb10.ReceiverPorts "MICROSAR RTE" /begin SUB_GROUP IoHwAb10.SysCVSwitchADC.Cnt_u16 /end SUB_GROUP /begin FUNCTION_LIST /end FUNCTION_LIST /begin REF_CHARACTERISTIC /end REF_CHARACTERISTIC /begin REF_MEASUREMENT /end REF_MEASUREMENT /end GROUP
/begin GROUP IoHwAb10.SenderPorts "MICROSAR RTE"
 /begin SUB_GROUP IoHwAb10.Batt.Volt_f32 IoHwAb10.BattSwitched.Volt_f32 IoHwAb10.SysCVSwitch.Volt_f32 IoHwAb10.TemperatureADC.Volt_f32 /end SUB_GROUP
 /begin FUNCTION_LIST /end FUNCTION_LIST
 /begin REF_CHARACTERISTIC /end REF_CHARACTERISTIC
 /begin REF_MEASUREMENT /end REF_MEASUREMENT
/end GROUP
/begin GROUP IoHwAb10.SysCVSwitch.Volt_f32 "MICROSAR RTE" /begin SUB_GROUP /end SUB_GROUP /begin FUNCTION_LIST /end FUNCTION_LIST /begin REF_CHARACTERISTIC /end REF_CHARACTERISTIC /end GROUP
/begin GROUP IoHwAb10.SysCVSwitchADC.Cnt_u16 "MICROSAR RTE" /begin SUB_GROUP /end SUB_GROUP /begin FUNCTION_LIST /end FUNCTION_LIST /begin REF_CHARACTERISTIC /end REF_CHARACTERISTIC /end GROUP
/begin GROUP IoHwAb10.TemperatureADC.Volt_f32 "MICROSAR RTE" /begin SUB_GROUP /end SUB_GROUP /begin FUNCTION_LIST /end FUNCTION_LIST /begin REF_CHARACTERISTIC /end REF_CHARACTERISTIC /end GROUP
/begin GROUP LmtCod "MICROSAR RTE" /begin SUB_GROUP LmtCod.ReceiverPorts LmtCod.SenderPorts /end SUB_GROUP /begin FUNCTION_LIST /end FUNCTION_LIST /begin REF_CHARACTERISTIC /end REF_CHARACTERISTIC /begin REF_MEASUREMENT /end REF_MEASUREMENT /end GROUP
/begin GROUP LmtCod.AssistEOTGain.Uls_f32 "MICROSAR RTE" /begin SUB_GROUP /end SUB_GROUP /begin FUNCTION_LIST /end FUNCTION_LIST /begin REF_CHARACTERISTIC /end REF_CHARACTERISTIC /end GROUP
/begin GROUP LmtCod.AssistEOTLimit.MtrNm_f32 "MICROSAR RTE" /begin SUB_GROUP /end SUB_GROUP /begin FUNCTION_LIST /end FUNCTION_LIST /begin REF_CHARACTERISTIC /end REF_CHARACTERISTIC /end GROUP
/begin GROUP LmtCod.AssistStallLimit.MtrNm_f32 "MICROSAR RTE" /begin SUB_GROUP /end SUB_GROUP /begin FUNCTION_LIST /end FUNCTION_LIST /begin REF_CHARACTERISTIC /end REF_CHARACTERISTIC /begin REF_MEASUREMENT Rte_HiLoadStall_AssistStallLimit_MtrNm_f32 /end REF_MEASUREMENT /end GROUP
/begin GROUP LmtCod.AssistVehSpdLimit.MtrNm_f32 "MICROSAR RTE" /begin SUB_GROUP /end SUB_GROUP /begin FUNCTION_LIST /end FUNCTION_LIST /begin REF_CHARACTERISTIC /end REF_CHARACTERISTIC /begin REF_MEASUREMENT Rte_VehSpdLmt_AstVehSpdLimit_MtrNm_f32 /end REF_MEASUREMENT /end GROUP
/begin GROUP LmtCod.CCLTrqRamp.Uls_f32 "MICROSAR RTE" /begin SUB_GROUP /end SUB_GROUP /begin FUNCTION_LIST /end FUNCTION_LIST /begin REF_CHARACTERISTIC /end REF_CHARACTERISTIC /begin REF_MEASUREMENT Rte_LmtCod_CCLTrqRamp_Uls_f32 /end REF_MEASUREMENT /end GROUP
/begin GROUP LmtCod.EOTGainLtd.Uls_f32 "MICROSAR RTE" /begin SUB_GROUP /end SUB_GROUP /begin FUNCTION_LIST /end FUNCTION_LIST /begin REF_CHARACTERISTIC /end REF_CHARACTERISTIC /end GROUP
/begin GROUP LmtCod.EOTLimitLtd.MtrNm_f32 "MICROSAR RTE" /begin SUB_GROUP /end SUB_GROUP /begin FUNCTION_LIST /end FUNCTION_LIST /begin REF_CHARACTERISTIC /end REF_CHARACTERISTIC /end GROUP
/begin GROUP LmtCod.OutputRampMult.Uls_f32 "MICROSAR RTE" /begin SUB_GROUP /end SUB_GROUP /begin FUNCTION_LIST /end FUNCTION_LIST /begin REF_CHARACTERISTIC /end REF_CHARACTERISTIC /begin REF_MEASUREMENT Rte_StOpCtrl_OutputRampMult_Uls_f32 /end REF_MEASUREMENT /end GROUP
/begin GROUP LmtCod.OutputRampMultLtd.Uls_f32 "MICROSAR RTE" /begin SUB_GROUP /end SUB_GROUP /begin FUNCTION_LIST /end FUNCTION_LIST /begin REF_CHARACTERISTIC /end REF_CHARACTERISTIC /end GROUP
/begin GROUP LmtCod.ReceiverPorts "MICROSAR RTE"
 /begin SUB_GROUP LmtCod.AssistEOTGain.Uls_f32 LmtCod.AssistEOTLimit.MtrNm_f32 LmtCod.AssistStallLimit.MtrNm_f32 LmtCod.AssistVehSpdLimit.MtrNm_f32 LmtCod.CCLTrqRamp.Uls_f32 LmtCod.OutputRampMult.Uls_f32 LmtCod.ThermalLimit.MtrNm_f32 LmtCod.VehicleSpeed.Kph_f32 /end SUB_GROUP
 /begin FUNCTION_LIST /end FUNCTION_LIST
 /begin REF_CHARACTERISTIC /end REF_CHARACTERISTIC
 /begin REF_MEASUREMENT /end REF_MEASUREMENT
/end GROUP
/begin GROUP LmtCod.SenderPorts "MICROSAR RTE"
 /begin SUB_GROUP LmtCod.EOTGainLtd.Uls_f32 LmtCod.EOTLimitLtd.MtrNm_f32 LmtCod.OutputRampMultLtd.Uls_f32 LmtCod.StallLimitLtd.MtrNm_f32 LmtCod.ThermalLimitLtd.MtrNm_f32 LmtCod.VehSpdLimitLtd.MtrNm_f32 /end SUB_GROUP
 /begin FUNCTION_LIST /end FUNCTION_LIST
 /begin REF_CHARACTERISTIC /end REF_CHARACTERISTIC
 /begin REF_MEASUREMENT /end REF_MEASUREMENT
/end GROUP
/begin GROUP LmtCod.StallLimitLtd.MtrNm_f32 "MICROSAR RTE" /begin SUB_GROUP /end SUB_GROUP /begin FUNCTION_LIST /end FUNCTION_LIST /begin REF_CHARACTERISTIC /end REF_CHARACTERISTIC /end GROUP
/begin GROUP LmtCod.ThermalLimit.MtrNm_f32 "MICROSAR RTE" /begin SUB_GROUP /end SUB_GROUP /begin FUNCTION_LIST /end FUNCTION_LIST /begin REF_CHARACTERISTIC /end REF_CHARACTERISTIC /begin REF_MEASUREMENT Rte_ThrmlDutyCycle_ThermalLimit_MtrNm_f32 /end REF_MEASUREMENT /end GROUP
/begin GROUP LmtCod.ThermalLimitLtd.MtrNm_f32 "MICROSAR RTE" /begin SUB_GROUP /end SUB_GROUP /begin FUNCTION_LIST /end FUNCTION_LIST /begin REF_CHARACTERISTIC /end REF_CHARACTERISTIC /end GROUP
/begin GROUP LmtCod.VehSpdLimitLtd.MtrNm_f32 "MICROSAR RTE" /begin SUB_GROUP /end SUB_GROUP /begin FUNCTION_LIST /end FUNCTION_LIST /begin REF_CHARACTERISTIC /end REF_CHARACTERISTIC /end GROUP
/begin GROUP LmtCod.VehicleSpeed.Kph_f32 "MICROSAR RTE" /begin SUB_GROUP /end SUB_GROUP /begin FUNCTION_LIST /end FUNCTION_LIST /begin REF_CHARACTERISTIC /end REF_CHARACTERISTIC /end GROUP
/begin GROUP LrnEOT "MICROSAR RTE"
 /begin SUB_GROUP LrnEOT.PerInstanceMemories LrnEOT.ReceiverPorts LrnEOT.SenderPorts /end SUB_GROUP
 /begin FUNCTION_LIST /end FUNCTION_LIST
 /begin REF_CHARACTERISTIC /end REF_CHARACTERISTIC
 /begin REF_MEASUREMENT /end REF_MEASUREMENT
/end GROUP
/begin GROUP LrnEOT.CCWFound.Cnt_lgc "MICROSAR RTE" /begin SUB_GROUP /end SUB_GROUP /begin FUNCTION_LIST /end FUNCTION_LIST /begin REF_CHARACTERISTIC /end REF_CHARACTERISTIC /end GROUP
/begin GROUP LrnEOT.CCWPosition.HwDeg_f32 "MICROSAR RTE" /begin SUB_GROUP /end SUB_GROUP /begin FUNCTION_LIST /end FUNCTION_LIST /begin REF_CHARACTERISTIC /end REF_CHARACTERISTIC /end GROUP
/begin GROUP LrnEOT.CWFound.Cnt_lgc "MICROSAR RTE" /begin SUB_GROUP /end SUB_GROUP /begin FUNCTION_LIST /end FUNCTION_LIST /begin REF_CHARACTERISTIC /end REF_CHARACTERISTIC /end GROUP
/begin GROUP LrnEOT.CWPosition.HwDeg_f32 "MICROSAR RTE" /begin SUB_GROUP /end SUB_GROUP /begin FUNCTION_LIST /end FUNCTION_LIST /begin REF_CHARACTERISTIC /end REF_CHARACTERISTIC /end GROUP
/begin GROUP LrnEOT.DiagStsHwPosDis.Cnt_lgc "MICROSAR RTE" /begin SUB_GROUP /end SUB_GROUP /begin FUNCTION_LIST /end FUNCTION_LIST /begin REF_CHARACTERISTIC /end REF_CHARACTERISTIC /end GROUP
/begin GROUP LrnEOT.HandwheelAuthority.Uls_f32 "MICROSAR RTE" /begin SUB_GROUP /end SUB_GROUP /begin FUNCTION_LIST /end FUNCTION_LIST /begin REF_CHARACTERISTIC /end REF_CHARACTERISTIC /end GROUP
/begin GROUP LrnEOT.HandwheelPosition.HwDeg_f32 "MICROSAR RTE" /begin SUB_GROUP /end SUB_GROUP /begin FUNCTION_LIST /end FUNCTION_LIST /begin REF_CHARACTERISTIC /end REF_CHARACTERISTIC /end GROUP
/begin GROUP LrnEOT.HwTorque.HwNm_f32 "MICROSAR RTE" /begin SUB_GROUP /end SUB_GROUP /begin FUNCTION_LIST /end FUNCTION_LIST /begin REF_CHARACTERISTIC /end REF_CHARACTERISTIC /end GROUP
/begin GROUP LrnEOT.LearnedEOT "MICROSAR RTE" /begin SUB_GROUP /end SUB_GROUP /begin FUNCTION_LIST /end FUNCTION_LIST /begin REF_CHARACTERISTIC /end REF_CHARACTERISTIC
 /begin REF_MEASUREMENT Rte_LrnEOT_LearnedEOT.CCWEOTFound_Cnt_lgc Rte_LrnEOT_LearnedEOT.CCWEOTPosition_HwDeg_f32 Rte_LrnEOT_LearnedEOT.CWEOTFound_Cnt_lgc Rte_LrnEOT_LearnedEOT.CWEOTPosition_HwDeg_f32 /end REF_MEASUREMENT
/end GROUP
/begin GROUP LrnEOT.MtrVelCRF.MtrRadpS_f32 "MICROSAR RTE" /begin SUB_GROUP /end SUB_GROUP /begin FUNCTION_LIST /end FUNCTION_LIST /begin REF_CHARACTERISTIC /end REF_CHARACTERISTIC /end GROUP
/begin GROUP LrnEOT.PerInstanceMemories "MICROSAR RTE" /begin SUB_GROUP LrnEOT.LearnedEOT /end SUB_GROUP /begin FUNCTION_LIST /end FUNCTION_LIST /begin REF_CHARACTERISTIC /end REF_CHARACTERISTIC /begin REF_MEASUREMENT /end REF_MEASUREMENT /end GROUP
/begin GROUP LrnEOT.ReceiverPorts "MICROSAR RTE"
 /begin SUB_GROUP LrnEOT.DiagStsHwPosDis.Cnt_lgc LrnEOT.HandwheelAuthority.Uls_f32 LrnEOT.HandwheelPosition.HwDeg_f32 LrnEOT.HwTorque.HwNm_f32 LrnEOT.MtrVelCRF.MtrRadpS_f32 /end SUB_GROUP
 /begin FUNCTION_LIST /end FUNCTION_LIST
 /begin REF_CHARACTERISTIC /end REF_CHARACTERISTIC
 /begin REF_MEASUREMENT /end REF_MEASUREMENT
/end GROUP
/begin GROUP LrnEOT.SenderPorts "MICROSAR RTE"
 /begin SUB_GROUP LrnEOT.CCWFound.Cnt_lgc LrnEOT.CCWPosition.HwDeg_f32 LrnEOT.CWFound.Cnt_lgc LrnEOT.CWPosition.HwDeg_f32 /end SUB_GROUP
 /begin FUNCTION_LIST /end FUNCTION_LIST
 /begin REF_CHARACTERISTIC /end REF_CHARACTERISTIC
 /begin REF_MEASUREMENT /end REF_MEASUREMENT
/end GROUP
/begin GROUP MtrDrvDiag "MICROSAR RTE"
 /begin SUB_GROUP MtrDrvDiag.ModeRequirePorts MtrDrvDiag.ReceiverPorts MtrDrvDiag.SenderPorts /end SUB_GROUP
 /begin FUNCTION_LIST /end FUNCTION_LIST
 /begin REF_CHARACTERISTIC /end REF_CHARACTERISTIC
 /begin REF_MEASUREMENT /end REF_MEASUREMENT
/end GROUP
/begin GROUP MtrDrvDiag.FETFaultPhase.Cnt_enum "MICROSAR RTE" /begin SUB_GROUP /end SUB_GROUP /begin FUNCTION_LIST /end FUNCTION_LIST /begin REF_CHARACTERISTIC /end REF_CHARACTERISTIC /begin REF_MEASUREMENT Rte_MtrDrvDiag_FETFaultPhase_Cnt_enum /end REF_MEASUREMENT /end GROUP
/begin GROUP MtrDrvDiag.FETFaultType.Cnt_enum "MICROSAR RTE" /begin SUB_GROUP /end SUB_GROUP /begin FUNCTION_LIST /end FUNCTION_LIST /begin REF_CHARACTERISTIC /end REF_CHARACTERISTIC /begin REF_MEASUREMENT Rte_MtrDrvDiag_FETFaultType_Cnt_enum /end REF_MEASUREMENT /end GROUP
/begin GROUP MtrDrvDiag.ModeRequirePorts "MICROSAR RTE" /begin SUB_GROUP MtrDrvDiag.SystemState.Mode /end SUB_GROUP /begin FUNCTION_LIST /end FUNCTION_LIST /begin REF_CHARACTERISTIC /end REF_CHARACTERISTIC /begin REF_MEASUREMENT /end REF_MEASUREMENT /end GROUP
/begin GROUP MtrDrvDiag.MtrDrvrInitComplete.Cnt_lgc "MICROSAR RTE" /begin SUB_GROUP /end SUB_GROUP /begin FUNCTION_LIST /end FUNCTION_LIST /begin REF_CHARACTERISTIC /end REF_CHARACTERISTIC /begin REF_MEASUREMENT Rte_MtrDrvDiag_MtrDrvrInitComplete_Cnt_lgc /end REF_MEASUREMENT /end GROUP
/begin GROUP MtrDrvDiag.MtrDrvrInitStart.Cnt_lgc "MICROSAR RTE" /begin SUB_GROUP /end SUB_GROUP /begin FUNCTION_LIST /end FUNCTION_LIST /begin REF_CHARACTERISTIC /end REF_CHARACTERISTIC /begin REF_MEASUREMENT Rte_HwPwUp_MtrDrvrInitStart_Cnt_lgc /end REF_MEASUREMENT /end GROUP
/begin GROUP MtrDrvDiag.ReceiverPorts "MICROSAR RTE"
 /begin SUB_GROUP MtrDrvDiag.MtrDrvrInitStart.Cnt_lgc MtrDrvDiag.VswitchClosed.Cnt_lgc /end SUB_GROUP
 /begin FUNCTION_LIST /end FUNCTION_LIST
 /begin REF_CHARACTERISTIC /end REF_CHARACTERISTIC
 /begin REF_MEASUREMENT /end REF_MEASUREMENT
/end GROUP
/begin GROUP MtrDrvDiag.SenderPorts "MICROSAR RTE"
 /begin SUB_GROUP MtrDrvDiag.FETFaultPhase.Cnt_enum MtrDrvDiag.FETFaultType.Cnt_enum MtrDrvDiag.MtrDrvrInitComplete.Cnt_lgc /end SUB_GROUP
 /begin FUNCTION_LIST /end FUNCTION_LIST
 /begin REF_CHARACTERISTIC /end REF_CHARACTERISTIC
 /begin REF_MEASUREMENT /end REF_MEASUREMENT
/end GROUP
/begin GROUP MtrDrvDiag.SystemState.Mode "MICROSAR RTE" /begin SUB_GROUP /end SUB_GROUP /begin FUNCTION_LIST /end FUNCTION_LIST /begin REF_CHARACTERISTIC /end REF_CHARACTERISTIC /end GROUP
/begin GROUP MtrDrvDiag.VswitchClosed.Cnt_lgc "MICROSAR RTE" /begin SUB_GROUP /end SUB_GROUP /begin FUNCTION_LIST /end FUNCTION_LIST /begin REF_CHARACTERISTIC /end REF_CHARACTERISTIC /end GROUP
/begin GROUP MtrTempEst "MICROSAR RTE" /begin SUB_GROUP MtrTempEst.ReceiverPorts MtrTempEst.SenderPorts /end SUB_GROUP /begin FUNCTION_LIST /end FUNCTION_LIST /begin REF_CHARACTERISTIC /end REF_CHARACTERISTIC /begin REF_MEASUREMENT /end REF_MEASUREMENT /end GROUP
/begin GROUP MtrTempEst.AmbTemp.DegC_f32 "MICROSAR RTE" /begin SUB_GROUP /end SUB_GROUP /begin FUNCTION_LIST /end FUNCTION_LIST /begin REF_CHARACTERISTIC /end REF_CHARACTERISTIC /begin REF_MEASUREMENT Rte_MtrTempEst_AmbTemp_DegC_f32 /end REF_MEASUREMENT /end GROUP
/begin GROUP MtrTempEst.AssistMechTempEst.DegC_f32 "MICROSAR RTE" /begin SUB_GROUP /end SUB_GROUP /begin FUNCTION_LIST /end FUNCTION_LIST /begin REF_CHARACTERISTIC /end REF_CHARACTERISTIC /end GROUP
/begin GROUP MtrTempEst.CtrlTempFinal.DegC_f32 "MICROSAR RTE" /begin SUB_GROUP /end SUB_GROUP /begin FUNCTION_LIST /end FUNCTION_LIST /begin REF_CHARACTERISTIC /end REF_CHARACTERISTIC /end GROUP
/begin GROUP MtrTempEst.CuTempEst.DegC_f32 "MICROSAR RTE" /begin SUB_GROUP /end SUB_GROUP /begin FUNCTION_LIST /end FUNCTION_LIST /begin REF_CHARACTERISTIC /end REF_CHARACTERISTIC /end GROUP
/begin GROUP MtrTempEst.EngTemp.DegC_f32 "MICROSAR RTE" /begin SUB_GROUP /end SUB_GROUP /begin FUNCTION_LIST /end FUNCTION_LIST /begin REF_CHARACTERISTIC /end REF_CHARACTERISTIC /begin REF_MEASUREMENT Rte_MtrTempEst_EngTemp_DegC_f32 /end REF_MEASUREMENT /end GROUP
/begin GROUP MtrTempEst.EstPkCurr.AmpSq_f32 "MICROSAR RTE" /begin SUB_GROUP /end SUB_GROUP /begin FUNCTION_LIST /end FUNCTION_LIST /begin REF_CHARACTERISTIC /end REF_CHARACTERISTIC /begin REF_MEASUREMENT Rte_PeakCurrEst_EstPkCurr_AmpSq_f32 /end REF_MEASUREMENT /end GROUP
/begin GROUP MtrTempEst.HwVel.HwRadpS_f32 "MICROSAR RTE" /begin SUB_GROUP /end SUB_GROUP /begin FUNCTION_LIST /end FUNCTION_LIST /begin REF_CHARACTERISTIC /end REF_CHARACTERISTIC /end GROUP
/begin GROUP MtrTempEst.MagTempEst.DegC_f32 "MICROSAR RTE" /begin SUB_GROUP /end SUB_GROUP /begin FUNCTION_LIST /end FUNCTION_LIST /begin REF_CHARACTERISTIC /end REF_CHARACTERISTIC /end GROUP
/begin GROUP MtrTempEst.ReceiverPorts "MICROSAR RTE"
 /begin SUB_GROUP MtrTempEst.AmbTemp.DegC_f32 MtrTempEst.CtrlTempFinal.DegC_f32 MtrTempEst.EngTemp.DegC_f32 MtrTempEst.EstPkCurr.AmpSq_f32 MtrTempEst.HwVel.HwRadpS_f32 MtrTempEst.ScomAMDefeat.Cnt_lgc MtrTempEst.ScomTempDataRcvd.Cnt_lgc /end SUB_GROUP
 /begin FUNCTION_LIST /end FUNCTION_LIST
 /begin REF_CHARACTERISTIC /end REF_CHARACTERISTIC
 /begin REF_MEASUREMENT /end REF_MEASUREMENT
/end GROUP
/begin GROUP MtrTempEst.ScomAMDefeat.Cnt_lgc "MICROSAR RTE" /begin SUB_GROUP /end SUB_GROUP /begin FUNCTION_LIST /end FUNCTION_LIST /begin REF_CHARACTERISTIC /end REF_CHARACTERISTIC /begin REF_MEASUREMENT Rte_MtrTempEst_ScomAMDefeat_Cnt_lgc /end REF_MEASUREMENT /end GROUP
/begin GROUP MtrTempEst.ScomTempDataRcvd.Cnt_lgc "MICROSAR RTE" /begin SUB_GROUP /end SUB_GROUP /begin FUNCTION_LIST /end FUNCTION_LIST /begin REF_CHARACTERISTIC /end REF_CHARACTERISTIC /begin REF_MEASUREMENT Rte_MtrTempEst_ScomTempDataRcvd_Cnt_lgc /end REF_MEASUREMENT /end GROUP
/begin GROUP MtrTempEst.SenderPorts "MICROSAR RTE"
 /begin SUB_GROUP MtrTempEst.AssistMechTempEst.DegC_f32 MtrTempEst.CuTempEst.DegC_f32 MtrTempEst.MagTempEst.DegC_f32 MtrTempEst.SiTempEst.DegC_f32 /end SUB_GROUP
 /begin FUNCTION_LIST /end FUNCTION_LIST
 /begin REF_CHARACTERISTIC /end REF_CHARACTERISTIC
 /begin REF_MEASUREMENT /end REF_MEASUREMENT
/end GROUP
/begin GROUP MtrTempEst.SiTempEst.DegC_f32 "MICROSAR RTE" /begin SUB_GROUP /end SUB_GROUP /begin FUNCTION_LIST /end FUNCTION_LIST /begin REF_CHARACTERISTIC /end REF_CHARACTERISTIC /end GROUP
/begin GROUP MtrVel "MICROSAR RTE" /begin SUB_GROUP MtrVel.ReceiverPorts MtrVel.SenderPorts /end SUB_GROUP /begin FUNCTION_LIST /end FUNCTION_LIST /begin REF_CHARACTERISTIC /end REF_CHARACTERISTIC /begin REF_MEASUREMENT /end REF_MEASUREMENT /end GROUP
/begin GROUP MtrVel.AsstAssemblyPolarity.Cnt_s08 "MICROSAR RTE" /begin SUB_GROUP /end SUB_GROUP /begin FUNCTION_LIST /end FUNCTION_LIST /begin REF_CHARACTERISTIC /end REF_CHARACTERISTIC /end GROUP
/begin GROUP MtrVel.HandwheelVel.HwRadpS_f32 "MICROSAR RTE" /begin SUB_GROUP /end SUB_GROUP /begin FUNCTION_LIST /end FUNCTION_LIST /begin REF_CHARACTERISTIC /end REF_CHARACTERISTIC /end GROUP
/begin GROUP MtrVel.HwVelValid.Cnt_lgc "MICROSAR RTE" /begin SUB_GROUP /end SUB_GROUP /begin FUNCTION_LIST /end FUNCTION_LIST /begin REF_CHARACTERISTIC /end REF_CHARACTERISTIC /begin REF_MEASUREMENT Rte_MtrVel_HwVelValid_Cnt_lgc /end REF_MEASUREMENT /end GROUP
/begin GROUP MtrVel.MechMtrPos2.Rev_u0p16 "MICROSAR RTE" /begin SUB_GROUP /end SUB_GROUP /begin FUNCTION_LIST /end FUNCTION_LIST /begin REF_CHARACTERISTIC /end REF_CHARACTERISTIC /end GROUP
/begin GROUP MtrVel.MechMtrPos2Timestamp.USec_u32 "MICROSAR RTE" /begin SUB_GROUP /end SUB_GROUP /begin FUNCTION_LIST /end FUNCTION_LIST /begin REF_CHARACTERISTIC /end REF_CHARACTERISTIC /end GROUP
/begin GROUP MtrVel.MotorVelCRF.MtrRadpS_f32 "MICROSAR RTE" /begin SUB_GROUP /end SUB_GROUP /begin FUNCTION_LIST /end FUNCTION_LIST /begin REF_CHARACTERISTIC /end REF_CHARACTERISTIC /end GROUP
/begin GROUP MtrVel.MotorVelMRF.MtrRadpS_f32 "MICROSAR RTE" /begin SUB_GROUP /end SUB_GROUP /begin FUNCTION_LIST /end FUNCTION_LIST /begin REF_CHARACTERISTIC /end REF_CHARACTERISTIC /end GROUP
/begin GROUP MtrVel.ReceiverPorts "MICROSAR RTE"
 /begin SUB_GROUP MtrVel.AsstAssemblyPolarity.Cnt_s08 MtrVel.MechMtrPos2.Rev_u0p16 MtrVel.MechMtrPos2Timestamp.USec_u32 MtrVel.SysCDiagHwVel.HwRadpS_f32 MtrVel.SysCDiagMtrVelMRF.MtrRadpS_f32 /end SUB_GROUP
 /begin FUNCTION_LIST /end FUNCTION_LIST
 /begin REF_CHARACTERISTIC /end REF_CHARACTERISTIC
 /begin REF_MEASUREMENT /end REF_MEASUREMENT
/end GROUP
/begin GROUP MtrVel.SenderPorts "MICROSAR RTE"
 /begin SUB_GROUP MtrVel.HandwheelVel.HwRadpS_f32 MtrVel.HwVelValid.Cnt_lgc MtrVel.MotorVelCRF.MtrRadpS_f32 MtrVel.MotorVelMRF.MtrRadpS_f32 MtrVel.SysCHandwheelVel.HwRadpS_f32 MtrVel.SysCMotorVelMRF.MtrRadpS_f32 /end SUB_GROUP
 /begin FUNCTION_LIST /end FUNCTION_LIST
 /begin REF_CHARACTERISTIC /end REF_CHARACTERISTIC
 /begin REF_MEASUREMENT /end REF_MEASUREMENT
/end GROUP
/begin GROUP MtrVel.SysCDiagHwVel.HwRadpS_f32 "MICROSAR RTE" /begin SUB_GROUP /end SUB_GROUP /begin FUNCTION_LIST /end FUNCTION_LIST /begin REF_CHARACTERISTIC /end REF_CHARACTERISTIC /begin REF_MEASUREMENT Rte_MtrVel2_SysCDiagHwVel_HwRadpS_f32 /end REF_MEASUREMENT /end GROUP
/begin GROUP MtrVel.SysCDiagMtrVelMRF.MtrRadpS_f32 "MICROSAR RTE" /begin SUB_GROUP /end SUB_GROUP /begin FUNCTION_LIST /end FUNCTION_LIST /begin REF_CHARACTERISTIC /end REF_CHARACTERISTIC /begin REF_MEASUREMENT Rte_MtrVel2_SysCDiagMtrVelMRF_MtrRadpS_f32 /end REF_MEASUREMENT /end GROUP
/begin GROUP MtrVel.SysCHandwheelVel.HwRadpS_f32 "MICROSAR RTE" /begin SUB_GROUP /end SUB_GROUP /begin FUNCTION_LIST /end FUNCTION_LIST /begin REF_CHARACTERISTIC /end REF_CHARACTERISTIC /begin REF_MEASUREMENT Rte_MtrVel_SysCHandwheelVel_HwRadpS_f32 /end REF_MEASUREMENT /end GROUP
/begin GROUP MtrVel.SysCMotorVelMRF.MtrRadpS_f32 "MICROSAR RTE" /begin SUB_GROUP /end SUB_GROUP /begin FUNCTION_LIST /end FUNCTION_LIST /begin REF_CHARACTERISTIC /end REF_CHARACTERISTIC /begin REF_MEASUREMENT Rte_MtrVel_SysCMotorVelMRF_MtrRadpS_f32 /end REF_MEASUREMENT /end GROUP
/begin GROUP MtrVel2 "MICROSAR RTE" /begin SUB_GROUP MtrVel2.ReceiverPorts MtrVel2.SenderPorts /end SUB_GROUP /begin FUNCTION_LIST /end FUNCTION_LIST /begin REF_CHARACTERISTIC /end REF_CHARACTERISTIC /begin REF_MEASUREMENT /end REF_MEASUREMENT /end GROUP
/begin GROUP MtrVel2.AsstAssemblyPolarity.Cnt_s08 "MICROSAR RTE" /begin SUB_GROUP /end SUB_GROUP /begin FUNCTION_LIST /end FUNCTION_LIST /begin REF_CHARACTERISTIC /end REF_CHARACTERISTIC /end GROUP
/begin GROUP MtrVel2.CumMechMtrPosMRF.Deg_f32 "MICROSAR RTE" /begin SUB_GROUP /end SUB_GROUP /begin FUNCTION_LIST /end FUNCTION_LIST /begin REF_CHARACTERISTIC /end REF_CHARACTERISTIC /end GROUP
/begin GROUP MtrVel2.HandwheelVel.HwRadpS_f32 "MICROSAR RTE" /begin SUB_GROUP /end SUB_GROUP /begin FUNCTION_LIST /end FUNCTION_LIST /begin REF_CHARACTERISTIC /end REF_CHARACTERISTIC /end GROUP
/begin GROUP MtrVel2.MechMtrPos1Timestamp.USec_u32 "MICROSAR RTE" /begin SUB_GROUP /end SUB_GROUP /begin FUNCTION_LIST /end FUNCTION_LIST /begin REF_CHARACTERISTIC /end REF_CHARACTERISTIC /end GROUP
/begin GROUP MtrVel2.MotorVelMRF.MtrRadpS_f32 "MICROSAR RTE" /begin SUB_GROUP /end SUB_GROUP /begin FUNCTION_LIST /end FUNCTION_LIST /begin REF_CHARACTERISTIC /end REF_CHARACTERISTIC /end GROUP
/begin GROUP MtrVel2.ReceiverPorts "MICROSAR RTE"
 /begin SUB_GROUP MtrVel2.AsstAssemblyPolarity.Cnt_s08 MtrVel2.CumMechMtrPosMRF.Deg_f32 MtrVel2.HandwheelVel.HwRadpS_f32 MtrVel2.MechMtrPos1Timestamp.USec_u32 MtrVel2.MotorVelMRF.MtrRadpS_f32 /end SUB_GROUP
 /begin FUNCTION_LIST /end FUNCTION_LIST
 /begin REF_CHARACTERISTIC /end REF_CHARACTERISTIC
 /begin REF_MEASUREMENT /end REF_MEASUREMENT
/end GROUP
/begin GROUP MtrVel2.SenderPorts "MICROSAR RTE"
 /begin SUB_GROUP MtrVel2.SysCDiagHwVel.HwRadpS_f32 MtrVel2.SysCDiagMtrVelMRF.MtrRadpS_f32 /end SUB_GROUP
 /begin FUNCTION_LIST /end FUNCTION_LIST
 /begin REF_CHARACTERISTIC /end REF_CHARACTERISTIC
 /begin REF_MEASUREMENT /end REF_MEASUREMENT
/end GROUP
/begin GROUP MtrVel2.SysCDiagHwVel.HwRadpS_f32 "MICROSAR RTE" /begin SUB_GROUP /end SUB_GROUP /begin FUNCTION_LIST /end FUNCTION_LIST /begin REF_CHARACTERISTIC /end REF_CHARACTERISTIC /begin REF_MEASUREMENT Rte_MtrVel2_SysCDiagHwVel_HwRadpS_f32 /end REF_MEASUREMENT /end GROUP
/begin GROUP MtrVel2.SysCDiagMtrVelMRF.MtrRadpS_f32 "MICROSAR RTE" /begin SUB_GROUP /end SUB_GROUP /begin FUNCTION_LIST /end FUNCTION_LIST /begin REF_CHARACTERISTIC /end REF_CHARACTERISTIC /begin REF_MEASUREMENT Rte_MtrVel2_SysCDiagMtrVelMRF_MtrRadpS_f32 /end REF_MEASUREMENT /end GROUP
/begin GROUP Nhet1 "MICROSAR RTE" /begin SUB_GROUP Nhet1.SenderPorts /end SUB_GROUP /begin FUNCTION_LIST /end FUNCTION_LIST /begin REF_CHARACTERISTIC /end REF_CHARACTERISTIC /begin REF_MEASUREMENT /end REF_MEASUREMENT /end GROUP
/begin GROUP Nhet1.DigHwTrqT1.HwNm_f32 "MICROSAR RTE" /begin SUB_GROUP /end SUB_GROUP /begin FUNCTION_LIST /end FUNCTION_LIST /begin REF_CHARACTERISTIC /end REF_CHARACTERISTIC /end GROUP
/begin GROUP Nhet1.DigHwTrqT2.HwNm_f32 "MICROSAR RTE" /begin SUB_GROUP /end SUB_GROUP /begin FUNCTION_LIST /end FUNCTION_LIST /begin REF_CHARACTERISTIC /end REF_CHARACTERISTIC /end GROUP
/begin GROUP Nhet1.SenderPorts "MICROSAR RTE" /begin SUB_GROUP Nhet1.DigHwTrqT1.HwNm_f32 Nhet1.DigHwTrqT2.HwNm_f32 /end SUB_GROUP /begin FUNCTION_LIST /end FUNCTION_LIST /begin REF_CHARACTERISTIC /end REF_CHARACTERISTIC /begin REF_MEASUREMENT /end REF_MEASUREMENT /end GROUP
/begin GROUP OvrVoltMon "MICROSAR RTE" /begin SUB_GROUP OvrVoltMon.ModeRequirePorts OvrVoltMon.ReceiverPorts /end SUB_GROUP /begin FUNCTION_LIST /end FUNCTION_LIST /begin REF_CHARACTERISTIC /end REF_CHARACTERISTIC /begin REF_MEASUREMENT /end REF_MEASUREMENT /end GROUP
/begin GROUP OvrVoltMon.ModeRequirePorts "MICROSAR RTE" /begin SUB_GROUP OvrVoltMon.SystemState.Mode /end SUB_GROUP /begin FUNCTION_LIST /end FUNCTION_LIST /begin REF_CHARACTERISTIC /end REF_CHARACTERISTIC /begin REF_MEASUREMENT /end REF_MEASUREMENT /end GROUP
/begin GROUP OvrVoltMon.PwrDiscBTestStart.Cnt_lgc "MICROSAR RTE" /begin SUB_GROUP /end SUB_GROUP /begin FUNCTION_LIST /end FUNCTION_LIST /begin REF_CHARACTERISTIC /end REF_CHARACTERISTIC /end GROUP
/begin GROUP OvrVoltMon.ReceiverPorts "MICROSAR RTE" /begin SUB_GROUP OvrVoltMon.PwrDiscBTestStart.Cnt_lgc /end SUB_GROUP /begin FUNCTION_LIST /end FUNCTION_LIST /begin REF_CHARACTERISTIC /end REF_CHARACTERISTIC /begin REF_MEASUREMENT /end REF_MEASUREMENT /end GROUP
/begin GROUP OvrVoltMon.SystemState.Mode "MICROSAR RTE" /begin SUB_GROUP /end SUB_GROUP /begin FUNCTION_LIST /end FUNCTION_LIST /begin REF_CHARACTERISTIC /end REF_CHARACTERISTIC /end GROUP
/begin GROUP PICurrCntrl "MICROSAR RTE"
 /begin SUB_GROUP PICurrCntrl.ModeRequirePorts PICurrCntrl.ReceiverPorts PICurrCntrl.SenderPorts /end SUB_GROUP
 /begin FUNCTION_LIST /end FUNCTION_LIST
 /begin REF_CHARACTERISTIC /end REF_CHARACTERISTIC
 /begin REF_MEASUREMENT /end REF_MEASUREMENT
/end GROUP
/begin GROUP PICurrCntrl.CorrMtrPosElec.Rev_f32 "MICROSAR RTE" /begin SUB_GROUP /end SUB_GROUP /begin FUNCTION_LIST /end FUNCTION_LIST /begin REF_CHARACTERISTIC /end REF_CHARACTERISTIC /end GROUP
/begin GROUP PICurrCntrl.DervLambdaAlphaDiag.Volt_f32 "MICROSAR RTE" /begin SUB_GROUP /end SUB_GROUP /begin FUNCTION_LIST /end FUNCTION_LIST /begin REF_CHARACTERISTIC /end REF_CHARACTERISTIC /begin REF_MEASUREMENT Rte_PICurrCntrl_DervLambdaAlphaDiag_Volt_f32 /end REF_MEASUREMENT /end GROUP
/begin GROUP PICurrCntrl.DervLambdaBetaDiag.Volt_f32 "MICROSAR RTE" /begin SUB_GROUP /end SUB_GROUP /begin FUNCTION_LIST /end FUNCTION_LIST /begin REF_CHARACTERISTIC /end REF_CHARACTERISTIC /begin REF_MEASUREMENT Rte_PICurrCntrl_DervLambdaBetaDiag_Volt_f32 /end REF_MEASUREMENT /end GROUP
/begin GROUP PICurrCntrl.EstKe.VpRadpS_f32 "MICROSAR RTE" /begin SUB_GROUP /end SUB_GROUP /begin FUNCTION_LIST /end FUNCTION_LIST /begin REF_CHARACTERISTIC /end REF_CHARACTERISTIC /end GROUP
/begin GROUP PICurrCntrl.EstR.Ohm_f32 "MICROSAR RTE" /begin SUB_GROUP /end SUB_GROUP /begin FUNCTION_LIST /end FUNCTION_LIST /begin REF_CHARACTERISTIC /end REF_CHARACTERISTIC /end GROUP
/begin GROUP PICurrCntrl.MRFMtrVel.MtrRadpS_f32 "MICROSAR RTE" /begin SUB_GROUP /end SUB_GROUP /begin FUNCTION_LIST /end FUNCTION_LIST /begin REF_CHARACTERISTIC /end REF_CHARACTERISTIC /end GROUP
/begin GROUP PICurrCntrl.ModeRequirePorts "MICROSAR RTE" /begin SUB_GROUP PICurrCntrl.SystemState.Mode /end SUB_GROUP /begin FUNCTION_LIST /end FUNCTION_LIST /begin REF_CHARACTERISTIC /end REF_CHARACTERISTIC /begin REF_MEASUREMENT /end REF_MEASUREMENT /end GROUP
/begin GROUP PICurrCntrl.MtrCurrDaxRef.Amp_f32 "MICROSAR RTE" /begin SUB_GROUP /end SUB_GROUP /begin FUNCTION_LIST /end FUNCTION_LIST /begin REF_CHARACTERISTIC /end REF_CHARACTERISTIC /end GROUP
/begin GROUP PICurrCntrl.ReceiverPorts "MICROSAR RTE"
 /begin SUB_GROUP PICurrCntrl.CorrMtrPosElec.Rev_f32 PICurrCntrl.EstKe.VpRadpS_f32 PICurrCntrl.EstR.Ohm_f32 PICurrCntrl.MRFMtrVel.MtrRadpS_f32 PICurrCntrl.MtrCurrDaxRef.Amp_f32 /end SUB_GROUP
 /begin FUNCTION_LIST /end FUNCTION_LIST
 /begin REF_CHARACTERISTIC /end REF_CHARACTERISTIC
 /begin REF_MEASUREMENT /end REF_MEASUREMENT
/end GROUP
/begin GROUP PICurrCntrl.SenderPorts "MICROSAR RTE"
 /begin SUB_GROUP PICurrCntrl.DervLambdaAlphaDiag.Volt_f32 PICurrCntrl.DervLambdaBetaDiag.Volt_f32 /end SUB_GROUP
 /begin FUNCTION_LIST /end FUNCTION_LIST
 /begin REF_CHARACTERISTIC /end REF_CHARACTERISTIC
 /begin REF_MEASUREMENT /end REF_MEASUREMENT
/end GROUP
/begin GROUP PICurrCntrl.SystemState.Mode "MICROSAR RTE" /begin SUB_GROUP /end SUB_GROUP /begin FUNCTION_LIST /end FUNCTION_LIST /begin REF_CHARACTERISTIC /end REF_CHARACTERISTIC /end GROUP
/begin GROUP PSASH "MICROSAR RTE"
 /begin SUB_GROUP PSASH.ModeRequirePorts PSASH.ReceiverPorts PSASH.SenderPorts /end SUB_GROUP
 /begin FUNCTION_LIST /end FUNCTION_LIST
 /begin REF_CHARACTERISTIC /end REF_CHARACTERISTIC
 /begin REF_MEASUREMENT /end REF_MEASUREMENT
/end GROUP
/begin GROUP PSASH.APAState.Cnt_u08 "MICROSAR RTE" /begin SUB_GROUP /end SUB_GROUP /begin FUNCTION_LIST /end FUNCTION_LIST /begin REF_CHARACTERISTIC /end REF_CHARACTERISTIC /begin REF_MEASUREMENT Rte_PSASH_APAState_Cnt_u08 /end REF_MEASUREMENT /end GROUP
/begin GROUP PSASH.APAStateTransitionCause.Cnt_u08 "MICROSAR RTE" /begin SUB_GROUP /end SUB_GROUP /begin FUNCTION_LIST /end FUNCTION_LIST /begin REF_CHARACTERISTIC /end REF_CHARACTERISTIC /begin REF_MEASUREMENT Rte_PSASH_APAStateTransitionCause_Cnt_u08 /end REF_MEASUREMENT /end GROUP
/begin GROUP PSASH.ApaAuthn.Cnt_lgc "MICROSAR RTE" /begin SUB_GROUP /end SUB_GROUP /begin FUNCTION_LIST /end FUNCTION_LIST /begin REF_CHARACTERISTIC /end REF_CHARACTERISTIC /begin REF_MEASUREMENT Rte_SrlComInput_APAAuthn_Cnt_lgc /end REF_MEASUREMENT /end GROUP
/begin GROUP PSASH.ApaCmdReq.Cnt_lgc "MICROSAR RTE" /begin SUB_GROUP /end SUB_GROUP /begin FUNCTION_LIST /end FUNCTION_LIST /begin REF_CHARACTERISTIC /end REF_CHARACTERISTIC /begin REF_MEASUREMENT Rte_SrlComInput_APARequest_Cnt_lgc /end REF_MEASUREMENT /end GROUP
/begin GROUP PSASH.ApaEna.Cnt_lgc "MICROSAR RTE" /begin SUB_GROUP /end SUB_GROUP /begin FUNCTION_LIST /end FUNCTION_LIST /begin REF_CHARACTERISTIC /end REF_CHARACTERISTIC /end GROUP
/begin GROUP PSASH.ApaRelaxReq.Cnt_lgc "MICROSAR RTE" /begin SUB_GROUP /end SUB_GROUP /begin FUNCTION_LIST /end FUNCTION_LIST /begin REF_CHARACTERISTIC /end REF_CHARACTERISTIC /begin REF_MEASUREMENT Rte_SrlComInput_ApaRelaxReq_Cnt_lgc /end REF_MEASUREMENT /end GROUP
/begin GROUP PSASH.AssistStallLimit.MtrNm_f32 "MICROSAR RTE" /begin SUB_GROUP /end SUB_GROUP /begin FUNCTION_LIST /end FUNCTION_LIST /begin REF_CHARACTERISTIC /end REF_CHARACTERISTIC /begin REF_MEASUREMENT Rte_HiLoadStall_AssistStallLimit_MtrNm_f32 /end REF_MEASUREMENT /end GROUP
/begin GROUP PSASH.CpkOk.Cnt_lgc "MICROSAR RTE" /begin SUB_GROUP /end SUB_GROUP /begin FUNCTION_LIST /end FUNCTION_LIST /begin REF_CHARACTERISTIC /end REF_CHARACTERISTIC /begin REF_MEASUREMENT Rte_SrlComInput_CPKOK_Cnt_lgc /end REF_MEASUREMENT /end GROUP
/begin GROUP PSASH.FTermActv.Cnt_lgc "MICROSAR RTE" /begin SUB_GROUP /end SUB_GROUP /begin FUNCTION_LIST /end FUNCTION_LIST /begin REF_CHARACTERISTIC /end REF_CHARACTERISTIC /end GROUP
/begin GROUP PSASH.HandwheelAuthority.Uls_f32 "MICROSAR RTE" /begin SUB_GROUP /end SUB_GROUP /begin FUNCTION_LIST /end FUNCTION_LIST /begin REF_CHARACTERISTIC /end REF_CHARACTERISTIC /end GROUP
/begin GROUP PSASH.HandwheelPosition.HwDeg_f32 "MICROSAR RTE" /begin SUB_GROUP /end SUB_GROUP /begin FUNCTION_LIST /end FUNCTION_LIST /begin REF_CHARACTERISTIC /end REF_CHARACTERISTIC /end GROUP
/begin GROUP PSASH.HwTorque.HwNm_f32 "MICROSAR RTE" /begin SUB_GROUP /end SUB_GROUP /begin FUNCTION_LIST /end FUNCTION_LIST /begin REF_CHARACTERISTIC /end REF_CHARACTERISTIC /end GROUP
/begin GROUP PSASH.ModeRequirePorts "MICROSAR RTE" /begin SUB_GROUP PSASH.SystemState.Mode /end SUB_GROUP /begin FUNCTION_LIST /end FUNCTION_LIST /begin REF_CHARACTERISTIC /end REF_CHARACTERISTIC /begin REF_MEASUREMENT /end REF_MEASUREMENT /end GROUP
/begin GROUP PSASH.OutputRampMult.Uls_f32 "MICROSAR RTE" /begin SUB_GROUP /end SUB_GROUP /begin FUNCTION_LIST /end FUNCTION_LIST /begin REF_CHARACTERISTIC /end REF_CHARACTERISTIC /begin REF_MEASUREMENT Rte_StOpCtrl_OutputRampMult_Uls_f32 /end REF_MEASUREMENT /end GROUP
/begin GROUP PSASH.PosSrvoEnable.Cnt_lgc "MICROSAR RTE" /begin SUB_GROUP /end SUB_GROUP /begin FUNCTION_LIST /end FUNCTION_LIST /begin REF_CHARACTERISTIC /end REF_CHARACTERISTIC /begin REF_MEASUREMENT Rte_PSASH_PosSrvoEnable_Cnt_lgc /end REF_MEASUREMENT /end GROUP
/begin GROUP PSASH.PosSrvoHwAngle.HwDeg_f32 "MICROSAR RTE" /begin SUB_GROUP /end SUB_GROUP /begin FUNCTION_LIST /end FUNCTION_LIST /begin REF_CHARACTERISTIC /end REF_CHARACTERISTIC /begin REF_MEASUREMENT Rte_SrlComInput_PosSrvoHwAngle_HwDeg_f32 /end REF_MEASUREMENT /end GROUP
/begin GROUP PSASH.PosSrvoNTC.Cnt_lgc "MICROSAR RTE" /begin SUB_GROUP /end SUB_GROUP /begin FUNCTION_LIST /end FUNCTION_LIST /begin REF_CHARACTERISTIC /end REF_CHARACTERISTIC /begin REF_MEASUREMENT Rte_PSATA_PosSrvoNTC_Cnt_lgc /end REF_MEASUREMENT /end GROUP
/begin GROUP PSASH.ReceiverPorts "MICROSAR RTE"
 /begin SUB_GROUP PSASH.ApaAuthn.Cnt_lgc PSASH.ApaCmdReq.Cnt_lgc PSASH.ApaEna.Cnt_lgc PSASH.ApaRelaxReq.Cnt_lgc PSASH.AssistStallLimit.MtrNm_f32 PSASH.CpkOk.Cnt_lgc PSASH.FTermActv.Cnt_lgc PSASH.HandwheelAuthority.Uls_f32 PSASH.HandwheelPosition.HwDeg_f32 PSASH.HwTorque.HwNm_f32 PSASH.OutputRampMult.Uls_f32 PSASH.PosSrvoHwAngle.HwDeg_f32 PSASH.PosSrvoNTC.Cnt_lgc PSASH.ThermLimitPerc.Uls_f32 PSASH.VehicleSpeed.Kph_f32 PSASH.VehicleSpeedValid.Cnt_lgc /end SUB_GROUP
 /begin FUNCTION_LIST /end FUNCTION_LIST
 /begin REF_CHARACTERISTIC /end REF_CHARACTERISTIC
 /begin REF_MEASUREMENT /end REF_MEASUREMENT
/end GROUP
/begin GROUP PSASH.SenderPorts "MICROSAR RTE"
 /begin SUB_GROUP PSASH.APAState.Cnt_u08 PSASH.APAStateTransitionCause.Cnt_u08 PSASH.PosSrvoEnable.Cnt_lgc /end SUB_GROUP
 /begin FUNCTION_LIST /end FUNCTION_LIST
 /begin REF_CHARACTERISTIC /end REF_CHARACTERISTIC
 /begin REF_MEASUREMENT /end REF_MEASUREMENT
/end GROUP
/begin GROUP PSASH.SystemState.Mode "MICROSAR RTE" /begin SUB_GROUP /end SUB_GROUP /begin FUNCTION_LIST /end FUNCTION_LIST /begin REF_CHARACTERISTIC /end REF_CHARACTERISTIC /end GROUP
/begin GROUP PSASH.ThermLimitPerc.Uls_f32 "MICROSAR RTE" /begin SUB_GROUP /end SUB_GROUP /begin FUNCTION_LIST /end FUNCTION_LIST /begin REF_CHARACTERISTIC /end REF_CHARACTERISTIC /end GROUP
/begin GROUP PSASH.VehicleSpeed.Kph_f32 "MICROSAR RTE" /begin SUB_GROUP /end SUB_GROUP /begin FUNCTION_LIST /end FUNCTION_LIST /begin REF_CHARACTERISTIC /end REF_CHARACTERISTIC /end GROUP
/begin GROUP PSASH.VehicleSpeedValid.Cnt_lgc "MICROSAR RTE" /begin SUB_GROUP /end SUB_GROUP /begin FUNCTION_LIST /end FUNCTION_LIST /begin REF_CHARACTERISTIC /end REF_CHARACTERISTIC /end GROUP
/begin GROUP PSATA "MICROSAR RTE" /begin SUB_GROUP PSATA.ReceiverPorts PSATA.SenderPorts /end SUB_GROUP /begin FUNCTION_LIST /end FUNCTION_LIST /begin REF_CHARACTERISTIC /end REF_CHARACTERISTIC /begin REF_MEASUREMENT /end REF_MEASUREMENT /end GROUP
/begin GROUP PSATA.HwTorque.HwNm_f32 "MICROSAR RTE" /begin SUB_GROUP /end SUB_GROUP /begin FUNCTION_LIST /end FUNCTION_LIST /begin REF_CHARACTERISTIC /end REF_CHARACTERISTIC /end GROUP
/begin GROUP PSATA.OpTrqOv.MtrNm_f32 "MICROSAR RTE" /begin SUB_GROUP /end SUB_GROUP /begin FUNCTION_LIST /end FUNCTION_LIST /begin REF_CHARACTERISTIC /end REF_CHARACTERISTIC /end GROUP
/begin GROUP PSATA.PosSrvoCmd.MtrNm_f32 "MICROSAR RTE" /begin SUB_GROUP /end SUB_GROUP /begin FUNCTION_LIST /end FUNCTION_LIST /begin REF_CHARACTERISTIC /end REF_CHARACTERISTIC /begin REF_MEASUREMENT Rte_PosServo_PosSrvoCmd_MtrNm_f32 /end REF_MEASUREMENT /end GROUP
/begin GROUP PSATA.PosSrvoEnable.Cnt_lgc "MICROSAR RTE" /begin SUB_GROUP /end SUB_GROUP /begin FUNCTION_LIST /end FUNCTION_LIST /begin REF_CHARACTERISTIC /end REF_CHARACTERISTIC /begin REF_MEASUREMENT Rte_PSASH_PosSrvoEnable_Cnt_lgc /end REF_MEASUREMENT /end GROUP
/begin GROUP PSATA.PosSrvoNTC.Cnt_lgc "MICROSAR RTE" /begin SUB_GROUP /end SUB_GROUP /begin FUNCTION_LIST /end FUNCTION_LIST /begin REF_CHARACTERISTIC /end REF_CHARACTERISTIC /begin REF_MEASUREMENT Rte_PSATA_PosSrvoNTC_Cnt_lgc /end REF_MEASUREMENT /end GROUP
/begin GROUP PSATA.ReceiverPorts "MICROSAR RTE"
 /begin SUB_GROUP PSATA.HwTorque.HwNm_f32 PSATA.PosSrvoCmd.MtrNm_f32 PSATA.PosSrvoEnable.Cnt_lgc PSATA.VehicleSpeed.Kph_f32 /end SUB_GROUP
 /begin FUNCTION_LIST /end FUNCTION_LIST
 /begin REF_CHARACTERISTIC /end REF_CHARACTERISTIC
 /begin REF_MEASUREMENT /end REF_MEASUREMENT
/end GROUP
/begin GROUP PSATA.SenderPorts "MICROSAR RTE" /begin SUB_GROUP PSATA.OpTrqOv.MtrNm_f32 PSATA.PosSrvoNTC.Cnt_lgc /end SUB_GROUP /begin FUNCTION_LIST /end FUNCTION_LIST /begin REF_CHARACTERISTIC /end REF_CHARACTERISTIC /begin REF_MEASUREMENT /end REF_MEASUREMENT /end GROUP
/begin GROUP PSATA.VehicleSpeed.Kph_f32 "MICROSAR RTE" /begin SUB_GROUP /end SUB_GROUP /begin FUNCTION_LIST /end FUNCTION_LIST /begin REF_CHARACTERISTIC /end REF_CHARACTERISTIC /end GROUP
/begin GROUP PeakCurrEst "MICROSAR RTE"
 /begin SUB_GROUP PeakCurrEst.ModeRequirePorts PeakCurrEst.ReceiverPorts PeakCurrEst.SenderPorts /end SUB_GROUP
 /begin FUNCTION_LIST /end FUNCTION_LIST
 /begin REF_CHARACTERISTIC /end REF_CHARACTERISTIC
 /begin REF_MEASUREMENT /end REF_MEASUREMENT
/end GROUP
/begin GROUP PeakCurrEst.EstPkCurr.AmpSq_f32 "MICROSAR RTE" /begin SUB_GROUP /end SUB_GROUP /begin FUNCTION_LIST /end FUNCTION_LIST /begin REF_CHARACTERISTIC /end REF_CHARACTERISTIC /begin REF_MEASUREMENT Rte_PeakCurrEst_EstPkCurr_AmpSq_f32 /end REF_MEASUREMENT /end GROUP
/begin GROUP PeakCurrEst.FiltEstPkCurr.AmpSq_f32 "MICROSAR RTE" /begin SUB_GROUP /end SUB_GROUP /begin FUNCTION_LIST /end FUNCTION_LIST /begin REF_CHARACTERISTIC /end REF_CHARACTERISTIC /begin REF_MEASUREMENT Rte_PeakCurrEst_FiltEstPkCurr_AmpSq_f32 /end REF_MEASUREMENT /end GROUP
/begin GROUP PeakCurrEst.ModeRequirePorts "MICROSAR RTE" /begin SUB_GROUP PeakCurrEst.SystemState.Mode /end SUB_GROUP /begin FUNCTION_LIST /end FUNCTION_LIST /begin REF_CHARACTERISTIC /end REF_CHARACTERISTIC /begin REF_MEASUREMENT /end REF_MEASUREMENT /end GROUP
/begin GROUP PeakCurrEst.MtrCurrDax.Amp_f32 "MICROSAR RTE" /begin SUB_GROUP /end SUB_GROUP /begin FUNCTION_LIST /end FUNCTION_LIST /begin REF_CHARACTERISTIC /end REF_CHARACTERISTIC /end GROUP
/begin GROUP PeakCurrEst.MtrCurrQax.Amp_f32 "MICROSAR RTE" /begin SUB_GROUP /end SUB_GROUP /begin FUNCTION_LIST /end FUNCTION_LIST /begin REF_CHARACTERISTIC /end REF_CHARACTERISTIC /end GROUP
/begin GROUP PeakCurrEst.ReceiverPorts "MICROSAR RTE"
 /begin SUB_GROUP PeakCurrEst.MtrCurrDax.Amp_f32 PeakCurrEst.MtrCurrQax.Amp_f32 /end SUB_GROUP
 /begin FUNCTION_LIST /end FUNCTION_LIST
 /begin REF_CHARACTERISTIC /end REF_CHARACTERISTIC
 /begin REF_MEASUREMENT /end REF_MEASUREMENT
/end GROUP
/begin GROUP PeakCurrEst.SenderPorts "MICROSAR RTE"
 /begin SUB_GROUP PeakCurrEst.EstPkCurr.AmpSq_f32 PeakCurrEst.FiltEstPkCurr.AmpSq_f32 /end SUB_GROUP
 /begin FUNCTION_LIST /end FUNCTION_LIST
 /begin REF_CHARACTERISTIC /end REF_CHARACTERISTIC
 /begin REF_MEASUREMENT /end REF_MEASUREMENT
/end GROUP
/begin GROUP PeakCurrEst.SystemState.Mode "MICROSAR RTE" /begin SUB_GROUP /end SUB_GROUP /begin FUNCTION_LIST /end FUNCTION_LIST /begin REF_CHARACTERISTIC /end REF_CHARACTERISTIC /end GROUP
/begin GROUP Polarity "MICROSAR RTE"
 /begin SUB_GROUP Polarity.PerInstanceMemories Polarity.ReceiverPorts Polarity.SenderPorts /end SUB_GROUP
 /begin FUNCTION_LIST /end FUNCTION_LIST
 /begin REF_CHARACTERISTIC /end REF_CHARACTERISTIC
 /begin REF_MEASUREMENT /end REF_MEASUREMENT
/end GROUP
/begin GROUP Polarity.AssistAssyPolarity.Cnt_s08 "MICROSAR RTE" /begin SUB_GROUP /end SUB_GROUP /begin FUNCTION_LIST /end FUNCTION_LIST /begin REF_CHARACTERISTIC /end REF_CHARACTERISTIC /end GROUP
/begin GROUP Polarity.DiagAssistAssyPolarity.Cnt_s08 "MICROSAR RTE" /begin SUB_GROUP /end SUB_GROUP /begin FUNCTION_LIST /end FUNCTION_LIST /begin REF_CHARACTERISTIC /end REF_CHARACTERISTIC /end GROUP
/begin GROUP Polarity.SysC_MtrElecMechPolarity.Cnt_s32 "MICROSAR RTE" /begin REF_MEASUREMENT Rte_Polarity_SysC_MtrElecMechPolarity_Cnt_s32 /end REF_MEASUREMENT /end GROUP
/begin GROUP PosServo.PosSrvoCmd.MtrNm_f32 "MICROSAR RTE" /begin REF_MEASUREMENT Rte_PosServo_PosSrvoCmd_MtrNm_f32 /end REF_MEASUREMENT /end GROUP
/begin GROUP PosServo.PosSrvoEnable.Cnt_lgc "MICROSAR RTE" /begin REF_MEASUREMENT Rte_PSASH_PosSrvoEnable_Cnt_lgc /end REF_MEASUREMENT /end GROUP
/begin GROUP PosServo.PosSrvoHwAngle.HwDeg_f32 "MICROSAR RTE" /begin REF_MEASUREMENT Rte_SrlComInput_PosSrvoHwAngle_HwDeg_f32 /end REF_MEASUREMENT /end GROUP
/begin GROUP SrlComDriver.PowerSupplies.Cnt_u08 "MICROSAR RTE" /begin REF_MEASUREMENT Rte_SrlComDriver_PowerSupplies_Cnt_u08 /end REF_MEASUREMENT /end GROUP
/begin GROUP SrlComDriver.ShuntPosition.Cnt_u08 "MICROSAR RTE" /begin REF_MEASUREMENT Rte_SrlComDriver_ShuntPosition_Cnt_u08 /end REF_MEASUREMENT /end GROUP
/begin GROUP SrlComDriver.TMFTestComplete.Cnt_lgc "MICROSAR RTE" /begin REF_MEASUREMENT Rte_TmprlMon_TMFTestComplete_Cnt_lgc /end REF_MEASUREMENT /end GROUP
/begin GROUP SrlComDriver.TxEnabled.Cnt_lgc "MICROSAR RTE" /begin REF_MEASUREMENT Rte_SrlComDriver_TxEnabled_Cnt_lgc /end REF_MEASUREMENT /end GROUP
/begin GROUP SrlComInput.APAAuthn.Cnt_lgc "MICROSAR RTE" /begin REF_MEASUREMENT Rte_SrlComInput_APAAuthn_Cnt_lgc /end REF_MEASUREMENT /end GROUP
/begin GROUP SrlComInput.APARequest.Cnt_lgc "MICROSAR RTE" /begin REF_MEASUREMENT Rte_SrlComInput_APARequest_Cnt_lgc /end REF_MEASUREMENT /end GROUP
/begin GROUP SrlComInput.ApaRelaxReq.Cnt_lgc "MICROSAR RTE" /begin REF_MEASUREMENT Rte_SrlComInput_ApaRelaxReq_Cnt_lgc /end REF_MEASUREMENT /end GROUP
/begin GROUP SrlComInput.CPKOK.Cnt_lgc "MICROSAR RTE" /begin REF_MEASUREMENT Rte_SrlComInput_CPKOK_Cnt_lgc /end REF_MEASUREMENT /end GROUP
/begin GROUP SrlComInput.OutputRampMult.Uls_f32 "MICROSAR RTE" /begin REF_MEASUREMENT Rte_StOpCtrl_OutputRampMult_Uls_f32 /end REF_MEASUREMENT /end GROUP
/begin GROUP SrlComInput.PosSrvoHwAngle.HwDeg_f32 "MICROSAR RTE" /begin REF_MEASUREMENT Rte_SrlComInput_PosSrvoHwAngle_HwDeg_f32 /end REF_MEASUREMENT /end GROUP
/begin GROUP SrlComOutput.APAState.Cnt_u08 "MICROSAR RTE" /begin REF_MEASUREMENT Rte_PSASH_APAState_Cnt_u08 /end REF_MEASUREMENT /end GROUP
/begin GROUP SrlComOutput.APAStateTransitionCause.Cnt_u08 "MICROSAR RTE" /begin REF_MEASUREMENT Rte_PSASH_APAStateTransitionCause_Cnt_u08 /end REF_MEASUREMENT /end GROUP
/begin GROUP SrlComOutput.OutputRampMult.Uls_f32 "MICROSAR RTE" /begin REF_MEASUREMENT Rte_StOpCtrl_OutputRampMult_Uls_f32 /end REF_MEASUREMENT /end GROUP
/begin GROUP StOpCtrl.OutputRampMult.Uls_f32 "MICROSAR RTE" /begin REF_MEASUREMENT Rte_StOpCtrl_OutputRampMult_Uls_f32 /end REF_MEASUREMENT /end GROUP
/begin GROUP StaMd.TMFTestComplete.Cnt_lgc "MICROSAR RTE" /begin REF_MEASUREMENT Rte_TmprlMon_TMFTestComplete_Cnt_lgc /end REF_MEASUREMENT /end GROUP
/begin GROUP StaMd11.TMFTestComplete.Cnt_lgc "MICROSAR RTE" /begin REF_MEASUREMENT Rte_TmprlMon_TMFTestComplete_Cnt_lgc /end REF_MEASUREMENT /end GROUP
/begin GROUP ThrmlDutyCycle.FilteredPkCurr.AmpSq_f32 "MICROSAR RTE" /begin REF_MEASUREMENT Rte_PeakCurrEst_FiltEstPkCurr_AmpSq_f32 /end REF_MEASUREMENT /end GROUP
/begin GROUP ThrmlDutyCycle.MtrPkCurr.AmpSq_f32 "MICROSAR RTE" /begin REF_MEASUREMENT Rte_PeakCurrEst_EstPkCurr_AmpSq_f32 /end REF_MEASUREMENT /end GROUP
/begin GROUP ThrmlDutyCycle.ThermalLimit.MtrNm_f32 "MICROSAR RTE" /begin REF_MEASUREMENT Rte_ThrmlDutyCycle_ThermalLimit_MtrNm_f32 /end REF_MEASUREMENT /end GROUP
/begin GROUP TmprlMon.TMFTestComplete.Cnt_lgc "MICROSAR RTE" /begin REF_MEASUREMENT Rte_TmprlMon_TMFTestComplete_Cnt_lgc /end REF_MEASUREMENT /end GROUP
/begin GROUP TmprlMon.TMFTestStart.Cnt_lgc "MICROSAR RTE" /begin REF_MEASUREMENT Rte_HwPwUp_TMFTestStart_Cnt_lgc /end REF_MEASUREMENT /end GROUP
/begin GROUP TqRsDg.DervLambdaAlphaDiag.Volt_f32 "MICROSAR RTE" /begin REF_MEASUREMENT Rte_PICurrCntrl_DervLambdaAlphaDiag_Volt_f32 /end REF_MEASUREMENT /end GROUP
/begin GROUP TqRsDg.DervLambdaBetaDiag.Volt_f32 "MICROSAR RTE" /begin REF_MEASUREMENT Rte_PICurrCntrl_DervLambdaBetaDiag_Volt_f32 /end REF_MEASUREMENT /end GROUP
/begin GROUP TqRsDg.OutputRampMult.Uls_f32 "MICROSAR RTE" /begin REF_MEASUREMENT Rte_StOpCtrl_OutputRampMult_Uls_f32 /end REF_MEASUREMENT /end GROUP
/begin GROUP VehPwrMd.OutputRampMult.Uls_f32 "MICROSAR RTE" /begin REF_MEASUREMENT Rte_StOpCtrl_OutputRampMult_Uls_f32 /end REF_MEASUREMENT /end GROUP
/begin GROUP VehSpdLmt.AstVehSpdLimit.MtrNm_f32 "MICROSAR RTE" /begin REF_MEASUREMENT Rte_VehSpdLmt_AstVehSpdLimit_MtrNm_f32 /end REF_MEASUREMENT /end GROUP
/begin RECORD_LAYOUT RTE_RL_SWORD FNC_VALUES 1 SWORD ROW_DIR DIRECT /end RECORD_LAYOUT
/begin RECORD_LAYOUT RTE_RL_SLONG FNC_VALUES 1 SLONG ROW_DIR DIRECT /end RECORD_LAYOUT
/**********************************************************************************************************************
* COMPU_METHOD / COMPU_VTAB_RANGE
*********************************************************************************************************************/
/begin COMPU_METHOD RTE_CM_BOOLEAN "" TAB_VERB "%3.1" "" COMPU_TAB_REF RTE_CM_BOOLEAN /end COMPU_METHOD
/begin COMPU_VTAB_RANGE RTE_CM_BOOLEAN "" 2 0 0 "false" 1 255 "true" /end COMPU_VTAB_RANGE
/begin COMPU_METHOD RTE_CM_ENUM_FETPHASETYPE_ENUM "" TAB_VERB "%.1" "" COMPU_TAB_REF RTE_CM_ENUM_FETPHASETYPE_ENUM /end COMPU_METHOD
/begin COMPU_VTAB_RANGE RTE_CM_ENUM_FETPHASETYPE_ENUM "" 4 0 0 "NOPHASE" 1 1 "PHASEA" 2 2 "PHASEB" 3 3 "PHASEC" /end COMPU_VTAB_RANGE
/begin COMPU_METHOD RTE_CM_ENUM_FETFAULTTYPE_ENUM "" TAB_VERB "%.1" "" COMPU_TAB_REF RTE_CM_ENUM_FETFAULTTYPE_ENUM /end COMPU_METHOD
/begin COMPU_VTAB_RANGE RTE_CM_ENUM_FETFAULTTYPE_ENUM "" 3 0 0 "NOFAULT" 1 1 "LOWER" 2 2 "UPPER" /end COMPU_VTAB_RANGE
